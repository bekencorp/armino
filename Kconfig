## components/ali_mqtt/Kconfig
```kconfig
menu "Ali_mqtt"

	config ALI_MQTT
		depends on WIFI_ENABLE
		bool "Enable Ali Mqtt"
		default y

endmenu
```

## components/app/Kconfig
```kconfig
menu "App"

	config DEMO_TEST
		bool "Enable Demo Test"
		default n

	#TODO does UPGRADE here means OTA?
	config FTPD_UPGRADE
		bool "Enable Ftpd Upgrade"
		default n

	config OTA_HTTP
		depends on WIFI_ENABLE
		bool "Enable Ota Http"
		default y if NO_HOSTED
		default n if !NO_HOSTED

	#TODO what's the relationship between HTTP and TFTP OTA, exculsive?
	config OTA_TFTP
		bool "Enable Ota Tftp"
		default n

	config USE_APP_DEMO_VIDEO_TRANSSER
		depends on WIFI_ENABLE
		depends on CAMERA
		bool "Enable Use App Demo Video Transser"
		default n

	config APP_DEMO_VIDEO_TRANSFER
		depends on CAMERA && WIFI_ENABLE
		bool "Enable App Demo Video Transser"
		default n

	config NET_WORK_VIDEO_TRANSFER
		depends on CAMERA && WIFI_ENABLE
		bool "Enable Net Work Video Transser"
		default n

	config COMPONENTS_P2P
		bool "Enable Components P2P"
		default n
		help
                	Enable NET_WORK P2P

	config LVGL_DEMO
		bool "Enable Lvgl Demo"
		default n

	config NTP_SYNC_RTC
		depends on AON_RTC
		bool "Enable Ntp Sync Rtc"
		default n

	config VIDEO_AVI
		depends on NTP_SYNC_RTC
		bool "Enable Video Avi"
		default n

	config LITTLEFS
		bool "Enable Littlefs"
		default n

endmenu
```

## components/audio/Kconfig
```kconfig
menu "Audio"

	config AUDIO
		bool "Enable Audio"
		default n
	menu "Modify Audio Config"
		config AUDIO_ADC
			depends on AUDIO
			bool "Enable Audio Adc"
			default y

		config AUDIO_DAC
			depends on AUDIO
			bool "Enable Audio Dac"
			default y
	endmenu
endmenu
```

## components/bk_ate/Kconfig
```kconfig
menu "Bk_ate"

	config ATE
		bool "Enable Ate"
		default n

	menu "Modify Ate Config"
		config ATE_GPIO_ID
			depends on ATE
			int "Set Ate Gpio Id"
			default 0

		config ATE_GPIO_PULL_UP
			depends on ATE
			bool "Enable Ate Gpio Pull Up"
			default y

		config ATE_TEST
			depends on ATE
			bool "Enable Ate Test"
			default n
	endmenu

endmenu
```

## components/bk_ble/Kconfig
```kconfig
menu "Bk_ble"
	depends on BLUETOOTH

	config BT
		bool "Enable Bt"
		default n

	config BLE
		bool "Enable Ble"
		default y

	choice BLE_STACK
		prompt "Select Ble Version"
		depends on BLE
		default BLE_5_X

		config BLE_5_X
			bool "BLE 5.X"
		config BLE_4_2
			bool "BLE 4.2"
		config BTDM_5_2
			bool "BTDM 5.2"
		config BTDM_5_2_MINDTREE
			bool "BTDM 5.2 Mindtree Host"
	endchoice

endmenu
```

## components/bk_cli/Kconfig
```kconfig
menu "Bk_cli"

	menu "Modify Cli Config"

		config CLI
			bool "Enable Cli"
			default y

		config CLI_USER_CONFIG
			depends on CLI
			bool "Enable Cli User Config"
			default n
			help
				support cli user configuration header

		config CLI_USER_CONFIG_DIR
			depends on CLI_USER_CONFIG
			string "Define Cli User Config Dir"
			default ""
			help
				cli user configuration header directory

		config BKREG
			depends on CLI
			bool "Enable Bkreg"
			default y
			help
				Enable BK Reg read/write

		config MAX_COMMANDS
			depends on CLI
			int "Set Max Commands"
			range 0 65535
			default 255
			help
				MAX number of commands is configured by default

		config IPERF_TEST
			depends on CLI
			bool "Enable Iperf Test"
			default y

		config TCP_SERVER_TEST
			depends on CLI
			bool "Enable Tcp Server Test"
			default n

		config AIRKISS_TEST
			depends on CLI
			bool "Enable Airkiss Test"
			default n

		config WIFI_RAW_TX_TEST
			depends on CLI
			bool "Enable Wifi Raw Tx Test"
			default n

		config CONNECT_THROUGH_PSK_OR_SAE_PASSWORD
			depends on CLI
			bool "Enable connect through psk or sae password"
			default n

		config VFS_TEST
			depends on CLI
			bool "Enable Vfs Test"
			default n

		#TODO Exculsive??
		config I2C1_TEST
			depends on CLI
			bool "Enable I2C1 Test"
			default n

		config I2C2_TEST
			depends on CLI
			bool "Enable I2C2 Test"
			default n

		config UART_TEST
			depends on CLI
			bool "Enable Uart Test"
			default n

		config SPI_TEST
			depends on CLI
			bool "Enable SPI Test"
			default n

		config PERI_TEST
			depends on CLI
			bool "Enable Peri Test"
			default n

		config RF_OTA_TEST
			depends on CLI
			bool "Enable Rf Ota Test"
			default n

		config SHELL_ASYNCLOG
			depends on CLI
			bool "Enable Shell Asynclog"
			default n
			help
				Enable Shell and Async log optimize

		config TOUCH_TEST
			depends on CLI
			bool "Enable Touch Test"
			default n

		config SBC_TEST
			depends on CLI
			bool "Enable Sbc Test"
			default n

		config AUDIO
			depends on CLI
			bool "Enable Audio"
			default n

		config PSRAM_TEST
			depends on CLI
			bool "Enable Psram Test"
			default n

		config CAMERA_TEST
			depends on CLI
			bool "Enable Camera Test"
			default n

		config SPE_TEST
			depends on CLI
			bool "Enable Spe Test"
			default n

		config MPC_TEST
			depends on CLI
			bool "Enable Mpc Test"
			default n

		config PRRO_TEST
			depends on CLI
			bool "Enable Prro Test"
			default n

		config INTERRUPT_TEST
			depends on CLI
			bool "Enable Interrupt Test"
			default n

		config AON_PMU_TEST
			depends on CLI
			bool "Enable Aon Pmu Test"
			default n

		config SDMADC_TEST
			depends on CLI
			bool "Enable Sdmadc Test"

		config PM_TEST
			depends on CLI
			bool "Enable Pm Test"
			default n

		config EFUSE
			bool "Enable Efuse"
			default y

		config ICU
			bool "Enable Icu"
			default y

		config SECURITYIP
			bool "Enable Securityip"
			default n
			help
				Enable SecurityIP

		config KEYVALUE
			bool "Enable Keyvalue"
			default n

		config IDLE_UART_OUT_TEST
			bool "Enable Idle Uart Out Test"
			default n

		config COMPONENTS_WPA2_ENTERPRISE
			bool "Enable Components Wpa2 Enterprise"
			default n

		config COMPONENTS_WPA_TWT_TEST
			bool "Enable Wpa Twt Test"
			default n

		config COMPONENTS_WFA_CA
			bool "Enable Components Wfa Ca"
			default n

		config ENABLE_WIFI_DEFAULT_CONNECT
			bool "Enable Wifi Default Connect"
			default n
			
		config OTP
			bool "Enable OTP"
			default y

		config RTC_TIMER_PRECISION_TEST
			bool "Enable RTC Timer precision test"
			default n

		config RTC_TIMER_PRECISION_TEST_BY_GPIO
			bool "Enable RTC Timer precision test"
			default n
	endmenu

	menu "Modify Dual Core Config"

		config DUAL_CORE
			bool "Enable Dual Core"
			default n
			help
				Dual cpu core run as master core

		config SLAVE_CORE
			depends on DUAL_CORE
			bool "Enable Slave Core"
			default n
			help
				Dual cpu core run as slave core

		config MASTER_CORE
			depends on DUAL_CORE
			bool "Enable Master Core"
			default n
			help
				Dual cpu core run as master core

		config SLAVE_CORE_OFFSET
			depends on MASTER_CORE
			int "Set Slave Core Offset"
			range 0 268435456
			default 3014656
			help
				Slave core offset address default 0x2e0000

		config SLAVE_CORE_RESET_VALUE
			depends on MASTER_CORE
			int "Set Slave Core Reset Value"
			range 0 1
			default 1

		config EFUSE
			bool "Enable Efuse"
			default y

		config ICU
			bool "Enable Icu"
			default y

		config RWNX_PROTO_DEBUG
			bool "Enable Rwnx Proto Debug"
			default n

	endmenu

endmenu
```

## components/bk_https/Kconfig
```kconfig
menu "Https"
	config HTTPS
	depends on MBEDTLS
		bool "Enable HTTPS"
		default n

endmenu
```

## components/bk_init/Kconfig
```kconfig
menu "Bk_init"

	config LIB_HASH_CHECK
		bool "Enable Lib Hash check"
		default y

endmenu
```

## components/bk_libs/Kconfig
```kconfig
#TODO remove all kconfigs which are defined in armino libs

menu "Internal Kconfig"

	config MCU_PS
		bool "Enable MCU Sleep"
		default y

	config DEEP_PS
		bool "Enable Deep Sleep"
		default y

	config TICK_CALI
		bool "Enable tick time caliration"
		default y

	config STA_PS
		bool "Enable STA PS"
		default y if !RF_OTA_TEST
		default n if RF_OTA_TEST
endmenu
```

## components/bk_netif/Kconfig
```kconfig
menu "Bk_netif"

	config BK_NETIF
		depends on WIFI_ENABLE
		bool "Enable Bk Netif" 
		default y

endmenu
```

## components/bk_rtos/Kconfig
```kconfig
menu "Bk_rtos"

	config CUSTOMIZE_HEAP_SIZE
		int "Set Customize Heap Size"
		default 163840
		help
			customize heap size, default 160k

	menu "Modify FreeRTOS Config"

		config FREERTOS
			bool "Enable FreeRTOS"
			default y

		config MEM_MGMT
			bool "Enable Mem Mgmt"
			default n
			help
				Enable heap management module

		choice FREERTOS_VER
			depends on FREERTOS
			prompt "Select FreeRTOS Version"
			default FREERTOS_V9

			config FREERTOS_V9
				bool "FreeRTOS v9.0.0"
			config FREERTOS_V10
				bool "FreeRTOS v10"
		endchoice

		config FREERTOS_POSIX
			depends on FREERTOS_V10
			bool "Enable FreeRTOS Posix"
			default n

		config FREERTOS_USE_TICKLESS_IDLE
			depends on FREERTOS_V10
			int "Set FreeRTOS Use Tickless Idle"
			default 2
			help
				Use tickless idle, can be 0/1/2

	endmenu

	menu "Modify LITEOS_M Config"

		config LITEOS_M
			bool "Enable Liteos_m"
			default n

		config LITEOS_M_V3
			bool "Enable Liteos_m_v3"
			default n
			help
				liteos_m v3.0.1-LTS

		config LITEOS_M_BK
			depends on LITEOS_M_V3
			bool "Enable Liteos_m_bk"
			default n
			help
				liteos_m bk adapter

	endmenu

	menu "Modify NON_OS Config"
	
		config NON_OS
			bool "Enable Non_os"
			default n

	endmenu

	menu "Modify Memory Debug Config"

		config MALLOC_STATIS
			bool "Enable Malloc Statis"
			default n
			help
				enable malloc statistics

		config MEM_DEBUG
			bool "Enable Mem Debug"
			default n
			help
				When this option is enable, more memory will be consumed because
				a fixed length debug block will be appended to every memory allocated
				from heap.
				Moreover, suggest disable task/watchdog when this option is enabled
				in case os_dump_memory_stats() triggers watchdog.

		config MEM_DEBUG_FUNC_NAME
			depends on MEM_DEBUG
			bool "Enable Mem Debug Func Name"
			default y

		config MEM_DEBUG_FUNC_NAME_LEN
			depends on MEM_DEBUG_FUNC_NAME
			int "Set Mem Debug Func Name Len"
			default 16
			help
				set memory debug function name length

		config MEM_DEBUG_TASK_NAME
			depends on MEM_DEBUG
			bool "Enable Mem Debug Task Name"
			default y

		config MEM_DEBUG_TASK_NAME_LEN
			depends on MEM_DEBUG_TASK_NAME
			int "Set Mem Debug Task Name Len"
			default 8
			help
				set memory debug task name length

	endmenu

endmenu
```

## components/bk_startup/Kconfig
```kconfig
menu "Startup"
	config APP_MAIN_TASK_PRIO
		int "Priority of application main task"
		range 1 10
		default 4

	config APP_MAIN_TASK_STACK_SIZE
		int "Stack size of application main task"
		default 4096

	config MATTER_START
		bool "enable matter auto start"
		default n

endmenu
```

## components/bk_system/Kconfig
```kconfig
#TODO may need to remove this component!
menu "BK_system"

	choice BASE_MAC_SRC
		prompt "Select Base Mac Source"
		default NEW_MAC_POLICY

		config BASE_MAC_FROM_EFUSE
			bool "BASE_MAC_FROM_EFUSE"
		config BASE_MAC_FROM_RF_OTP_FLASH
			bool "BASE_MAC_FROM_RF_OTP_FLASH"
		config NEW_MAC_POLICY
			bool "NEW_MAC_POLICY"
	endchoice

	config RANDOM_MAC_ADDR
        bool "Enable Random Mac Addr"
        default n

	config BK_MAC_ADDR_CHECK
		bool "Enable Beken Mac Addr Check"
		default n

endmenu
```

## components/bk_thirdparty/Kconfig
```kconfig
#TODO remove all kconfigs which are defined in armino libs

menu "bk_thirdparty"

    config CS2_P2P_SERVER
        bool "Enable CS2 P2P server"
        default n
        help
        Enable CS2 P2P lib server

    config CS2_P2P_CLIENT
        bool "Enable CS2 P2P client"
        default n
        help
        Enable CS2 P2P lib client

    config CS2_P2P_TEST
        bool "Enable CS2 P2P Test"
        default n
        help
        Enable CS2 P2P lib test

endmenu
```

## components/bk_thirdparty/P2P/Kconfig
```kconfig
#TODO remove all kconfigs which are defined in armino libs

menu "Bk_thirdparty"

    config CS2_P2P_SERVER
	bool "Enable CS2 P2P server"
	default n
	help
            Enable CS2 P2P lib

    config CS2_P2P_CLIENT
        bool "Enable CS2 P2P client"
        default n
        help
            Enable CS2 P2P lib

    config CS2_P2P_TEST
        bool "Enable CS2 P2P Test"
        default n
		help
			Enable CS2 P2P lib test

endmenu
```

## components/bk_thirdparty/aac_decoder/Kconfig
```kconfig
menu "Bk_thirdparty::aac_decoder"

	config AAC_DECODER
		bool "Enable AAC decoder"
		default n
		help
			Enable AAC decoder lib

endmenu
```

## components/bk_thirdparty/agora-iot-sdk/Kconfig
```kconfig
menu "Bk_thirdparty::agora-iot-sdk"

	config AGORA_IOT_SDK
		bool "Enable Agora iot sdk"
		default n
		help
			Enable Agora iot sdk lib

endmenu
```

## components/bk_thirdparty/asr/Kconfig
```kconfig
menu "Bk_thirdparty::asr"

	config ASR
		bool "Enable huazhen ASR"
		default n
		help
			Enable huazhen Automatic Speech Recognition

endmenu
```

## components/bk_thirdparty/asr/wanson/Kconfig
```kconfig
menu "Bk_thirdparty::asr"

	config ASR
		bool "Enable Wanson ASR"
		default n
		help
			Enable Wanson Automatic Speech Recognition

endmenu
```

## components/bk_thirdparty/cs2p2p/Kconfig
```kconfig
#TODO remove all kconfigs which are defined in armino libs

menu "cs2p2p"

    config CS2_P2P_SERVER
		bool "Enable CS2 P2P server"
		default n
		help
            Enable CS2 P2P server lib

    config CS2_P2P_CLIENT
        bool "Enable CS2 P2P client"
        default n
        help
            Enable CS2 P2P client lib

    config CS2_P2P_TEST
        bool "Enable CS2 P2P Test"
        default n
		help
			Enable CS2 P2P lib test

endmenu
```
