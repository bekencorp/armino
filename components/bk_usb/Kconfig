## components/bk_usb/Kconfig
```kconfig
menu "Bk_usb"

	config USB
		bool "Enable Usb"
		default n

	menu "Modify Usb Config"
		depends on USB

		choice USB_PROTOCOL_STACK
			prompt "Select Usb Protocol Stack"
			default MENTOR_USB

			config MENTOR_USB
				bool "MENTOR_USB"
			config CHERRY_USB
				bool "CHERRY_USB"
		endchoice

	#TODO HOST/DEVICE mode mutual exclusive???
		choice USB_MODE
			prompt "Select Usb Host Mode"
			default USB_HOST

			config USB_HOST
				bool "USB_HOST"
				help
					USB Host Mode
			config USB_DEVICE
				bool "USB_DEVICE"
				help
					USB Device Mode
		endchoice

		choice USB_PORT
			prompt "Select Usb Port"
			default USB2_PORT
			
			config USB1_PORT
				bool "USB1_PORT"
			config USB2_PORT
				bool "USB2_PORT"
		endchoice

		config TASK_USB_PRIO
			int "Set Task Usb Prio"
			range 1 10
			default 5
			help
				Priority of USB task

		config USB_MSD
			bool "Enable Usb Msd"
			default y

		config USB_HID
			bool "Enable Usb Hid"
			default n

		config USB_CCD
			bool "Enable Usb Ccd"
			default n

		config USB_UVC
			bool "Enable Usb Uvc"
			default n

		config USB_UVC_DEBUG
			depends on USB_UVC
			bool "Enable Usb Uvc Debug"
			default n

		config USB_UAC
			depends on USB_UVC
			bool "Enable Usb Uac"
			default n

		menu "Modify Usb Uac Config"
			depends on USB_UAC

			config USB_UAC_DEBUG
				bool "Enable Usb Uac Debug"
				default n

			config USB_UAC_MIC
				bool "Enable Usb Uac Mic"
				default n

			config USB_UAC_SPEAKER
				bool "Enable Usb Uac Speaker"
				default n

		endmenu

		config USB_CHARGE
			bool "Enable Usb Charge"
			default n

	endmenu

	menu "Modify Dsp Config"

		config DSP
			bool "Enable Dsp"
			default n

		#TODO delete it
		config DSP_SRC_ADD
			hex "Set Dsp Src Add"
			default 0x130000
			help
				set dsp source address

	endmenu

endmenu
```

## components/bk_websocket/Kconfig
```kconfig
menu "Bk_websocket"

	config WEBSOCKET
		depends on MBEDTLS
		bool "Enable Websocket"
		default n

endmenu
```

## components/bk_wifi/Kconfig
```kconfig
#TODO optimize it
menu "Bk_Wifi"

	config WIFI_ENABLE
		bool "Enable Wifi Enable"
		default y
		help
			enable wifi

	config WIFI6_CODE_STACK
		depends on WIFI_ENABLE
		bool "Enable Wifi6 Code Stack"
		default n
		help
			Use WiFi-6 Code Stack

	config WIFI4
		depends on WIFI_ENABLE
		bool "Enable Wifi4"
		default y
		help
			Don't disable it when WiFi-6 is enabled.

	config WIFI5
		bool "Enable Wifi5"
		default n
		help
			Don't disable it when WiFi-6 is enabled.

	config WIFI6
		bool "Enable Wifi6"
		depends on WIFI6_CODE_STACK && WIFI_ENABLE
		default n

	config WIFI6E
		bool "Enable Wifi6e"
		depends on WIFI6_CODE_STACK
		default n

	config WIFI6_IP_DEBUG
		depends on WIFI6_CODE_STACK
		bool "Enable Wifi6 Ip Debug"
		default n

#TODO remove below kconfig

	config MSDU_RESV_HEAD_LENGTH
		int "Set Msdu Resv Head Length"
		range 1 1500
		default 96
		help
			MSDU reserved header length

	config MSDU_RESV_TAIL_LENGTH
		int "Set Msdu Resv Tail Length"
		range 1 1500
		default 16
		help
			MSDU reserved tail length
	
	#TODO may need to remove it
	config TASK_RECONNECT_PRIO
		int "Set Task Reconnect Prio"
		range 1 10
		default 4
		help
			Priority of WiFi reconnect task

	config AP_MONITOR_COEXIST
		bool "Enable Ap Monitor Coexist"
		default n
		help
			enable AP and monitor coexist

	config CONNECT_THROUGH_PSK_OR_SAE_PASSWORD
		bool"Enable connect through psk or sae password"
		default n

	config WIFI_FAST_CONNECT
		bool "Enable Wifi Fast Connect"
		default n

	config MINIMUM_SCAN_RESULTS
		bool "Enable minimum scan results"
		default n

	config BSSID_CONNECT
		depends on WIFI_ENABLE
		bool "Enable Bssid Connect"
		default n
		help
			enable WiFi BSSI connect

	config WFA_CERT
		bool "Enable Wfa Cert"
		default n
		help
			enable WiFi WFA Certification

	config LESS_MEMERY_IN_RWNX
		bool "Enable Less Memory In Rwnx"
		default n

	config AP_PROBEREQ_CB
		bool "Enable Ap Probereq Cb"
		default n
		help
			enable AP probe request callback

	config STA_PS
		bool "Enable Sta Ps"
		default y if !RF_OTA_TEST
		default n if RF_OTA_TEST

	config MAC_BSSID
		depends on WIFI_ENABLE
		bool "Enable Mac Bssid"
		default n

	config COMPONENTS_STA_VSIE
		bool "Enable Components Sta Vsie"
		default n
endmenu
```

## components/cmsis/Kconfig
```kconfig
config CMSIS
	bool "Enable CMSIS"
	default n

menu "CMSIS"
	depends on CMSIS

	config DEFAULT_CMSIS_START
		bool "Use default CMSIS start"
		default y

	config DCACHE
		bool "Enable data cache"
		default n

	config ICACHE
		bool "Enable code cache"
		default y
endmenu
```

## components/coredump/Kconfig
```kconfig
menu "Coredump"
	config CM_BACKTRACE
		bool "Enable Cm Backtrace"
		default n
endmenu
```

## components/demos/bluetooth/Kconfig
```kconfig
menu "Demos::Bluetooth"
	config A2DP_SINK_DEMO
		bool "Enable A2DP SINK DEMO"
		depends on BT
		depends on AUDIO
		depends on AAC_DECODER
		default n

	config A2DP_AUDIO
		bool "Enable A2DP AUDIO"
		depends on BT
		default n

    config A2DP_SOURCE_DEMO
        bool "Enable A2DP SOURCE DEMO"
        depends on BT
        depends on AUDIO
        depends on FATFS
        default n

	config A2DP_CACHE_FRAME_NUM
		int "A2DP Cache Frame Num"
		depends on A2DP_SINK_DEMO
		range 3 255
		default 4

	config HFP_HF_DEMO
		bool "Enable HFP HF DEMO"
		depends on BT
		depends on AUDIO
		default n
endmenu
```

## components/demos/bluetooth/ble_boarding/Kconfig
```kconfig
menu "DEMOS_CONFIG"
	config CONFIG_AT_CMD
		bool "Enable ble boarding demos"
		default n
endmenu
```

## components/demos/media/agora/Kconfig
```kconfig
menu "Demos::Media::Agora"

    config AGORA_IOT_SDK_TEST
        bool "Enable Agora iot sdk Test"
		depends on AGORA_IOT_SDK
        default n
		help
			Enable Agora iot sdk lib test

endmenu
```

## components/demos/media/audio/adpcm/Kconfig
```kconfig
menu "Demos::Media::Audio::Adpcm"
	config AUDIO_ADPCM_TEST
		bool "Enable Audio Adpcm Test"
		default n
endmenu
```

## components/demos/media/audio/aec/Kconfig
```kconfig
menu "Demos::Media::Audio::Aec"
	config AUDIO_AEC_TEST
		bool "Enable Audio Aec Test"
		default n
endmenu
```

## components/demos/media/audio/aud/Kconfig
```kconfig
menu "Demos::Media::Audio::Aud"
	config AUDIO_TEST
		bool "Enable Audio Test"
		default n
endmenu
```

## components/demos/media/audio/aud_intf/Kconfig
```kconfig
menu "Demos::Media::Audio::Aud_intf"
	menu "Modify Aud Intf Config"
		config AUD_INTF
			bool "Enable Aud Intf"
			default n
			help
				Enable Audio Interface API

		config AUD_INTF_TEST
			depends on AUD_INTF
			bool "Enable Aud Intf Test"
			default n
			help
				enable Audio interface test
	endmenu

	menu "Modify Aud Trasfer Config"

		config AUD_RING_BUFF_SAFE_INTERVAL
			int "Set Aud Ring Buff Safe Interval"
			range 0 320
			default 0
			help
				Audio ring buff safe interval

		config AUDIO_TRANSFER
			bool "Enable Audio Transfer"
			default n
			help
				Enable Audio Transfer Feature

		choice AUD_TRAS_MODE
			depends on AUDIO_TRANSFER
			prompt "Select Audio Transfer Mode"
			default AUD_TRAS_MODE_CPU1

			config AUD_TRAS_MODE_CPU0
				bool "AUD_TRAS_MODE_CPU0"
				help
					Audio Transfer in CPU0

			config AUD_TRAS_MODE_CPU1
				bool "AUD_TRAS_MODE_CPU1"
				help
					Audio Transfer in CPU1
		endchoice

		config AUD_TRAS_AEC_DUMP_DEBUG
			depends on AUDIO_TRANSFER
			bool "Enable Aud Tras Aec Dump Debug"
			default n
			help
				enable Audio Transfer AEC dump debug

		choice AUD_TRAS_AEC_DUMP_MODE
			depends on AUD_TRAS_AEC_DUMP_DEBUG
			prompt "Select Audio Transfer AEC Dump Mode"
			default AUD_TRAS_AEC_DUMP_MODE_TF

			config AUD_TRAS_AEC_DUMP_MODE_TF
				bool "AUD_TRAS_AEC_DUMP_MODE_TF"
				help
					Audio Transfer AEC Dump by TFcard

			config AUD_TRAS_AEC_DUMP_MODE_UART
				bool "AUD_TRAS_AEC_DUMP_MODE_UART"
				help
					Audio Transfer AEC Dump by Uart

			menu "Modify Aud Tras Aec Dump Uart Config"
				depends on AUD_TRAS_AEC_DUMP_MODE_UART
				
				config AUD_TRAS_AEC_DUMP_UART_BAUDRATE
					int "Set Aud Tras Aec Dump Uart Baudrate"
					range 921600 2000000
					default 921600
					help
						Audio Transfer AEC dump uart baudrate

				config AUD_TRAS_AEC_DUMP_UART_ID
					int "Set Aud Tras Aec Dump Uart Id"
					range 0 2
					default 1
					help
						Audio Transfer AEC dump uart id
			endmenu

			config AUD_TRAS_AEC_DUMP_MODE_WIFI
				bool "AUD_TRAS_AEC_DUMP_MODE_WIFI"
				help
					Audio Transfer AEC Dump by udp

			choice AUD_TRAS_AEC_DUMP_MODE_WIFI_MODE
				depends on AUD_TRAS_AEC_DUMP_MODE_WIFI
				prompt "Select Audio Transfer AEC WIFI Mode"
				default AUD_TRAS_AEC_DUMP_MODE_UDP

				config AUD_TRAS_AEC_DUMP_MODE_UDP
					bool "AUD_TRAS_AEC_DUMP_MODE_UDP"
					help
						Audio Transfer AEC Dump by UDP

				config AUD_TRAS_AEC_DUMP_MODE_TCP
					bool "AUD_TRAS_AEC_DUMP_MODE_TCP"
					help
						Audio Transfer AEC Dump by TCP
			endchoice
		endchoice

		config AUD_TRAS_LOST_COUNT_DEBUG
			depends on AUDIO_TRANSFER
			bool "Enable Aud Tras Lost Count Debug"
			default n
			help
				enable Audio Transfer lost count debug

		config AUD_TRAS_AEC_MIC_DELAY_DEBUG
			depends on AUDIO_TRANSFER
			bool "Enable Aud Tras Aec Mic Delay Debug"
			default n
			help
				enable Audio Transfer AEC mic Delay debug

		config AUD_TRAS_AEC_MIC_DELAY_POINTS
			depends on AUDIO_TRANSFER
			int "Set Aud Tras Aec Mic Delay Points"
			range 1 320
			default 54
			help
				Audio Transfer AEC mic Delay points

		config AUD_TRAS_DAC_DEBUG
			depends on AUDIO_TRANSFER
			bool "Enable Aud Tras Dac Debug"
			default n
			help
				Audio Transfer DAC ERROR DEBUG

		config AUD_TRAS_DAC_PA_CTRL
			depends on AUDIO_TRANSFER
			bool "Enable Aud Tras Dac Pa Ctrl"
			default n
			help
				Audio Transfer DAC PA Control Enable

		choice AUD_TRAS_UAC_SPK_VOL_CTRL_MODE
			depends on AUDIO_TRANSFER
			prompt "Select UAC speaker volume set Mode"
			default AUD_TRAS_UAC_SPK_VOL_CTRL_MODE_DIRECT

			config AUD_TRAS_UAC_SPK_VOL_CTRL_MODE_DIRECT
				bool "Enable direct set uac speaker volume mode"
				help
					Direct set uac speaker volume

			config AUD_TRAS_UAC_SPK_VOL_CTRL_MODE_STOP_UAC_TRAS
				bool "Enable indirect set uac speaker volume mode "
				help
					Indirect set uac speaker volume after stop uac mic and speaker transfer, then recover uac mic and speaker transfer

			config AUD_TRAS_UAC_SPK_VOL_CTRL_MODE_MUTE
				bool "Enable indirect set uac speaker volume mode "
				help
					Indirect set uac speaker volume after mute, then unmute
		endchoice

	endmenu
endmenu
```

## components/demos/media/audio/aud_ns/Kconfig
```kconfig
menu "Demos::Media::Audio::Aud_ns"
	config AUDIO_NS_TEST
		bool "Enable Audio Ns Test"
		default n
		help
			Enable AUDIO Noise Suppression Test
endmenu
```

## components/demos/media/audio/aud_vad/Kconfig
```kconfig
menu "Demos::Media::Audio::Aud_vad"
	config AUDIO_VAD_TEST
		bool "Enable Audio Vad Test"
		default n
		help
			Enable AUDIO Voice Activity Detection Test
endmenu
```

## components/demos/media/audio/audio_asr/Kconfig
```kconfig
menu "Demos::Media::Audio::Audio_asr"
	config ASR_TEST
		depends on AUDIO
		depends on AUD_INTF
		depends on FATFS
		bool "Enable Audio Asr Test"
		default n
endmenu
```

## components/demos/media/audio/es8311/Kconfig
```kconfig
menu "Demos::Media::Audio::ES8311"
	config ES8311_TEST
		depends on ES8311
		depends on FATFS
		bool "Enable es8311 Test"
		default n
endmenu
```

## components/demos/media/audio/fft/Kconfig
```kconfig
menu "Demos::Media::Audio::Fft"
	config FFT_TEST
		bool "Enable FFT Test"
		default n
endmenu
```

## components/demos/media/audio/flac/Kconfig
```kconfig
menu "Demos::Media::Audio::Flac"
	config AUDIO_FLAC_TEST
		bool "Enable Audio Flac Test"
		default n
		help
			Enable Audio FLAC Encoder and Decoder Test
endmenu
```

## components/demos/media/audio/g711/Kconfig
```kconfig
menu "Demos::Media::Audio::G711"
	config AUDIO_G711_TEST
		bool "Enable Audio G711 Test"
		default n
endmenu
```

## components/demos/media/audio/i2s/Kconfig
```kconfig
menu "Demos::Media::Audio::I2s"
	config I2S_TEST
		bool "Enable I2S Test"
		depends on I2S
		default n
endmenu
```

## components/demos/media/audio/mp3/Kconfig
```kconfig
menu "Demos::Media::Audio::Mp3"
	config AUDIO_MP3_TEST
		bool "Enable Audio MP3 Test"
		default n
endmenu
```

## components/demos/media/audio/opus/Kconfig
```kconfig
menu "Demos::Media::Audio::Opus"
	config AUDIO_OPUS_TEST
		bool "Enable Audio Opus Test"
		default n
endmenu
```

## components/demos/media/audio/rsp/Kconfig
```kconfig
menu "Demos::Media::Audio::Rsp"
	config AUDIO_RSP_TEST
		bool "Enable Audio Rsp Test"
		default n
		help
			Enable AUDIO Resample Test
endmenu
```

## components/demos/media/audio/sbc_decode/Kconfig
```kconfig
menu "Demos::Media::Audio::Sbc_decode"
	config SBC_TEST
		bool "Enable Sbc Test"
		default n
		help
			Enable sbc decode demos
endmenu
```
