## components/demos/media/av_demo/Kconfig
```kconfig
menu "Demos::Media::Av_demo"
	config AV_DEMO
		depends on DOORBELL
		bool "Enable Av Demo"
		default n

	choice AV_DEMO_MODE
		depends on AV_DEMO
		prompt "Select Av Demo Mode"
		default AV_DEMO_MODE_UDP

		config AV_DEMO_MODE_UDP
			bool "AV_DEMO_MODE_UDP"
			help
				AV demo work in UDP mode

		config AV_DEMO_MODE_TCP
			bool "AV_DEMO_MODE_TCP"
			help
				AV demo work in TCP mode

	endchoice
endmenu
```

## components/demos/media/dma2d/Kconfig
```kconfig
menu "Demos::Media::Dma2d"
	config DMA2D_TEST
		bool "Enable Dma2d Test"
		default n
		help
			Enable lcd demos
endmenu
```

## components/demos/media/doorbell/Kconfig
```kconfig
menu "Demos::Media::Doorbell"
	config DOORBELL
		depends on MEDIA && WIFI_ENABLE
		bool "Enable Doorbell"
		default n

	config DOORBELL_DEMO2
		depends on DOORBELL
		bool "Enable Doorbell Demo2"
		default n
endmenu
```

## components/demos/media/lcd/Kconfig
```kconfig
menu "DEMOS_CONFIG"
	config LCD_TEST
		bool "Enable lcd demos"
		default n
endmenu
```

## components/demos/media/lcd/common/Kconfig
```kconfig
menu "Demos::Media::Lcd::Common"
	config LCD_TEST
		depends on LCD
		bool "Enable Lcd Test"
		default n
endmenu
```

## components/demos/media/lcd/lcd_8080/Kconfig
```kconfig
menu "Demos::Media::Lcd::Lcd_8080"
	config LCD_TEST
		depends on LCD
		bool "Enable Lcd Test"
		default n
		help
			Enable lcd demos
endmenu
```

## components/demos/media/lcd/lcd_qspi/Kconfig
```kconfig
menu "Demos::Media::Lcd::Lcd_qspi"
	config LCD_QSPI_TEST
		depends on LCD_QSPI
		bool "Enable Lcd Qspi Test"
		default n
endmenu
```

## components/demos/media/lcd/lcd_rgb/Kconfig
```kconfig
menu "Demos::Media::Lcd::Lcd_rgb"
	config LCD_TEST
		depends on LCD
		bool "Enable Lcd Test"
		default n
		help
			Enable lcd demos
endmenu
```

## components/demos/media/lcd/picture_display/Kconfig
```kconfig
menu "Demos::Media::Lcd::Picture_display"
	config LCD_TEST
		depends on LCD
		bool "Enable Lcd Test"
		default n
		help
			Enable lcd demos
endmenu
```

## components/demos/media/lcd/qrcodegen/Kconfig
```kconfig
menu "Demos::Media::Lcd::Qrcodegen"
	config QRCODEGEN_TEST
		bool "Enable Qrcodegen Test"
		default n
		help
			Enable qrcodegen demos
endmenu
```

## components/demos/media/lcd/qspi_oled/Kconfig
```kconfig
menu "DEMOS_CONFIG"
	config QSPI_OLED_TEST
		bool "Enable qspi oled demos"
		default n
endmenu
```

## components/demos/media/rott/Kconfig
```kconfig
menu "Demos::Media::rott"
	config HW_ROTT_TEST
		bool "Enable ROTT Test"
		default n

endmenu
```

## components/demos/media/video/Kconfig
```kconfig
menu "Demos::Media::Video"
	config JPEGDEC_SW
		bool "Enable SoftWare Jpeg Decode"
		default n
		help
			Enable jpeg_dec interface

	config JPEGDEC_LIBJPEG
		bool "Enable libjpeg"
		default n

	config SPIDMA
		bool "Enable Spi Dma"
		default n

endmenu
```

## components/demos/net/iperf/Kconfig
```kconfig
menu "Demos::Net::Iperf"
	config DEMOS_IPERF
		depends on WIFI_ENABLE
		bool "Enable Demos Iperf"
		default y
		help
			enable iperf demos
endmenu
```

## components/demos/os/Kconfig
```kconfig
menu "Demos::Os"
	config OS_THREAD_DEMO
		bool "Enable Os Thread Demo"
		default n

	config OS_QUEUE_DEMO
		bool "Enable Os Queue Demo"
		default n

	config OS_SEM_DEMO
		bool "Enable Os Sem Demo"
		default n
		help
			enable os semaphore demos

	config OS_MUTEX_DEMO
		bool "Enable Os Mutex Demo"
		default n

	config OS_TIMER_DEMO
		bool "Enable Os Timer Demo"
		default n
endmenu
```

## components/demos/peripheral/touch/Kconfig
```kconfig
menu "Demos::Peripheral::Touch"
	config TOUCH_TEST
		bool "Enable Touch Test"
		default n
		help
			Enable touch demos
endmenu
```

## components/demos/usb/Kconfig
```kconfig
menu "Demos::USB::uvc_ota"

	menu "Modify USB Demo Config"
		depends on USB && HTTP
			config UVC_OTA_DEMO
				bool "Enable Uvc ota demo"
				default n
				help
					Enable uvc ota interface And Requires an HTTP module
	endmenu



endmenu
```

## components/easy_flash/Kconfig
```kconfig
menu "Easy_flash"
	config EASY_FLASH
		depends on FLASH
		bool "Enable Easy Flash"
		default n

	menu "Modify Easy Flash Config"
		depends on EASY_FLASH

		config EF_START_ADDR
			hex "Set EF Start Addr"
			range 0x0 0xFFFFFFFF
			default 0xFFFFFFFF
			help
				Easy_flash indicates the start address

		choice EASY_FLASH_VER
			prompt "Select Easy Flash Version"
			default EASY_FLASH_V4

			config EASY_FLASH_V4
				bool "EASY_FLASH_V4"
				help
					EASY_FLASH v4.1.0
			config EASY_FLASH_V3
				bool "EASY_FLASH_V3"
				help
					EASY_FLASH v3.0.4
		endchoice
	endmenu
endmenu
```

## components/flashdb/Kconfig
```kconfig
menu "flashdb"
	config FLASHDB
		bool "Enable flashdb"
		default n

	config FLASHDB_USING_KVDB
		depends on FLASHDB
		bool "Enable use kvdb of flashdb"
		default n
		
	config FLASHDB_KVDB_START_ADDR
		depends on FLASHDB_USING_KVDB
		hex "config the addr offset in flash of kvdb"
		range 0x0 0xFFFFFFFF
	    default 0xFFFFFFFF
		
	config FLASHDB_KVDB_SIZE
		depends on FLASHDB_USING_KVDB
		hex "config the size in flash of kvdb"
		range 0x0 0xFFFFFFFF
	    default 0xFFFFFFFF
				
	config FLASHDB_USING_TSDB
		depends on FLASHDB
		bool "Enable use tsdb of flashdb"
		default n
		
	config FLASHDB_TSDB_START_ADDR
		depends on FLASHDB_USING_TSDB
		hex "config the addr offset in flash of tsdb"
		range 0x0 0xFFFFFFFF
	    default 0xFFFFFFFF
		
	config FLASHDB_TSDB_SIZE
		depends on FLASHDB_USING_TSDB
		hex "config the size in flash of tsdb"
		range 0x0 0xFFFFFFFF
	    default 0xFFFFFFFF
		
	config FLASHDB_DEMO
		depends on FLASHDB
		bool "test case for flashdb"
		default n
endmenu
```

## components/http/Kconfig
```kconfig
menu "Http"
	config HTTP
		depends on WIFI_ENABLE
		bool "Enable Http"
		default y

	config HTTP_OTA_WITH_BLE
		bool "Enable Http Ota With Ble"
		default n

	config LITE_LOG_ENABLED
		bool "Enable Lite Log Enable"
		default n
		help
			Enable http log
		
endmenu
```

## components/jrtplib/Kconfig
```kconfig
menu "RTP"
        config RTP
                bool "Enable BK RTP"
                default n
endmenu
```

## components/key_handle/Kconfig
```kconfig
menu "Key_Handle"
	config COMPONENTS_TX_BUFING
		bool "Enable Components Tx Bufing"
		default n
endmenu
```

## components/littlefs/Kconfig
```kconfig
menu "Littlefs"
	config LITTLEFS
		depends on FATFS
		bool "Enable Littlefs"
		default n
endmenu
```

## components/lvgl_source/Kconfig
```kconfig
menu "Lvgl_source"
	config LVGL
		bool "Enable Lvgl"
		default n

	config LV_COLOR_DEPTH
		int "Set Lv Color Depth"
		default 16
		help
			1 - 1 byte per pixel
			8 - RGB332
			16 - RGB565
			32 - ARGB888

	config LV_COLOR_SCREEN_TRANSP
		bool "Enable Lv Color Screen Transp"
		default n
		help
			Enable features to draw on transparent background

	config LV_FONT_MONTSERRAT_8
		bool "Enable Lv Font Montserrat 8"
		default n

	config LV_FONT_MONTSERRAT_16
		bool "Enable Lv Font Montserrat 16"
		default n

	config LV_FONT_MONTSERRAT_12
		bool "Enable Lv Font Montserrat 12"
		default n

	config LV_FONT_MONTSERRAT_14
		bool "Enable Lv Font Montserrat 14"
		default n

	config LV_FONT_MONTSERRAT_18
		bool "Enable Lv Font Montserrat 18"
		default n

	config LV_FONT_MONTSERRAT_20
		bool "Enable Lv Font Montserrat 20"
		default n

	config LV_FONT_MONTSERRAT_22
		bool "Enable Lv Font Montserrat 22"
		default n

	config LV_FONT_MONTSERRAT_24
		bool "Enable Lv Font Montserrat 24"
		default n

	config LV_FONT_MONTSERRAT_26
		bool "Enable Lv Font Montserrat 26"
		default n

	config LV_FONT_MONTSERRAT_28
		bool "Enable Lv Font Montserrat 28"
		default n

	config LV_FONT_MONTSERRAT_30
		bool "Enable Lv Font Montserrat 30"
		default n

	config LV_FONT_MONTSERRAT_32
		bool "Enable Lv Font Montserrat 32"
		default n

	config LV_FONT_MONTSERRAT_34
		bool "Enable Lv Font Montserrat 34"
		default n

	config LV_FONT_MONTSERRAT_36
		bool "Enable Lv Font Montserrat 36"
		default n

	config LV_FONT_MONTSERRAT_38
		bool "Enable Lv Font Montserrat 38"
		default n

	config LV_FONT_MONTSERRAT_40
		bool "Enable Lv Font Montserrat 40"
		default n

	config LV_FONT_MONTSERRAT_42
		bool "Enable Lv Font Montserrat 42"
		default n

	config LV_FONT_MONTSERRAT_44
		bool "Enable Lv Font Montserrat 44"
		default n

	config LV_FONT_MONTSERRAT_46
		bool "Enable Lv Font Montserrat 46"
		default n

	config LV_FONT_MONTSERRAT_48
		bool "Enable Lv Font Montserrat 48"
		default n

	config LV_USE_PERF_MONITOR
		bool "Enable Lv Use Perf Monitor"
		default n
		help
			Show CPU usage and FPS count

	config LVGL_USE_PSRAM
		bool "Enable Lvgl Use Psram"
		default n
		help
			Enable PSRAM draw buffer

	config LVGL_USE_DIRECT_MODE
		bool "Enable Lvgl Use Direct Mode"
		default n
		help
			Enable use direct mode in LVGL use psram draw buffer

	config LV_ATTRIBUTE_FAST_MEM
		bool "Enable Lv Attribute Fast Mem"
		default n

    config LVGL_TASK_PRIORITY
        int "lvgl internal task priority"
        default 4
        help
            lvgl internal task priority

    config LVGL_TASK_DELAY
        int "lvgl internal task delay(ms) per loop"
        default 5
        help
            lvgl internal task delay(ms) per loop
endmenu
```
