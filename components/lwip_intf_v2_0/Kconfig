## components/lwip_intf_v2_0/Kconfig
```kconfig
#TODO add depens for CONFIG_HOST (bk7231u)
menu "Lwip_intf_v2_0"

	config COMPONENTS_MOBILE_CONNECT_SAP_STATISTICS
		bool "Enable Components Mobile Connect Sap Statistics"
		default n
		help
			Statistics mobile connect sap time

	config LWIP
		bool "Enable Lwip"
		default y

	menu "Modify Lwip Config"
		depends on LWIP

		config DHCP
			bool "Enable DHCP"
			default y

		config AUTOIP
			bool "Enable AUTOIP"
			default n

		config MDNS
			bool "Enable MDNS"
			default n

		config TASK_LWIP_PRIO
			int "Set Task Lwip Prio"
			range 1 10
			default 4
			help
				Priority of LwIP task

		#TODO optimize it
		choice LWIP_MEM
			prompt "Select Lwip Mem Policy"
			default LWIP_MEM_DEFAULT

			config LWIP_MEM_DEFAULT
				bool "LWIP_MEM_DEFAULT"
				help
					Default Memory Policy
			config LWIP_MEM_REDUCE
				bool "LWIP_MEM_REDUCE"
				help
					Reduced Memory Policy
		endchoice
	endmenu

endmenu
```

## components/lwip_intf_v2_1/Kconfig
```kconfig
#TODO add depens for CONFIG_HOST (bk7231u)
menu "Lwip_intf_v2_1"

	config IPV6
		bool "Enable IPV6"
		default n

	config WIFI_FAST_DHCP
		bool "Enable Wifi Fast Dhcp"
		default n
		help
			Enable Fast DHCP(use previous IP)

	config MQTT_ACK_NOW
		bool "Enable Mqtt Ack Now"
		default y
		help
			Enable ACK_NOW if MQTT is open

	config LWIP
		depends on WIFI_ENABLE
		bool "Enable LWIP"
		default y

	menu "Modify Lwip Config"
		depends on LWIP

		config DHCP
			depends on WIFI_ENABLE
			bool "Enable DHCP"
			default y
		
		config AUTOIP
			bool "Enable AUTOIP"
			default n

		config MDNS
			bool "Enable MDNS"
			default n

		config TASK_LWIP_PRIO
			depends on WIFI_ENABLE
			int "Set Task Lwip Prio"
			range 1 10
			default 4
			help
				Priority of LwIP task

		config MIDEA
			bool "Enable MIDEA"
			default n

		#TODO optimize it
		choice LWIP_MEM
			prompt "Select Lwip Mem Policy"
			default LWIP_MEM_DEFAULT

			config LWIP_MEM_DEFAULT
				bool "LWIP_MEM_DEFAULT"
				help
					Default Memory Policy
			config LWIP_MEM_REDUCE
				depends on WIFI_ENABLE
				bool "LWIP_MEM_REDUCE"
				help
					Reduced Memory Policy
		endchoice
	endmenu

endmenu
```

## components/mbedtls/Kconfig
```kconfig
#TODO add depens for CONFIG_HOST (bk7231u)
menu "Mbedtls"
	config MBEDTLS
		bool "Enable Mbedtls"
		default n
endmenu
```

## components/media/Kconfig
```kconfig
menu "Media"

	config MEDIA
		depends on CAMERA || USB_UVC || LCD
		bool "Enable Media"
		default n
		help
			Enable media service
	config WIFI_TRANSFER
		depends on MEDIA
		bool "Enable Wifi Transfer"
		default n
	config LVGL
		depends on LCD
		bool "Enable Lvgl"
		default n
	config LCD_FLASH_JPEG_DISPLAY
		depends on LCD
		bool "Enable Lcd Flash Jpeg Display"
		default n
		help
			enable lcd display flash img
	config LCD_DMA2D_BLEND_FLASH_IMG
		depends on DMA2D
		bool "Enable Lcd Dma2d Blend Flash Img"
		default n
		help
			enable lcd dma2d blend flash logo
	config BLEND_USE_GUI
		depends on LCD
		bool "Enable Blend Use Gui"
		default n
		help
			enable lcd dma2d blend from gui
	config BLEND_GUI_OUTPUT_888
		depends on LCD
		bool "Enable Blend Gui Output 888"
		default n
		help
			enable lcd dma2d blend from gui, gui data is rgb888
	config LCD_FONT_BLEND
		depends on LCD
		bool "Enable Lcd Font Blend"
		default n
		help
			enable lcd blend by font logo
	config IMAGE_STORAGE
		depends on MEDIA
		bool "enable image storage function"
		default n
		help
			enable image save and read image
	config JPEG_YUV_MIX
		depends on CAMERA
		bool "enable jpeg module for jpeg and yuv mix mode"
		default n
		help
			enable jpeg work method: encode and yuv by turns

endmenu
```

## components/micropython/Kconfig
```kconfig
#TODO add depens for CONFIG_MBEDTLS
menu "MICROPYTHON CONFIG"
	config MICROPYTHON
		bool "Enable MICROPYTHON"
		default n
endmenu
```

## components/openssl/Kconfig
```kconfig
menu "Openssl"
	config OPENSSL
		bool "Enable OPENSSL"
		default n

    config OPENSSL_ERROR_STACK
        bool "Enable OpenSSL Error Stack"
        default y
        help
            Enable OpenSSL Error reporting

    config OPENSSL_DEBUG
        bool "Enable OpenSSL Debug"
        default n
        help
            Enable OpenSSL debugging function.
            If the option is enabled, "SSL_DEBUG" works.

    config OPENSSL_DEBUG_LEVEL
        int "Set OpenSSL Debug Level"
        default 0
        range 0 255
        depends on OPENSSL_DEBUG
        help
            OpenSSL debugging level.
            Only function whose debugging level is higher than "OPENSSL_DEBUG_LEVEL" works.
            For example:
            If OPENSSL_DEBUG_LEVEL = 2, you use function "SSL_DEBUG(1, "malloc failed")". Because 1 < 2, it will not
            print.

    config OPENSSL_LOWLEVEL_DEBUG
        bool "Enable OpenSSL Lowlevel Debug"
        default n
        depends on OPENSSL_DEBUG
        select MBEDTLS_DEBUG
        help
            If the option is enabled, low-level module debugging function of OpenSSL is enabled, e.g. mbedtls internal
            debugging function.

    choice OPENSSL_ASSERT
        prompt "Select OpenSSL Assert Function"
        default OPENSSL_ASSERT_EXIT
        help
            OpenSSL function needs "assert" function to check if input parameters are valid.
            If you want to use assert debugging function, "OPENSSL_DEBUG" should be enabled.

        config OPENSSL_ASSERT_DO_NOTHING
            bool "OPENSSL_ASSERT_DO_NOTHING"
            help
                Do nothing and "SSL_ASSERT" does not work.

        config OPENSSL_ASSERT_EXIT
            bool "OPENSSL_ASSERT_EXIT"
            help
                Enable assert exiting, it will check and return error code.

        config OPENSSL_ASSERT_DEBUG
            bool "OPENSSL_ASSERT_DEBUG"
            depends on OPENSSL_DEBUG
            help
                Enable assert debugging, it will check and show debugging message.

        config OPENSSL_ASSERT_DEBUG_EXIT
            bool "OPENSSL_ASSERT_DEBUG_EXIT"
            depends on OPENSSL_DEBUG
            help
                Enable assert debugging and exiting, it will check, show debugging message and return error code.

        config OPENSSL_ASSERT_DEBUG_BLOCK
            bool "OPENSSL_ASSERT_DEBUG_BLOCK"
            depends on OPENSSL_DEBUG
            help
                Enable assert debugging and blocking, it will check, show debugging message and block by "while (1);".

    endchoice

endmenu
```

## components/ota/Kconfig
```kconfig
menu "Ota"
	config HTTP_AB_PARTITION
		bool "Enable Http AB Partition"
		default n
		help
			enable http update ab partition
	config OTA_UPDATE_DEFAULT_PARTITION
		bool "Enable Ota Update Default Partition"
		default n
		help
			enable ota update default partition
	config OTA_UPDATE_B_PARTITION
		bool "Enable Ota Update B Partition"
		default n
		help
			enable ota update b partition
endmenu
```

## components/part_table/Kconfig
```kconfig
menu "Part_table"
	config FLASH_PARTITION_USER
		depends on OVERRIDE_FLASH_PARTITION
		bool "Enable flash partition user"
		default y
endmenu
```

## components/pm/Kconfig
```kconfig
menu "Pm"
	config PM
		bool "Enable Pm"
		default n
		help
			Enable Power Management

	menu "Modify PM Config"
		depends on PM

		config PM_DEFAULT_POLICY
			bool "Enable PM Default Policy"
			default y

		config PM_NS
			depends on PM_DEFAULT_POLICY
			bool "Enable PM Normal Sleep"
			default y
			help
				Enable PM Normal Sleep

		config PM_LV
			depends on PM_DEFAULT_POLICY
			bool "Enable PM Low Voltage Sleep"
			default y
			help
				Enable PM Low Voltage Sleep

		config PM_DS
			depends on PM_DEFAULT_POLICY
			bool "Enable PM Deep Sleep"
			default y
			help
				Enable PM Deep Sleep

		config PM_NS_LATENCY
			depends on PM_DEFAULT_POLICY
			int "config PM normal sleep latency"
			default 0
			help
				Config PM normal sleep latency, in unit of us

		config PM_NS_RESIDENCY
			depends on PM_DEFAULT_POLICY
			int "config PM normal sleep minimum residency"
			default 2000
			help
				Config PM normal sleep minimum residency, in unit of us
		config PM_LV_LATENCY
			depends on PM_DEFAULT_POLICY
			int "config PM low voltage sleep latency"
			default 0
			help
				Config PM low voltage latency, in unit of us

		config PM_LV_RESIDENCY
			depends on PM_DEFAULT_POLICY
			int "config PM low voltage sleep minimum residency"
			default 4000
			help
				Config PM low voltage sleep minimum residency, in unit of us
		config PM_DS_LATENCY
			depends on PM_DEFAULT_POLICY
			int "config PM deep sleep latency"
			default 0
			help
				Config PM deep sleep latency, in unit of us

		config PM_DS_RESIDENCY
			depends on PM_DEFAULT_POLICY
			int "config PM low voltage sleep minimum residency"
			default 50000000
			help
				Config PM deep sleep minimum residency, in unit of us

		config PM_DEPEND
			bool "Enable PM Dependency"
			default y
			help
				Enable PM Dependency

		config PM_DEPEND_HANDLE_MAX
			depends on PM_DEPEND
			int "Set PM Depend Handle Max"
			default 128
			help
				Set maximum dependency handle

		config PM_DEBUG
			bool "Enable PM Stats"
			default n
			help
				Enable PM debug

		config PM_STATS
			depends on PM_DEBUG
			bool "Enable PM Stats"
			default y
			help
				Enable PM statistics

		config PM_DEVICE_STATS
			depends on PM_DEBUG
			bool "Enable PM Device Stats"
			default y
			help
				Enable PM device statistics

		config PM_AUTO_RTC_WAKEUP
			bool "Enable PM Auto Rtc Wakeup"
			default y
			help
				Enable PM device statistics

		config PM_DEVICE
			bool "Enable PM Device"
			default n
			help
				Enable device power management
	endmenu
endmenu
```

## components/saradc_intf/Kconfig
```kconfig
menu "Saradc_intf"
	config SARADC_CALI
		bool "Enable Saradc Cali"
		default n
		help
			Enable SAR ADC Calibration
endmenu
```

## components/temp_detect/Kconfig
```kconfig
menu "Temp_detect"
	config TEMP_DETECT
		bool "Enable Temp Detect"
		default n
		help
			Enable temperature detect
endmenu
```

## components/tfm/Kconfig
```kconfig
menu "Tfm"
	config TFM
		bool "Enable TFM"
		default n

	menu "Modify TFM Info"
		depends on TFM

		config TFM_PROFILE
			string "Define Tfm Profile"
			default "profile_medium"
			help
				psa level:0(profile_small) 1(profile_medium) 2(profile_large)

		config TFM_BUILD_TYPE
			string "Define Tfm Build Type"
			default "debug"
			help
				build type: debug, release or minsizerel

		config TFM_FPGA
			string "Define Tfm FPGA"
			default "ON"
			help
				Enable FPGA: ON/OFF

		config TFM_TEST_S
			string "Define Tfm Test S"
			default "OFF"
			help
				Enable to TFM secure bin test: ON/OFF

		config TFM_TEST_NS
			string "Define Tfm Test NS"
			default "OFF"
			help
				Enable to TFM non-secure bin test: ON/OFF

		config TFM_BL2_LOG_LEVEL
			string "Define Tfm Bl2 Log Level"
			default "DEBUG"
			help
				Set BL2 log level: OFF/ERROR/WARNING/INFO/DEBUG

		config TFM_BL2
			string "Define Tfm Bl2"
			default "OFF"
			help
				Enable BL2: ON/OFF

		config OTP_NV_COUNTERS_RAM_EMULATION
			string "Define Otp Nv Counters Ram Emulation"
			default "ON"
			help
				Enable OTP/NV counter RAM emulation: ON/OFF

		config PLATFORM_DEFAULT_OTP_WRITEABLE
			string "Define Platform Default Otp Writeable"
			default "ON"
			help
				Enable platform default OTP writable: ON/OFF
	endmenu
endmenu
```

## components/tfm_v17/Kconfig
```kconfig
config TFM_V17
	bool "Enable TFM_V17"
	default n

menu "TFM"
	depends on TFM_V17

	config TFM_PROFILE
		string "psa level:0(profile_small) 1(profile_medium) 2(profile_large)"
		default "profile_medium"

	config TFM_BUILD_TYPE
		string "build type: debug, release or minsizerel"
		default "debug"

	config TFM_FPGA
		string "Enable FPGA: ON/OFF"
		default "ON"

	config TFM_TEST_S
		string "Enable to TFM secure bin test: ON/OFF"
		default "OFF"

	config TFM_TEST_NS
		string "Enable to TFM non-secure bin test: ON/OFF"
		default "OFF"

	config TFM_BL2_LOG_LEVEL
		string "Set BL2 log level: OFF/ERROR/WARNING/INFO/DEBUG"
		default "DEBUG"

	config TFM_BL2
		string "Enable BL2"
		default "OFF"

	config OTP_NV_COUNTERS_RAM_EMULATION
		string "Enable OTP/NV counter RAM emulation: ON/OFF"
		default "ON"

	config PLATFORM_DEFAULT_OTP_WRITEABLE
		string "Enable platform default OTP writable: ON/OFF"
		default "ON"
endmenu
```

## components/tfm_v17/tfm/Kconfig
```kconfig
#-------------------------------------------------------------------------------
# Copyright (c) 2022, Arm Limited. All rights reserved.
#
# SPDX-License-Identifier: BSD-3-Clause
#
#-------------------------------------------------------------------------------

# Load platform Kconfig file if exists
osource "$(PLATFORM_PATH)/Kconfig"

################################# SPM ##########################################

menu "SPM"
config TFM_ISOLATION_LEVEL
    int "Isolation level"
    default 1
    range 1 1 if TFM_SPM_BACKEND_SFN
    range 1 3 if PLATFORM_HAS_ISOLATION_L3_SUPPORT
    range 1 2

choice
    prompt "SPM Backend"
    default TFM_SPM_BACKEND_SFN

    config TFM_SPM_BACKEND_SFN
        bool "SFN Backend"

    config TFM_SPM_BACKEND_IPC
        bool "IPC Backend"
endchoice

config CONFIG_TFM_SPM_BACKEND
    string
    default "IPC" if TFM_SPM_BACKEND_IPC
    default "SFN" if TFM_SPM_BACKEND_SFN
    default ""

choice
    prompt "Fault injection hardening profile"

    config TFM_FIH_PROFILE_OFF
        bool "OFF"

    config TFM_FIH_PROFILE_LOW
        bool "Low"

    config TFM_FIH_PROFILE_MEDIUM
        bool "Medium"

    config TFM_FIH_PROFILE_HIGH
        bool "High"
endchoice

config TFM_FIH_PROFILE
    string
    default "OFF" if TFM_FIH_PROFILE_OFF
    default "LOW" if TFM_FIH_PROFILE_LOW
    default "MEDIUM" if TFM_FIH_PROFILE_MEDIUM
    default "HIGH" if TFM_FIH_PROFILE_HIGH

config PSA_FRAMEWORK_HAS_MM_IOVEC
    bool "Enable MM-IOVEC"
    default n
    depends on TFM_ISOLATION_LEVEL = 1
endmenu

################################# Secure partitions ############################

# These are partition switches.
rsource "secure_fw/partitions/Kconfig"

################################# Platforms ####################################

rsource "platform/Kconfig"

################################# TEST #########################################

menu "TF-M tests"
rsource "lib/ext/tf-m-tests/Kconfig"
rsource "lib/ext/psa_arch_tests/Kconfig"
endmenu

################################# Component ####################################

# These configs in this menu are local to a component or externally referenced
# when components are coupled. Usually, such options are located in C header
# file. The Header File Config System has more details about it.

# Other configs above which are not in component menu are TF-M build options to
# select which file or component to include into compilation. These are options,
# usually used by a build system to enable/disable modules, specify location of
# external dependency or other selection, global to a project. These options
# shall be considered while adopting TF-M to other build systems.

menu "TF-M component configs"
rsource "secure_fw/spm/Kconfig"

menu "Secure Partitions component configs"
    rsource "secure_fw/partitions/*/Kconfig"
endmenu
endmenu
```
