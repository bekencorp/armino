## components/tfm_v17/tfm/lib/ext/psa_arch_tests/Kconfig
```kconfig
#-------------------------------------------------------------------------------
# Copyright (c) 2022, Arm Limited. All rights reserved.
#
# SPDX-License-Identifier: BSD-3-Clause
#
#-------------------------------------------------------------------------------

menu "PSA Arch Test"

choice
    prompt "PSA API Test Suite"
    optional

    config TEST_PSA_API_IPC
        bool "IPC"

    config TEST_PSA_API_CRYPTO
        bool "Crypto"
        imply TFM_PARTITION_CRYPTO
        imply TFM_PARTITION_INTERNAL_TRUSTED_STORAGE
        imply TFM_PARTITION_PLATFORM

    config TEST_PSA_API_INITIAL_ATTESTATION
        bool "Initial attestation"
        imply TFM_PARTITION_INITIAL_ATTESTATION
        imply TFM_PARTITION_INTERNAL_TRUSTED_STORAGE
        imply TFM_PARTITION_CRYPTO
        imply TFM_PARTITION_PLATFORM

    config TEST_PSA_API_INTERNAL_TRUSTED_STORAGE
        bool "Internal trusted storage"
        imply TFM_PARTITION_INTERNAL_TRUSTED_STORAGE

    config TEST_PSA_API_PROTECTED_STORAGE
        bool "Protected storage"
        imply TFM_PARTITION_PROTECTED_STORAGE
        imply TFM_PARTITION_INTERNAL_TRUSTED_STORAGE
        imply TFM_PARTITION_CRYPTO
        imply TFM_PARTITION_PLATFORM

    config TEST_PSA_API_STORAGE
        bool "Storage(ITS+PS)"
        imply TFM_PARTITION_PROTECTED_STORAGE
        imply TFM_PARTITION_INTERNAL_TRUSTED_STORAGE
        imply TFM_PARTITION_CRYPTO
        imply TFM_PARTITION_PLATFORM

endchoice

config TEST_PSA_API
    string
    default "IPC" if TEST_PSA_API_IPC
    default "CRYPTO" if TEST_PSA_API_CRYPTO
    default "INITIAL_ATTESTATION" if TEST_PSA_API_INITIAL_ATTESTATION
    default "INTERNAL_TRUSTED_STORAGE" if TEST_PSA_API_INTERNAL_TRUSTED_STORAGE
    default "PROTECTED_STORAGE" if TEST_PSA_API_PROTECTED_STORAGE
    default "STORAGE" if TEST_PSA_API_STORAGE
    default ""

endmenu
```

## components/tfm_v17/tfm/lib/ext/tf-m-tests/Kconfig
```kconfig
#-------------------------------------------------------------------------------
# Copyright (c) 2022, Arm Limited. All rights reserved.
#
# SPDX-License-Identifier: BSD-3-Clause
#
#-------------------------------------------------------------------------------

menu "TF-M regression tests"

config TEST_S
    bool "Enable default secure test cases"
    default n
    imply TEST_S_ATTESTATION
    imply TEST_S_CRYPTO
    imply TEST_S_ITS
    imply TEST_S_PS
    imply TEST_S_PLATFORM
    imply TEST_S_FWU
    imply TEST_S_SFN_BACKEND

config TEST_NS
    bool "Enable default non-secure test cases"
    default n
    imply TEST_NS_ATTESTATION
    imply TEST_NS_T_COSE
    imply TEST_NS_QCBOR
    imply TEST_NS_CRYPTO
    imply TEST_NS_PS
    imply TEST_NS_ITS
    imply TEST_NS_PLATFORM
    imply TEST_NS_FWU
    imply TEST_NS_MULTI_CORE
    imply TEST_NS_MANAGE_NSID
    imply TEST_NS_IPC
    imply TEST_NS_SFN_BACKEND

################################# Secure test ##################################

menu "Secure regression tests"

config TEST_S_ATTESTATION
    bool "Attestation"
    default n
    imply TFM_PARTITION_INITIAL_ATTESTATION
    imply TFM_PARTITION_INTERNAL_TRUSTED_STORAGE
    imply TFM_PARTITION_CRYPTO

config TEST_S_CRYPTO
    bool "Crypto"
    default n
    imply TFM_PARTITION_CRYPTO
    imply TFM_PARTITION_INTERNAL_TRUSTED_STORAGE

config TEST_S_ITS
    bool "ITS"
    default n
    imply TFM_PARTITION_INTERNAL_TRUSTED_STORAGE

config TEST_S_PS
    bool "PS"
    default n
    imply TFM_PARTITION_PROTECTED_STORAGE
    imply TFM_PARTITION_INTERNAL_TRUSTED_STORAGE
    imply TFM_PARTITION_CRYPTO
    imply TFM_PARTITION_PLATFORM

config TEST_S_PLATFORM
    bool "Platform"
    default n
    imply TFM_PARTITION_PLATFORM

config TEST_S_FWU
    bool "FWU"
    depends on PLATFORM_HAS_FIRMWARE_UPDATE_SUPPORT
    imply TFM_PARTITION_FIRMWARE_UPDATE
    imply TFM_PARTITION_CRYPTO
    imply TFM_PARTITION_INTERNAL_TRUSTED_STORAGE
    imply TFM_PARTITION_PLATFORM

config TEST_S_IPC
    bool "IPC"
    depends on TFM_SPM_BACKEND_IPC

config TEST_S_SFN_BACKEND
    bool "SFN backend"
    depends on TFM_SPM_BACKEND_SFN

config TEST_S_FPU
    bool "FPU"
    default n
endmenu

################################# Non-secure test ##############################

menu "Non-Secure regression tests"

config TEST_NS_ATTESTATION
    bool "Attestation"
    default n
    imply TFM_PARTITION_INITIAL_ATTESTATION
    imply TFM_PARTITION_INTERNAL_TRUSTED_STORAGE
    imply TFM_PARTITION_CRYPTO

config TEST_NS_T_COSE
    bool "t_cose"
    default n
    imply TFM_PARTITION_INITIAL_ATTESTATION
    imply TFM_PARTITION_INTERNAL_TRUSTED_STORAGE
    imply TFM_PARTITION_CRYPTO

config TEST_NS_QCBOR
    bool "QCBOR"
    default n
    imply TFM_PARTITION_INITIAL_ATTESTATION
    imply TFM_PARTITION_INTERNAL_TRUSTED_STORAGE
    imply TFM_PARTITION_CRYPTO

config TEST_NS_CRYPTO
    bool "Crypto"
    default n
    imply TFM_PARTITION_CRYPTO
    imply TFM_PARTITION_INTERNAL_TRUSTED_STORAGE

config TEST_NS_PS
    bool "PS"
    default n
    imply TFM_PARTITION_PROTECTED_STORAGE
    imply TFM_PARTITION_INTERNAL_TRUSTED_STORAGE
    imply TFM_PARTITION_CRYPTO
    imply TFM_PARTITION_PLATFORM
    imply TEST_NS_ITS

config TEST_NS_ITS
    bool "ITS"
    default n
    imply TFM_PARTITION_INTERNAL_TRUSTED_STORAGE

config TEST_NS_PLATFORM
    bool "Platform"
    default n
    imply TFM_PARTITION_PLATFORM

config TEST_NS_FWU
    bool "FWU"
    depends on PLATFORM_HAS_FIRMWARE_UPDATE_SUPPORT
    imply TFM_PARTITION_FIRMWARE_UPDATE
    imply TFM_PARTITION_CRYPTO
    imply TFM_PARTITION_INTERNAL_TRUSTED_STORAGE
    imply TFM_PARTITION_PLATFORM

config TEST_NS_MULTI_CORE
    bool "Multi-core"
    depends on TFM_MULTI_CORE_TOPOLOGY

config TEST_NS_MANAGE_NSID
    bool "NSID management"

choice TEST_NS_IRQ
    prompt "IRQ test type"
    optional

    config TEST_NS_FLIH_IRQ
        bool "First-Level Interrupt Handling"

    config TEST_NS_SLIH_IRQ
        bool "Second-Level Interrupt Handling"

endchoice

config TEST_NS_FPU
    bool "FPU"
    default n

config TEST_NS_IPC
    bool "IPC"
    depends on TFM_SPM_BACKEND_IPC

config TEST_NS_SFN_BACKEND
    bool "SFN backend"
    depends on TFM_SPM_BACKEND_SFN

endmenu

################################# Crypto tests #################################

if TEST_NS_CRYPTO || TEST_S_CRYPTO

menu "Crypto Test Configs"

config TFM_CRYPTO_TEST_ALG_CBC
    bool "Test CBC cryptography mode"
    default y

config TFM_CRYPTO_TEST_ALG_CCM
    bool "Test CCM cryptography mode"
    default y

config TFM_CRYPTO_TEST_ALG_CFB
    bool "Test CFB cryptography mode"
    default y

config TFM_CRYPTO_TEST_ALG_ECB
    bool "Test ECB cryptography mode"
    default y

config TFM_CRYPTO_TEST_ALG_CTR
    bool "Test CTR cryptography mode"
    default y

config TFM_CRYPTO_TEST_ALG_OFB
    bool "Test OFB cryptography mode"
    default y

config TFM_CRYPTO_TEST_ALG_GCM
    bool "Test GCM cryptography mode"
    default y

config TFM_CRYPTO_TEST_ALG_SHA_384
    bool "Test SHA-384 cryptography algorithm"
    default y

config TFM_CRYPTO_TEST_ALG_SHA_512
    bool "Test SHA-512 cryptography algorithm"
    default y

config TFM_CRYPTO_TEST_HKDF
    bool "Test the HKDF key derivation algorithm"
    default y

config TFM_CRYPTO_TEST_ECDH
    bool "Test the ECDH key agreement algorithm"
    default y

config TFM_CRYPTO_TEST_CHACHA20
    bool "Test the ChaCha20 stream cipher"
    default n

config TFM_CRYPTO_TEST_ALG_CHACHA20_POLY1305
    bool "Test ChaCha20-Poly1305 AEAD algorithm"
    default n

config TFM_CRYPTO_TEST_SINGLE_PART_FUNCS
    bool "Test single-part operations in hash, MAC, AEAD and symmetric ciphers"
    default y

endmenu
endif
endmenu
```

## components/tfm_v17/tfm/platform/Kconfig
```kconfig
#-------------------------------------------------------------------------------
# Copyright (c) 2022, Arm Limited. All rights reserved.
#
# SPDX-License-Identifier: BSD-3-Clause
#
#-------------------------------------------------------------------------------

menu "Platform options"

config PLATFORM_DEFAULT_BL1
    bool "Use default BL1"
    default y

config PLATFORM_DEFAULT_ATTEST_HAL
    bool "Use default attest hal implementation"
    default y

config PLATFORM_DEFAULT_NV_COUNTERS
    bool "Use default nv counter implementation"
    default y
    depends on PLATFORM_DEFAULT_OTP_WRITEABLE

config PLATFORM_DEFAULT_CRYPTO_KEYS
    bool "Use default crypto keys implementation"
    default y

config PLATFORM_DEFAULT_ROTPK
    bool "Use default root of trust public key"
    default y

config PLATFORM_DEFAULT_IAK
    bool "Use default initial attestation_key"
    default y

config PLATFORM_DEFAULT_UART_STDOUT
    bool "Use default uart stdout implementation"
    default y

config PLATFORM_DEFAULT_NV_SEED
    bool "Use default NV seed implementation"
    default y

config PLATFORM_DEFAULT_OTP
    bool "Use trusted on-chip flash to implement OTP memory"
    default y

config PLATFORM_DEFAULT_OTP_WRITEABLE
    bool "Use OTP memory with write support"
    default y

config PLATFORM_DEFAULT_PROVISIONING
    bool "Use default provisioning implementation"
    default y

config PLATFORM_DEFAULT_SYSTEM_RESET_HALT
    bool "Use default system reset/halt implementation"
    default y

config PLATFORM_HAS_FIRMWARE_UPDATE_SUPPORT
    bool
    default n
endmenu
```

## components/tfm_v17/tfm/secure_fw/partitions/Kconfig
```kconfig
#-------------------------------------------------------------------------------
# Copyright (c) 2022, Arm Limited. All rights reserved.
#
# SPDX-License-Identifier: BSD-3-Clause
#
#-------------------------------------------------------------------------------

menu "Secure partitions"

################################# Crypto #######################################

comment "Crypto depends on ITS"
    depends on !TFM_PARTITION_INTERNAL_TRUSTED_STORAGE

config TFM_PARTITION_CRYPTO
    bool "Crypto"
    depends on TFM_PARTITION_INTERNAL_TRUSTED_STORAGE

################################# Attestation ##################################

comment "Initial attestation depends on Crypto"
    depends on !TFM_PARTITION_CRYPTO

config TFM_PARTITION_INITIAL_ATTESTATION
    bool "Initial attestation"
    depends on TFM_PARTITION_CRYPTO

################################# ITS ##########################################

config TFM_PARTITION_INTERNAL_TRUSTED_STORAGE
    bool "Internal Trusted Storage"
    default n

################################# Platform #####################################

config TFM_PARTITION_PLATFORM
    bool "Platform"
    default n

################################# FWU ##########################################

comment "Firmware update depends on Crypto and Platform, and FWU support"
    depends on !(TFM_PARTITION_PLATFORM && TFM_PARTITION_CRYPTO && PLATFORM_HAS_FIRMWARE_UPDATE_SUPPORT)

config TFM_PARTITION_FIRMWARE_UPDATE
    bool "Firmware update"
    depends on TFM_PARTITION_PLATFORM && TFM_PARTITION_CRYPTO && PLATFORM_HAS_FIRMWARE_UPDATE_SUPPORT

################################# PS ###########################################

comment "Protected Storage depends on Crypto, ITS and Platform"
    depends on !(TFM_PARTITION_INTERNAL_TRUSTED_STORAGE && TFM_PARTITION_PLATFORM && TFM_PARTITION_CRYPTO)

config TFM_PARTITION_PROTECTED_STORAGE
    bool "Protected Storage"
    depends on TFM_PARTITION_INTERNAL_TRUSTED_STORAGE && TFM_PARTITION_PLATFORM && TFM_PARTITION_CRYPTO
endmenu
```

## components/tfm_v17/tfm/secure_fw/partitions/crypto/Kconfig
```kconfig
#-------------------------------------------------------------------------------
# Copyright (c) 2022, Arm Limited. All rights reserved.
#
# SPDX-License-Identifier: BSD-3-Clause
#
#-------------------------------------------------------------------------------

menu "Crypto component configs"
    depends on TFM_PARTITION_CRYPTO

config CRYPTO_ENGINE_BUF_SIZE
    hex "Heap size for the crypto backend"
    default 0x2080
    help
      CRYPTO_ENGINE_BUF_SIZE needs to be >8KB for EC signing by attest
      module.

config CRYPTO_CONC_OPER_NUM
    int "Max number of concurrent operations"
    default 8
    help
      The max number of concurrent operations that can be active (allocated)
      at any time in Crypto

config CRYPTO_RNG_MODULE_ENABLED
    bool "Enable PSA Crypto random number generator module"
    default y

config CRYPTO_KEY_MODULE_ENABLED
    bool "Enable PSA Crypto Key module"
    default y

config CRYPTO_AEAD_MODULE_ENABLED
    bool "Enable PSA Crypto AEAD module"
    default y

config CRYPTO_MAC_MODULE_ENABLED
    bool "Enable PSA Crypto MAC module"
    default y

config CRYPTO_HASH_MODULE_ENABLED
    bool "Enable PSA Crypto Hash module"
    default y

config CRYPTO_CIPHER_MODULE_ENABLED
    bool "Enable PSA Crypto Cipher module"
    default y

config CRYPTO_ASYM_SIGN_MODULE_ENABLED
    bool "Enable PSA Crypto asymmetric key signature module"
    default y

config CRYPTO_ASYM_ENCRYPT_MODULE_ENABLED
    bool "Enable PSA Crypto asymmetric key encryption module"
    default y

config CRYPTO_KEY_DERIVATION_MODULE_ENABLED
    bool "Enable PSA Crypto key derivation module"
    default y

config CRYPTO_IOVEC_BUFFER_SIZE
    int "Default size of the internal scratch buffer"
    default 5120
    help
      Default size of the internal scratch buffer used for PSA FF IOVec
      allocations

config CRYPTO_NV_SEED
    bool "Use stored NV seed to provide entropy"
    default y

config CRYPTO_SINGLE_PART_FUNCS_DISABLED
    bool "Only enable multi-part operations"
    default n
    help
      Only enable multi-part operations in Hash, MAC, AEAD and symmetric
      ciphers, to optimize memory footprint in resource-constrained devices

config CRYPTO_STACK_SIZE
    hex "Stack size"
    default 0x1B00

endmenu
```

## components/tfm_v17/tfm/secure_fw/partitions/firmware_update/Kconfig
```kconfig
#-------------------------------------------------------------------------------
# Copyright (c) 2022, Arm Limited. All rights reserved.
#
# SPDX-License-Identifier: BSD-3-Clause
#
#-------------------------------------------------------------------------------

menu "FWU component configs"
    depends on TFM_PARTITION_FIRMWARE_UPDATE

config PSA_FWU_MAX_BLOCK_SIZE
    int "Maximum permitted block size(bytes)"
    default 1024
    help
      The maximum permitted size for block in psa_fwu_write, in bytes.

config TFM_FWU_BUF_SIZE
    int "Size of the FWU internal data transfer buffer"
    default PSA_FWU_MAX_BLOCK_SIZE
    help
      Size of the FWU internal data transfer buffer
      (defaults to PSA_FWU_MAX_BLOCK_SIZE if not set)

config FWU_STACK_SIZE
    hex "Stack size"
    default 0x600

endmenu
```

## components/tfm_v17/tfm/secure_fw/partitions/initial_attestation/Kconfig
```kconfig
#-------------------------------------------------------------------------------
# Copyright (c) 2022, Arm Limited. All rights reserved.
#
# SPDX-License-Identifier: BSD-3-Clause
#
#-------------------------------------------------------------------------------

menu "Attestation component configs"
    depends on TFM_PARTITION_INITIAL_ATTESTATION

config ATTEST_INCLUDE_OPTIONAL_CLAIMS
    bool "Include optional claims in initial attestation token"
    default y

config ATTEST_INCLUDE_COSE_KEY_ID
    bool "Include COSE key-id in initial attestation token"
    default n

choice
    prompt "Set the initial attestation token profile"
    config ATTEST_TOKEN_PROFILE_PSA_IOT_1
        bool "PSA_IOT_1"
    config ATTEST_TOKEN_PROFILE_PSA_2_0_0
        bool "PSA_2_0_0"
    config ATTEST_TOKEN_PROFILE_ARM_CCA
        bool "ARM_CCA"
endchoice

config ATTEST_TOKEN_PROFILE
    string
    default "PSA_IOT_1" if ATTEST_TOKEN_PROFILE_PSA_IOT_1
    default "PSA_2_0_0" if ATTEST_TOKEN_PROFILE_PSA_2_0_0
    default "ARM_CCA" if ATTEST_TOKEN_PROFILE_ARM_CCA

config ATTEST_STACK_SIZE
    hex "Stack size"
    default 0x700

endmenu
```
