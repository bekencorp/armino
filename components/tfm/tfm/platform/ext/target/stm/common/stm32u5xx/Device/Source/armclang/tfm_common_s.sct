/*
 * Copyright (c) 2017-2022 Arm Limited. All rights reserved.
 *
 * Licensed under the Apache License, Version 2.0 (the "License");
 * you may not use this file except in compliance with the License.
 * You may obtain a copy of the License at
 *
 *     http://www.apache.org/licenses/LICENSE-2.0
 *
 * Unless required by applicable law or agreed to in writing, software
 * distributed under the License is distributed on an "AS IS" BASIS,
 * WITHOUT WARRANTIES OR CONDITIONS OF ANY KIND, either express or implied.
 * See the License for the specific language governing permissions and
 * limitations under the License.
 */

#include "region_defs.h"

LR_CODE S_CODE_START S_CODE_SIZE {

    /****  This initial section contains common code for secure binary */
    ER_TFM_CODE S_CODE_START {
        *.o (RESET +First)
        *libplatform_s* (.text*, .rodata*)
        *libtfm_spm* (+RO)
    }

    /**** Section for holding partition RO load data */
    TFM_SP_LOAD_LIST +0 ALIGN 4 {
        *(.part_load)
    }

    /**** PSA RoT RO part (CODE + RODATA) start here */
    /*
     * This empty, zero long execution region is here to mark the start address
     * of PSA RoT code.
     */
    TFM_PSA_CODE_START +0 ALIGN 32 EMPTY 0x0 {
    }

    TFM_PSA_ROT_LINKER +0 ALIGN 32 {
        *tfm_psa_rot_partition* (+RO-CODE, +RO-DATA)
        *libplatform_s* (TFM_*_PSA-ROT_ATTR_FN)
        *.o (TFM_*_PSA-ROT_ATTR_FN)
    }

    /*
     * This empty, zero long execution region is here to mark the end address
     * of PSA RoT code.
     */
    TFM_PSA_CODE_END +0 ALIGN 32 EMPTY 0x0 {
    }
    /**** Unprivileged Secure code start here */
    TFM_UNPRIV_CODE  AlignExpr(+0, GTZC_FLASH_ALIGN) FIXED {
        *(SFN)
        * (+RO)
    }
    /**** APPLICATION RoT RO part (CODE + RODATA) start here */
    /*
     * This empty, zero long execution region is here to mark the start address
     * of APP RoT code.
     */
    TFM_APP_CODE_START +0 ALIGN 32 EMPTY 0x0 {
    }

    TFM_APP_ROT_LINKER +0 ALIGN 32 {
        *tfm_app_rot_partition* (+RO-CODE, +RO-DATA)
        *libplatform_s* (TFM_*_APP-ROT_ATTR_FN)
        *.o (TFM_*_APP-ROT_ATTR_FN)
    }

    /*
     * This empty, zero long execution region is here to mark the end address
     * of APP RoT code.
     */
    TFM_APP_CODE_END +0 ALIGN 32 EMPTY 0x0 {
    }

    /**** Base address of secure data area */
    TFM_SECURE_DATA_START S_DATA_START {
    }
    /*
     * This empty, zero long execution region is here to mark the start address
     * of unpriv data.
     */
    TFM_APP_RW_STACK_START +0 ALIGN GTZC_RAM_ALIGN EMPTY 0x0 {
    }

# if !defined(TFM_PSA_API)
    /* PSP is unprivileged in single-core topology. Reserve 8 bytes for seal */
    ER_INITIAL_PSP +0 ALIGN 32 EMPTY S_PSP_STACK_SIZE - 0x8 {
    }

    ER_INITIAL_PSP_SEAL +0 EMPTY 0x8 {
    }
# endif /* !defined(TFM_PSA_API) */


#if !defined(TFM_PSA_API)
    TFM_SECURE_STACK +0 ALIGN 128 EMPTY 0x2000 {
    }
#endif /* !defined(TFM_PSA_API) */

#if defined(CONFIG_TFM_PARTITION_META)
    TFM_SP_META_PTR +0 ALIGN 32 {
        *(.bss.SP_META_PTR_SPRTL_INST)
    }
#endif

    /**** APP RoT DATA start here */

    TFM_APP_ROT_LINKER_DATA +0 ALIGN 32 {
        *tfm_app_rot_partition* (+RW +ZI)
        *.o(TFM_*_APP-ROT_ATTR_RW)
        *.o(TFM_*_APP-ROT_ATTR_ZI)
    }

    /*
     * This empty, zero long execution region is here to mark the end address
     * of APP RoT RW and Stack.
     */
    TFM_APP_RW_STACK_END +0 ALIGN GTZC_RAM_ALIGN EMPTY 0x0 {
    }
        /* Shared area between BL2 and runtime to exchange data */
    TFM_SHARED_DATA +0 ALIGN 32 OVERLAY EMPTY BOOT_TFM_SHARED_DATA_SIZE {
    }

    /* MSP */
    ARM_LIB_STACK +0 ALIGN 32 OVERLAY EMPTY S_MSP_STACK_SIZE {
    }

    ARM_LIB_HEAP +0 ALIGN 8 EMPTY S_HEAP_SIZE {
    }

    ER_TFM_DATA +0 {
        * (+RW +ZI)
    }

    ER_PART_RT_POOL +0 ALIGN 4 {
        *(.bss.part_runtime)
    }

    ER_SERV_RT_POOL +0 ALIGN 4 {
        *(.bss.serv_runtime)
    }

    /**** PSA RoT DATA start here */
    /*
     * This empty, zero long execution region is here to mark the start address
     * of PSA RoT RW and Stack.
     */
    TFM_PSA_RW_STACK_START +0 ALIGN 32 EMPTY 0x0 {
    }

    TFM_PSA_ROT_LINKER_DATA +0 ALIGN 32 {
        *tfm_psa_rot_partition* (+RW +ZI)
        *.o(TFM_*_PSA-ROT_ATTR_RW)
        *.o(TFM_*_PSA-ROT_ATTR_ZI)
    }

    /*
     * This empty, zero long execution region is here to mark the end address
     * of PSA RoT RW and Stack.
     */
    TFM_PSA_RW_STACK_END +0 ALIGN 32 EMPTY 0x0 {
    }

#if defined(PSA_PROXY_SHARED_MEMORY_BASE)
    PSA_PROXY_SHARED_MEMORY PSA_PROXY_SHARED_MEMORY_BASE PSA_PROXY_SHARED_MEMORY_SIZE {
        *(PSA_PROXY_SHARED_MEMORY_SECTION)
    }
#endif

    /* This empty, zero long execution region is here to mark the limit address
     * of the last execution region that is allocated in SRAM.
     */
    SRAM_WATERMARK +0 EMPTY 0x0 {
    }

    /* Make sure that the sections allocated in the SRAM does not exceed the
     * size of the SRAM available.
     */
    ScatterAssert(ImageLimit(SRAM_WATERMARK) <= S_DATA_START + S_DATA_SIZE)
}

LR_VENEER CMSE_VENEER_REGION_START {
    /*
     * Place the CMSE Veneers (containing the SG instruction) in a separate
     * 32 bytes aligned region so that the SAU can be programmed to
     * just set this region as Non-Secure Callable.
     */
    CMSE_VENEER CMSE_VENEER_REGION_START CMSE_VENEER_REGION_SIZE {
        *(Veneer$$CMSE)
    }
}

LR_NS_PARTITION NS_PARTITION_START {
    /* Reserved place for NS application.
     * No code will be placed here, just address of this region is used in the
     * secure code to configure certain HW components. This generates an empty
     * execution region description warning during linking.
     */
    ER_NS_PARTITION NS_PARTITION_START UNINIT NS_PARTITION_SIZE {
    }
}

#ifdef BL2
LR_SECONDARY_PARTITION SECONDARY_PARTITION_START {
    /* Reserved place for new image in case of firmware upgrade.
     * No code will be placed here, just address of this region is used in the
     * secure code to configure certain HW components. This generates an empty
     * execution region description warning during linking.
     */
    ER_SECONDARY_PARTITION SECONDARY_PARTITION_START \
        UNINIT SECONDARY_PARTITION_SIZE {
    }
}
#endif /* BL2 */
