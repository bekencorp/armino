## components/tfm_v17/tfm/secure_fw/partitions/protected_storage/Kconfig
```kconfig
#-------------------------------------------------------------------------------
# Copyright (c) 2022, Arm Limited. All rights reserved.
#
# SPDX-License-Identifier: BSD-3-Clause
#
#-------------------------------------------------------------------------------

menu "PS component configs"
    depends on TFM_PARTITION_PROTECTED_STORAGE

config PS_CREATE_FLASH_LAYOUT
    bool "Create flash FS"
    default y
    help
      Create flash FS if it doesn't exist for Protected Storage partition

config PS_RAM_FS
    bool "Enable emulated RAM FS"
    default n
    help
      Enable emulated RAM FS for platforms that don't have flash for
      Protected Storage partition

config PS_ROLLBACK_PROTECTION
    bool "Enable rollback protection"
    default y
    help
      Enable rollback protection for Protected Storage partition

config PS_VALIDATE_METADATA_FROM_FLASH
    bool "Validate filesystem metadata"
    default y
    help
      Validate filesystem metadata every time it is read from flash

config PS_MAX_ASSET_SIZE
    int "Maximum stored asset size"
    default 2048
    help
      The maximum asset size to be stored in the Protected Storage area

config PS_NUM_ASSETS
    int "Maximum stored assets number"
    default 10
    help
      The maximum number of assets to be stored in the Protected Storage
      area

config PS_STACK_SIZE
    hex "Stack size"
    default 0x700

endmenu
```

## components/tfm_v17/tfm/secure_fw/spm/Kconfig
```kconfig
#-------------------------------------------------------------------------------
# Copyright (c) 2022, Arm Limited. All rights reserved.
#
# SPDX-License-Identifier: BSD-3-Clause
#
#-------------------------------------------------------------------------------

menu "TF-M SPM component configs"

config CONFIG_TFM_CONN_HANDLE_MAX_NUM
    int "Maximal number of handling secure services"
    default 8
    help
      The maximal number of secure services that are connected or requested at
      the same time

config CONFIG_TFM_DOORBELL_API
    bool "Enable the doorbell APIs"
    depends on TFM_SPM_BACKEND_IPC
    default y
endmenu
```

## components/user_driver/Kconfig
```kconfig
menu "User_driver"

	config FLASH_SIZE_4M
		depends on FLASH
		bool "Enable Flash Size 4M"
		default n

endmenu
```

## components/webclient/Kconfig
```kconfig
menu "Webclient"
	config WEBCLIENT
		bool "Enable Webclient"
		default n
endmenu
```

## middleware/arch/arm9/Kconfig
```kconfig
menu "Arch::Arm9"

	config CPU_FREQ_HZ
		int "Set Cpu Freq Hz"
		default 120000000
		help
			CPU frequency

	config ARCH_ARM9
		bool "Enable Arch ARM9"
		default n

endmenu
```

## middleware/arch/cm33/Kconfig
```kconfig
menu "Arch::Cm33"
	config ARCH_CM33
		bool "Enable Cortex-M33"
		default n
	
	menu "Modify Arch Cm33 Config"
		depends on ARCH_CM33

		config FPGA
			bool "Enable FPGA"
			default n

		config MPU
			bool "Enable Memory Protect Unit Feature"
			default n
	
		config SPE
			int "Enable SPE"
			default 0

		config CPU_FREQ_HZ
			int "Set Cpu Freq Hz"
			default 120000000
			help
				CPU frequency

		config ARCH_INT_STATIS
			bool "Enable Arch Int Statis"
			default n
			help
				Enable interrupt statis

		config SYSTICK_32K
			bool "Systick use external 32K clock"
			default n
			
		config CACHE_ENABLE
                	depends on MPU
			bool "Enable DCache"
			default n
			help
				Enable DCache

		config MEMDUMP_ALL
			bool "Enable Memdump All"
			default y
			help
				Dump all memory when exception happen

	endmenu
endmenu
```

## middleware/arch/riscv/Kconfig
```kconfig
menu "Arch::Riscv"
	config CPU_FREQ_HZ
		int "Enable Cpu Freq Hz"
		default 120000000
		help
			CPU frequency

	config ARCH_RISCV
		bool "Enable Arch RISCV"
		default n

	menu "Modify Arch Riscv Config"
		depends on ARCH_RISCV

		config NEST_INT_SUPPORT
			bool "Enable Nest Int Support"
			default n
			help
				Support nest interrupt

		config MEMDUMP_ALL
			bool "Enable Memdump All"
			default y
			help
				Dump all memory when exception happen

		config SAVE_BOOT_TIME_POINT
			bool "Enable Save Boot Time Point"
			default n

		config CACHE_ENABLE
			bool "Enable Cache Enable"
			default n
			help
				Enable Cache

		config CACHE_CUSTOM_SRAM_MAPPING
			depends on CACHE_ENABLE
			bool "Enable Cache Custom Sram Mapping"
			default n
			help
				Custom defined sram mapping
	endmenu
endmenu
```

## middleware/boards/bk7235/vnd_cal/Kconfig
```kconfig
menu "VENDOR CAL CONFIG"
	config VND_CAL
		bool "Enable vendor cal"
		default n
endmenu
```

## middleware/boards/bk7237/vnd_flash/Kconfig
```kconfig
menu "VENDOR FLASH CONFIG"
	config OVERRIDE_FLASH_PARTITION
		bool "Override flash partition"
		default n
endmenu
```

## middleware/boards/bk7256/vnd_cal/Kconfig
```kconfig
menu "Boards::Bk7256::Vnd_cal"
	config VND_CAL
		bool "Enable Vnd Cal"
		default n
		help
			Enable vendor cal

	config BLE_USE_HIGH_POWER_LEVEL
		bool "Enable Ble Use High Power Level"
		default y
		help
			Enable high power level
endmenu
```

## middleware/compal/Kconfig
```kconfig
menu "Compal"

	config SUPPORT_MATTER
		bool "Enable Support Matter"
		default n
		help
			Enable MATTER

	config COMMON_IO
		depends on FREERTOS_V10
		bool "Enable Common Io"
		default n
		help
			Amazon Common IO

endmenu
```

## middleware/driver/Kconfig
```kconfig
menu "Driver"

	menu "SOFTWARE_SUPPORT_CHIP"
		config CHIP_SUPPORT
			bool "Enable chip support"
			default n
	endmenu
	
	menu "Interrupt"
		config ISR_REG_DISABLE
			bool "Disable irq"
			default n
	endmenu

	source "${ARMINO_PATH}/middleware/driver/wdt/Kconfig"
	source "${ARMINO_PATH}/middleware/driver/aon_wdt/Kconfig"
	source "${ARMINO_PATH}/middleware/driver/uart/Kconfig"
	source "${ARMINO_PATH}/middleware/driver/trng/Kconfig"
	source "${ARMINO_PATH}/middleware/driver/sdio_host/Kconfig"
	source "${ARMINO_PATH}/middleware/driver/sdcard/Kconfig"
	source "${ARMINO_PATH}/middleware/driver/sd_card/Kconfig"
	source "${ARMINO_PATH}/middleware/driver/fatfs/Kconfig"
	source "${ARMINO_PATH}/middleware/driver/sdio/Kconfig"
	source "${ARMINO_PATH}/middleware/driver/spi/Kconfig"
	source "${ARMINO_PATH}/middleware/driver/qspi/Kconfig"
	source "${ARMINO_PATH}/middleware/driver/rtc/Kconfig"
	source "${ARMINO_PATH}/middleware/driver/gpio/Kconfig"
	source "${ARMINO_PATH}/middleware/driver/pmu/Kconfig"
	source "${ARMINO_PATH}/middleware/driver/general_dma/Kconfig"
	source "${ARMINO_PATH}/middleware/driver/touch/Kconfig"
	source "${ARMINO_PATH}/middleware/driver/sbc/Kconfig"
	source "${ARMINO_PATH}/middleware/driver/jpeg_enc/Kconfig"
	source "${ARMINO_PATH}/middleware/driver/psram/Kconfig"
	source "${ARMINO_PATH}/middleware/driver/calendar/Kconfig"
	source "${ARMINO_PATH}/middleware/driver/mpc/Kconfig"
	source "${ARMINO_PATH}/middleware/driver/prro/Kconfig"
	source "${ARMINO_PATH}/middleware/driver/sys_ctrl/Kconfig"
	source "${ARMINO_PATH}/middleware/driver/phy/Kconfig"
	source "${ARMINO_PATH}/middleware/driver/i2s/Kconfig"
	source "${ARMINO_PATH}/middleware/driver/i2c/Kconfig"
	source "${ARMINO_PATH}/middleware/driver/i2s/Kconfig"
	source "${ARMINO_PATH}/middleware/driver/pwm/Kconfig"
	source "${ARMINO_PATH}/middleware/driver/icu/Kconfig"
	source "${ARMINO_PATH}/middleware/driver/timer/Kconfig"
	source "${ARMINO_PATH}/middleware/driver/saradc/Kconfig"
	source "${ARMINO_PATH}/middleware/driver/flash/Kconfig"
	source "${ARMINO_PATH}/middleware/driver/pwr_clk/Kconfig"
	source "${ARMINO_PATH}/middleware/driver/vault/Kconfig"
	source "${ARMINO_PATH}/middleware/driver/otp/Kconfig"
	source "${ARMINO_PATH}/middleware/driver/jpeg_dec/Kconfig"

	config LCD
		bool "Enable LCD"
		default n

	config LCD_GC9503V
		depends on LCD
		bool "Enable LCD_GC9503V API"
		default n

	config LCD_H050IWV
		depends on LCD
		bool "Enable LCD_H050IWV API"
		default n

	config LCD_HX8282
		depends on LCD
		bool "Enable LCD_HX8282 API"
		default n

	config LCD_MD0430R
		depends on LCD
		bool "Enable LCD_MD0430R API"
		default n

	config LCD_MD0700R
		depends on LCD
		bool "Enable LCD_MD0700R API"
		default n

	config LCD_NT35512
		depends on LCD
		bool "Enable LCD_NT35512 API"
		default n

	config LCD_NT35510
		depends on LCD
		bool "Enable LCD_NT35510 API"
		default n

	config LCD_NT35510_MCU
		depends on LCD
		bool "Enable LCD_NT35510_MCU API"
		default n

	config LCD_ST7282
		depends on LCD
		bool "Enable LCD_ST7282 API"
		default n

	config LCD_ST7796S
		depends on LCD
		bool "Enable LCD_ST7796S API"
		default n

	config LCD_ST7710S
		depends on LCD
		bool "Enable LCD_ST7710S API"
		default n
		
	config LCD_ST7701S
		depends on LCD
		bool "Enable LCD_ST7701S API"
		default n

	config LCD_QSPI
		bool "Enable LCD QSPI"
		default n

	config LCD_QSPI_SH8601A
		depends on LCD_QSPI
		bool "Enable LCD_QSPI_SH8601A API"
		default n

	config LCD_QSPI_ST77903
		depends on LCD_QSPI
		bool "Enable LCD_QSPI_ST77903 API"
		default n

	config MAC_PHY_BYPASS
		bool "Enable MAC/PHY by pass mode"
		default y

	config SUPPORT_IRDA
		bool "Enable IRDA"
		default y

	config MAILBOX
		bool "Enable mail_box"
		default n

	config TP
		bool "Enable TP"
		default n

	config DMA2D
		bool "Enable DMA2D"
		default n

	config YUV_BUF
		bool "Enable yuv_buf"
		default n

	config EFUSE
		bool "Enable efuse"
		default y
	
	config FFT
		bool "Enable fft"
		default n

	config AUDIO_RISCV_IP_V1_0
		bool "Enable audio riscv driver"
		default n

	config AUDIO_DSP_IP_V1_0
		bool "Enable audio dsp driver"
		default n

	config CHANGE_JTAG_GPIO
		bool "Enable change jtag group"
		default n

	config RESET_REASON
		bool "Enable reset reason"
		default y

	config LCD_POWER_GPIO_CTRL
		bool "Enable lcd power gpio ctrl"
		default n

	config LCD_BACKLIGHT_GPIO_CTRL
		bool "Enable lcd backlight gpio ctrl"
		default n

	config CAMERA_POWER_GPIO_CTRL
		bool "Enable camera power gpio ctrl"
		default n
endmenu
```

## middleware/driver/audio/Kconfig
```kconfig
menu "AUDIO"
	config AUDIO
		bool "Enable Audio"
		default n

	config AUDIO_RISCV_IP_V1_0
		depends on AUDIO
		bool "Enable audio riscv driver"
		default n

	config AUDIO_DSP_IP_V1_0
		depends on AUDIO
		bool "Enable audio dsp driver"
		default n

	config ES8311
		depends on SIM_I2C
		depends on I2S
		bool "Enable audio codec chip ES8311 driver"
		default n
endmenu
```

## middleware/driver/camera/Kconfig
```kconfig
menu "CAMERA"
	config CAMERA_POWER_GPIO_CTRL
		bool "Enable camera power gpio ctrl"
		default n

	config UVC_CHECK_BULK_JPEG_HEADER
		depends on USB_UVC
		bool "Check JPEG (ff d8) header in bulk payload"
		default y
endmenu
```

## middleware/driver/flash/Kconfig
```kconfig
menu "FLASH"
	config FLASH
		bool "Enable flash"
		default y

	config FLASH_QUAD_ENABLE
		bool "Enable flash quad enable"
		default n
		
	config FLASH_SRC_CLK_60M
		bool "Enable flash source clock 60M"
		default n
		
	config FLASH_ORIGIN_API
		bool "Enable flash old api"
		default n
endmenu
```

## middleware/driver/general_dma/Kconfig
```kconfig
menu "GENERAL_DMA"
	config GENERAL_DMA
		bool "Enable General DMA"
		default y
endmenu
```

## middleware/driver/gpio/Kconfig
```kconfig
menu "GPIO"
	config GPIO_WAKEUP_SUPPORT
		bool "Enable GPIO WAKEUP system if at low voltage status"
		default n

	config GPIO_DYNAMIC_WAKEUP_SUPPORT
		bool "Enable GPIO dynamic config to wake system if at low volatage status"
		depends on GPIO_WAKEUP_SUPPORT
		default n

	config GPIO_WAKEUP_DEBUG
		bool "Enable GPIO wakeup module debug code"
		depends on GPIO_WAKEUP_SUPPORT
		default n

	config GPIO_DYNAMIC_WAKEUP_SOURCE_MAX_CNT
		int "how many gpio can dynamic set to wakeup system at low power status"
		range 0 48
		default 4
		help
		The value should be changed if need more then 4 gpio

	config CONFIG_GPIO_WAKEUP_ID
		int "specific port for GPIO wakeup"
		range 0 48
		default 22
		help
		Only one port is supported for now

	config CONFIG_GPIO_WAKEUP_INT_TYPE
		int "which intterupt type for GPIO wakeup"
		range 0 3
		default 0
		help
		0: set gpio as low level intterrupt type
		1: set gpio as high level intterrupt type
		2: set gpio as rising edge intterrupt type
		3: set gpio as falling edge intterrupt type

	config GPIO_SIMULATE_UART_WRITE
		bool "Enable GPIO simulate uart write data"
		default n

	config GPIO_DEFAULT_SET_SUPPORT
		bool "Enable GPIO default set devs"
		default n

	config GPIO_ANA_WAKEUP_SUPPORT
		bool "Enable GPIO wakeup system from analog channel"
		default n
		help
			This is for super deep sleep
endmenu
```

## middleware/driver/i2c/Kconfig
```kconfig
menu "I2C"
	config I2C
		bool "Enable I2C"
		default y

	config I2C_SUPPORT_ID_BITS
		int "i2c support id bits"
		range 1 255
		default 1
		help
		The value should be changed if need to change i2c id

	config FM_I2C
		bool "Enable FM I2C"
		default y

	config SIM_I2C
		bool "Enable GPIO Simulate I2C"
		default n
endmenu
```

## middleware/driver/jpeg_dec/Kconfig
```kconfig
menu "JPEG_DEC"
	config JPEG_DEC
		bool "Enable JPEGDEC Display"
		default n

	config JPEG_DEC_UVC_SRAM_BUFFER_SIZE
		int "set jpeg decoder sram size"
		range 1 131072
		default 131072
		help
			the sram used to save jepg data from UVC

endmenu
```

## middleware/driver/jpeg_enc/Kconfig
```kconfig
menu "JPEG_ENC"
	config JPEGENC_HW
		bool "Enable HardWare JPEG ENCODE"
		default n
endmenu
	
```
