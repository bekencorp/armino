## middleware/driver/lcd/Kconfig
```kconfig
menu "LCD"
	config LCD
		bool "Enable LCD"
		default n

	config LCD_GC9503V
		depends on LCD
		bool "Enable LCD_GC9503V API"
		default n

	config LCD_H050IWV
		depends on LCD
		bool "Enable LCD_H050IWV API"
		default n

	config LCD_HX8282
		depends on LCD
		bool "Enable LCD_HX8282 API"
		default n

	config LCD_MD0430R
		depends on LCD
		bool "Enable LCD_MD0430R API"
		default n

	config LCD_MD0700R
		depends on LCD
		bool "Enable LCD_MD0700R API"
		default n

	config LCD_NT35512
		depends on LCD
		bool "Enable LCD_NT35512 API"
		default n

	config LCD_NT35510
		depends on LCD
		bool "Enable LCD_NT35510 API"
		default n

	config LCD_NT35510_MCU
		depends on LCD
		bool "Enable LCD_NT35510_MCU API"
		default n

	config LCD_ST7282
		depends on LCD
		bool "Enable LCD_ST7282 API"
		default n

	config LCD_ST7796S
		depends on LCD
		bool "Enable LCD_ST7796S API"
		default n

	config LCD_ST7710S
		depends on LCD
		bool "Enable LCD_ST7710S API"
		default n

	config LCD_ST7701S
		depends on LCD
		bool "Enable LCD_ST7701S API"
		default n

	config LCD_ST7701S_LY
		depends on LCD
		bool "Enable LCD_ST7701S API"
		default n

	config LCD_QSPI
		bool "Enable LCD QSPI"
		default n

	config LCD_QSPI_SH8601A
		depends on LCD_QSPI
		bool "Enable LCD_QSPI_SH8601A API"
		default n

	config LCD_QSPI_ST77903
		depends on LCD_QSPI
		bool "Enable LCD_QSPI_ST77903 API"
		default n

	config LCD_QSPI_ST77903_SAT61478M
		depends on LCD_QSPI
		bool "Enable LCD_QSPI_ST77903_SAT61478M API"
		default n

	config LCD_QSPI_PIXEL_DEPTH_BYTE
		depends on LCD_QSPI
		int "Set LCD QSPI Pixel Depth Byte"
		default 3
		help
			2 - RGB565
			3 - RGB888

	config LCD_QSPI_CUSTOM
		depends on LCD_QSPI
		bool "Enable LCD_QSPI_CUSTOM API"
		default n

	config LCD_POWER_GPIO_CTRL
		bool "Enable lcd power gpio ctrl"
		default n

	config LCD_BACKLIGHT_GPIO_CTRL
		bool "Enable lcd backlight gpio ctrl"
		default n
endmenu
```

## middleware/driver/phy/Kconfig
```kconfig
menu "PHY"
	#TODO is here the right place to put CONFIG_PTA?
	config PTA
	bool "Enable PTA"
	default n

	config ATE_TEST
	    bool "Enable ATE Test"
	    default n
endmenu
```

## middleware/driver/prro/Kconfig
```kconfig
menu "PRRO"
	config PRRO
		bool "Enable PRRO"
		default n

	config GPIO_GROUP0_SECURE_BITMAP
		depends on PRRO
		int  "GPIO 0~31 secure attribute bitmap"
		default 0

	config GPIO_GROUP1_SECURE_BITMAP
		depends on PRRO
		int  "GPIO 32~47 secure attribute bitmap"
		default 0

	config AHB_DEV_SECURE_BITMAP
		depends on PRRO
		int  "AHB devices secure attribute bitmap"
		default 0

	config APB_DEV_SECURE_BITMAP
		depends on PRRO
		int  "APB devices secure attribute bitmap"
		default 0

	config AHB_PRIVILEGE_BITMAP
		depends on PRRO
		int  "AHB devices privilege attribute bitmap"
		default 0

	config APB_PRIVILEGE_BITMAP
		depends on PRRO
		int  "APB devices privilege attribute bitmap"
		default 0
endmenu
```

## middleware/driver/psram/Kconfig
```kconfig
menu "PSRAM"
	config PSRAM
		bool "Enable PSRAM"
		default n

	#TODO identify psram factory type
		choice USB_PSRAM
			prompt "Select PSRAM chip id"
			default PSRAM_APM

			config PSRAM_APM
				bool "PSRAM_APM"
				help
					use APMemory 8MByte

			config PSRAM_WBD955
				bool "PSRAM_WBD955"
				help
					use WBD955 4MByte
		endchoice

	config PSRAM_AS_SYS_MEMORY
		depends on PSRAM
		bool "Enable psram_malloc API"
		default n

	config PSRAM_HEAP_BASE
		depends on PSRAM_AS_SYS_MEMORY
		hex "Set psram_malloc base address"
		default 0x60700000 if PSRAM_APM
		default 0x60320000 if PSRAM_WBD955
		help
			The psram address is from 0x60000000 to 0x60800000 in BK7256 for psram apm
			The suggested option is 0x60600000 or 0x60700000
			The psram address is from 0x60000000 to 0x60400000 in BK7256 for psram wbd955
			The suggested option is 0x60300000

	config PSRAM_HEAP_SIZE
		depends on PSRAM_AS_SYS_MEMORY
		hex "Set psram heap size"
		default 0x100000 if PSRAM_APM
		default 0xE0000 if PSRAM_WBD955
		help
			psram apm
			0x100000 - 1M
			The max size is 0x800000 in BK7256
			The suggested option is 0x100000 or 0x200000
			psram wbd955
			0xE0000 - 896KB
			The max size is 0x400000 in BK7256
			The suggested option is 0xE0000
endmenu
```

## middleware/driver/pwm/Kconfig
```kconfig
menu "PWM"
	config PWM
		bool "Enable pwm"
		default y

	config PWM_HAS_TWO_INT
		bool "Enable pwm has two int"
		default n
endmenu
```

## middleware/driver/pwr_clk/Kconfig
```kconfig
menu "PWR_CLK"
	config EXTERN_32K
		bool "Use an external 32k crystal"
		default n
	config MEM_AUTO_POWER_DISABLE
		bool "mem auto power disable"
		default n
	config CP1_AUTO_POWER_DISABLE
		bool "cp1 auto power disable"
		default n
	config CPU_DEFAULT_FREQ_60M
		bool "set cpu default frequency 60M"
		default n
	config RESERVE_1K_SRAM_UNINITIAL
		bool "reserve 1k sram uninitialized"
		default n
endmenu
```

## middleware/driver/qspi/Kconfig
```kconfig
menu "QSPI"
		config QSPI
			bool "Enable QSPI"
			default n
			
		config QSPI_STATIS
			bool "Enable QSPI Statis"
			default y
endmenu
	
```

## middleware/driver/qspi_oled/Kconfig
```kconfig
menu "QSPI_OLED"
	config QSPI
		bool "Enable QSPI"
		default n
				
	config QSPI_OLED
		bool "Enable QSPI_OLED"
		default n
endmenu
```

## middleware/driver/rtc/Kconfig
```kconfig
menu "AON_RTC"
	config AON_RTC
		bool "Enable AON_RTC"
		default n

	config AON_RTC_MANY_USERS
		bool "Enable AON_RTC support many users"
		default n

	config AON_RTC_TEST
		bool "Enable AON_RTC Test,F.E:Command line test"
		default n

	config AON_RTC_DEBUG
		bool "Enable AON_RTC Debug"
		default n

	config AON_RTC_KEEP_TIME_SUPPORT
		bool "Enable rtc keep time when enter deepsleep,set data on flash"
		default n
endmenu
```

## middleware/driver/saradc/Kconfig
```kconfig
menu "SARADC"
	config SARADC
		bool "Enable saradc"
		default y

	config SARADC_NEED_FLUSH
		bool "SARADC whether need flush data"
		default y

	config SARADC_RANGE_DIVIDE
		bool "Enable saradc measure range divide"
		default n
endmenu	
```

## middleware/driver/sd_card/Kconfig
```kconfig
menu "SDCARD"
	config SDCARD
		bool "Enable SDCARD"
		default y if (USB && USB_DEVICE)
		default n if !(USB && USB_DEVICE)

	config SDCARD_DEFAULT_CLOCK_FREQ
		int "sd card default clock freq"
		default 9

	config SDCARD_CHECK_INSERTION_EN
		bool "Whether to use pin to determine whether the sdcard is connected"
		default n

	menu "SDCARD_CHECK_INSERTION_EN"
		depends on SDCARD_CHECK_INSERTION_EN

		config SDCARD_CHECK_INSERTION_GPIO_ID
			int "Detect whether to connect the GPIO ID of the sdcard"
			default 0
	endmenu

	config SDCARD_BUSWIDTH_4LINE
		bool "Support SDCARD 4 Data Wires"
		default n

	config SDCARD_POWER_GPIO_CTRL
		bool "Enable SDcard power gpio ctrl"
		default n
endmenu
```

## middleware/driver/sdio/Kconfig
```kconfig
menu "SDIO"
	config SDIO
		bool "Enable SDIO"

	config SDIO_V1P0
		bool "SDIO Version V1P0"
		depends on SDIO
		default n
		
	config SDIO_V2P0
		bool "SDIO Version V2P0"
		default n

	config SDIO_TRANS
		bool "Enable SDIO Trans"
		depends on SDIO_V1P0
		default n

	config REAL_SDIO
		bool "Enable Real SDIO"
		depends on SDIO_V1P0

	config SDIO_BLOCK_512
		bool "Enable SDIO 512 Bytes Block"
		depends on REAL_SDIO

	config SDIO_SLAVE
		bool "Enable SDIO Slave Device, BEKEN Chip Is A SDIO Slave Device"
		depends on SDIO
		default n

	config SDIO_CHANNEL_EN
		bool "Enable SDIO channel"
		depends on SDIO_SLAVE && SDIO_V2P0
		default n

	config SDIO_BIDIRECT_CHANNEL_EN
		bool "Enable SDIO two derect channel"
		depends on SDIO_CHANNEL_EN
		default n

	config SDIO_GDMA_EN
		bool "BK7256 First Version Chip Doesn't Support GDMA"
		depends on SDIO_SLAVE && SDIO_V2P0
		default n

	config GPIO_NOTIFY_TRANSACTION_EN
		bool "Host Wake BK7256"
		depends on SDIO_SLAVE && SDIO_V2P0
		default y

	config SDIO_4LINES_EN
		bool "SDIO Uses 4 Lines Transfer Data"
		depends on SDIO
		default y

	config SDIO_TEST_EN
		bool "SDIO Test Program Enable"
		depends on SDIO_SLAVE && SDIO_V2P0
		default n

	config SDIO_DEBUG_EN
		bool "SDIO Debug Program Enable"
		depends on SDIO_SLAVE && SDIO_V2P0
		default n

endmenu
```

## middleware/driver/sdio_host/Kconfig
```kconfig
menu "SDIO_HOST"
	config SDIO_HOST
		bool "Enable sdio host"
		default n

	config SDIO_HOST_DEFAULT_CLOCK_FREQ
		int "SDIO Host default clock freq"
		default 200000
endmenu
```

## middleware/driver/spi/Kconfig
```kconfig
menu "SPI"
	#TODO optimize SPI_DMA and GENERAL_DMA when optimize driver
	config SPI_DMA
		bool "Enable SPI DMA"
		default y

	config SPI_SLAVE
		bool "Enable SPI Slave"
		default y

	config SPI_MASTER
		bool "Enable SPI Master"
		default y
			
	config SPI_STATIS
		bool "Enable SPI Statis"
		default y
			
	config SPI_SUPPORT_TX_FIFO_WR_READY
		bool "Support TX FIFO Write Ready"
		default y

	config HSLAVE_SPI
		bool "Enable HSlave SPI"
		default y

	config SPI_MST_FLASH
		bool "SPI MST Flash"
		default n

	config SPI_MST_PSRAM
		bool "SPI MST PSRAM"
		default n

endmenu
```

## middleware/driver/touch/Kconfig
```kconfig
menu "TOUCH"
	config TOUCH
		bool "Enable TOUCH"
		default n
	config TOUCH_PM_SUPPORT
		bool "Enable TOUCH PM SUPPORT"
		default n
endmenu
	
```

## middleware/driver/uart/Kconfig
```kconfig
menu "UART"
	config UART1
		bool "Enable UART1"
		default n
	config UART1_FLOW_CTRL
		bool "Uart1 Flow Ctrl"
		default n

	config UART2
		bool "Enable UART2"
		default n

	config UART3
		bool "Enable UART3"
		default n

	config UART_PRINT_PORT
		int "Config Uart Print Port"
		range 0 2
		default 0
		help
		Default 0 mean use UART1

	config UART_ATE_PORT
		int "Config Uart ATE Port"
		range 0 2
		default 1
		help
		Default 1 mean use UART2

	config PRINTF_BUF_SIZE
		int "Print Buffer Size"
		range 1 4096
		default 128
		help
		The value should be changed if print size is more than 128

	# TODO do we need to put it to uart_debug component?
	config BACKGROUND_PRINT
		bool "Enable background print"
		default n

	config KFIFO_SIZE
		int "Kfifo Size"
		range 1 4096
		default 128
		help
			This will set kfifo size when software uses kfifo to cache data receiving.

	config UART_STATIS
		bool "Enable UART Statis"
		default n

	config UART_LOW_VOLTAGE_SUPPORT
		bool "Enable UART support low power"
		default n
		
	config UART_ERR_INTERRUPT
		bool "Enable UART support error interrupt"
		default n
endmenu
```

## middleware/soc/Kconfig
```kconfig
menu "SOC_CONFIG"

	choice SOC
		prompt "ARMINO SoC"
		default SOC_BK7231N if "$ARMINO_SOC" = "bk7231n"
		default SOC_BK7236 if "$ARMINO_SOC" = "bk7236"
		default SOC_BK7236_CP1 if "$ARMINO_SOC" = "bk7236_cp1"
		default SOC_BK7258 if "$ARMINO_SOC" = "bk7258"
		default SOC_BK7258_CP1 if "$ARMINO_SOC" = "bk7258_cp1"
		default SOC_BK7256 if "$ARMINO_SOC" = "bk7256"
		default SOC_BK7256_CP1 if "$ARMINO_SOC" = "bk7256_cp1"
		default SOC_BK7235 if "$ARMINO_SOC" = "bk7235"
		default SOC_BK7235_CP1 if "$ARMINO_SOC" = "bk7235_cp1"
		default SOC_BK7235 if "$ARMINO_SOC" = "bk7235a"
		default SOC_BK7235 if "$ARMINO_SOC" = "bk7235b"
		default SOC_BK7235M if "$ARMINO_SOC" = "bk7235m"

		config SOC_BK7231N
			bool "BK7231N"
		config SOC_BK7236
			bool "BK7236"
		config SOC_BK7236_CP1
			bool "BK7236_CP1"
		config SOC_BK7258
			bool "BK7258"
		config SOC_BK7258_CP1
			bool "BK7258_CP1"
		config SOC_BK7256
			bool "BK7256"
		config SOC_BK7256_CP1
			bool "BK7256_CP1"
		config SOC_BK7235
			bool "BK7235"
		config SOC_BK7235_CP1
			bool "BK7235_CP1"
		config SOC_BK7235M
			bool "BK7235M"
	endchoice

	choice System
		prompt "System"
		default SYS_CPU1 if "$ARMINO_SOC" = "bk7235_cp1"
		default SYS_CPU1 if "$ARMINO_SOC" = "bk7236_cp1"
		default SYS_CPU1 if "$ARMINO_SOC" = "bk7258_cp1"
		default SYS_CPU1 if "$ARMINO_SOC" = "bk7256_cp1"
		default SYS_CPU0

		config SYS_CPU0
			bool "CPU0 system"

		config SYS_CPU1
			bool "CPU1 system"

		config SYS_CPU2
			bool "CPU2 system"
	endchoice

	config CPU_CNT
			int "System CPU count: 1: single core, 2: dual core, etc."
			default 1

	config SOC_STR
		string "SoC string"
		default "bk7231n" if SOC_BK7231N
		default "bk7236"  if SOC_BK7236
		default "bk7236_cp1"  if SOC_BK7236_CP1
		default "bk7258"  if SOC_BK7258
		default "bk7258_cp1"  if SOC_BK7258_CP1
		default "bk7256"  if SOC_BK7256
		default "bk7256_cp1"  if SOC_BK7256_CP1
		default "bk7235"  if SOC_BK7235
		default "bk7235_cp1"  if SOC_BK7235_CP1
		default "bk7235m"  if SOC_BK7235M
		default "$ARMINO_SOC"

	config SOC_ARCH
		string "Soc arch"
		default "unknown"

	config SOC_BK7256XX
		bool "For bk7256 series chipset"
		default n

	config SOC_BK7236XX
		bool "For bk7236 series chipset"
		default n
endmenu
```
