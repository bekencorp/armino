## middleware/soc/bk7231n/bk7231n.defconfig
```kconfig
#The value config in bk7231n.defconfig will over write the Kconfig's default value.
#If the default value in Kconfig satisfy your needs, then you needn't to config again here.

CONFIG_SOC_ARCH="arm9"
CONFIG_SOC_BK7231N=y
CONFIG_SOC_STR="bk7231n"

#
# ARMINO Configuration
#

#
# Common Configuration
#

#
# Compile/Build
#

#
# Debug
#
CONFIG_DEBUG_FIRMWARE=y
CONFIG_ASSERT_IGNORE=y
# CONFIG_ASSERT_HALT is not set
# CONFIG_ASSERT_REBOOT is not set
# CONFIG_JTAG is not set
# end of Debug
# end of Common Configuration

#
# Features Configuration
#
CONFIG_LWIP_V2_0=y
# CONFIG_LWIP_V2_1 is not set
CONFIG_NO_HOSTED=y
# CONFIG_SEMI_HOSTED is not set
# CONFIG_FULLY_HOSTED is not set
# CONFIG_WIFI_SENSOR is not set
# end of Features Configuration

#
# Components Configuration
#

#
# Application
#
# CONFIG_DEMO_TEST is not set
# CONFIG_FTPD_UPGRADE is not set
CONFIG_OTA_HTTP=y
# CONFIG_OTA_TFTP is not set
# end of Application

# CONFIG_AT is not set
CONFIG_AT_CMD=y

#
# Audio
#
# end of Audio

#
# Calibration
#
CONFIG_CALI=y
CONFIG_MANUAL_CALI=y
CONFIG_TPC_PA_MAP=y
# end of Calibration

#
# ATE
#
CONFIG_ATE=y
# end of ATE

#
# BLE
#
CONFIG_BLE=y
CONFIG_BLE_5_X=y
CONFIG_BLE_HOST_RW=y
# CONFIG_BLE_4_2 is not set
# end of BLE

#
# Cli
#
CONFIG_CLI=y
CONFIG_BKREG=y
# CONFIG_TCP_SERVER_TEST is not set
# CONFIG_AIRKISS_TEST is not set
# CONFIG_WIFI_RAW_TX_TEST is not set
# CONFIG_I2C1_TEST is not set
CONFIG_I2C2_TEST=y
# CONFIG_UART_TEST is not set
CONFIG_SPI_TEST=y
CONFIG_PERI_TEST=y
# CONFIG_RF_OTA_TEST is not set
CONFIG_SHELL_ASYNCLOG=y
# end of Cli

#
# RF
#
CONFIG_RF_POLICY_BLE_REQ=y
# CONFIG_RF_POLICY_WIFI_REQ is not set
# CONFIG_RF_POLICY_CO_REQ is not set
# end of RF

#
# Internal Kconfig
#
CONFIG_CHECK_MISMATCH=y
CONFIG_MCU_PS=y
CONFIG_DEEP_PS=y
CONFIG_TICK_CALI=y
CONFIG_STA_PS=y
# end of Internal Kconfig

#
# FreeRTOS
#
CONFIG_FREERTOS=y
# CONFIG_LITEOS_M is not set
CONFIG_FREERTOS_V9=y
# CONFIG_FREERTOS_V10 is not set

#
# Memory Debug
#
# CONFIG_MALLOC_STATIS is not set
# CONFIG_MEM_DEBUG is not set
# end of Memory Debug
# end of FreeRTOS

#
# Startup
#
CONFIG_APP_MAIN_TASK_PRIO=4
CONFIG_APP_MAIN_TASK_STACK_SIZE=4096
# end of Startup

#
# System
#
# CONFIG_BASE_MAC_FROM_EFUSE is not set
CONFIG_BASE_MAC_FROM_RF_OTP_FLASH=y
# CONFIG_BASE_MAC_FROM_NVS is not set
# end of System

#
# USB configuration
#
CONFIG_USB=n
# end of USB configuration

#
# WiFi
#
CONFIG_WIFI_IP=y
# CONFIG_WIFI6_CODE_STACK is not set
CONFIG_WIFI4=y
CONFIG_MSDU_RESV_HEAD_LENGTH=96
CONFIG_MSDU_RESV_TAIL_LENGTH=16
CONFIG_TASK_RECONNECT_PRIO=4
CONFIG_GDMA2TCM_WAR=y
# CONFIG_AP_MONITOR_COEXIST is not set
# CONFIG_WIFI_FAST_CONNECT is not set
# CONFIG_BSSID_CONNECT is not set
# CONFIG_WFA_CERT is not set
# CONFIG_LESS_MEMERY_IN_RWNX is not set
# CONFIG_AP_PROBEREQ_CB is not set
# end of WiFi

CONFIG_BLE_PS=y

#
# BLE 5.x
#
# CONFIG_BLE_HOST_NONE is not set
CONFIG_BLE_HOST_RW=y
# CONFIG_BLE_HOST_ZEPHYR is not set
#CONFIG_BLE_HOST_ZEPHYR_2_7 is not set
CONFIG_BLE_MESH_NONE=y
# CONFIG_BLE_MESH_RW is not set
# CONFIG_BLE_MESH_ZEPHYR_2_7 is not set
CONFIG_BLE_ADV_NUM=1
CONFIG_BLE_SCAN_NUM=1
CONFIG_BLE_INIT_NUM=0
CONFIG_BLE_CONN_NUM=1
# end of BLE 5.x

# CONFIG_CAMERA is not set

#
# Driver
#

#
# Watchdog
#
CONFIG_INT_WDT=y
CONFIG_INT_WDT_PERIOD_MS=1000
CONFIG_TASK_WDT=y
CONFIG_TASK_WDT_PERIOD_MS=60000
# end of Watchdog

#
# UART
#
CONFIG_UART1=y
CONFIG_UART2=y
CONFIG_UART_ATE_PORT=1
# CONFIG_PRINT_PORT_UART1 is not set
CONFIG_PRINT_PORT_UART2=y
CONFIG_UART_PRINT_PORT=1
CONFIG_PRINTF_BUF_SIZE=128
# CONFIG_BACKGROUND_PRINT is not set
CONFIG_KFIFO_SIZE=128
# CONFIG_UART_STATIS is not set
# end of UART

#
# TRNG
#
CONFIG_TRNG_SUPPORT=y
# end of TRNG

#depends on CONFIG_TRNG_SUPPORT
CONFIG_RANDOM_MAC_ADDR=y

#
# SDCARD
#
# CONFIG_SDCARD_HOST is not set
# end of SDCARD

CONFIG_MAC_PHY_BYPASS=y

#
# SDIO
#
# CONFIG_SDIO is not set
# end of SDIO

#
# SPI
#
CONFIG_SPI_DMA=y
CONFIG_SPI_SLAVE=y
CONFIG_SPI_MASTER=y
CONFIG_SPI_STATIS=y
CONFIG_SPI_SUPPORT_TX_FIFO_WR_READY=y
# CONFIG_HSLAVE_SPI is not set
# CONFIG_QSPI is not set
# CONFIG_SPI_MST_FLASH is not set
# CONFIG_SPI_MST_PSRAM is not set
# end of SPI

#
# DMA
#
CONFIG_GENERAL_DMA=y
# end of DMA

#
# CALENDAR
#
CONFIG_CALENDAR=y
# end of CALENDAR

#
# System control
#
# CONFIG_SYS_REDUCE_NORMAL_POWER is not set
# CONFIG_XTAL_FREQ_40M is not set
CONFIG_XTAL_FREQ_26M=y
CONFIG_XTAL_FREQ=26000000
CONFIG_DCO_FREQ=120000000
# end of System control

#
# PHY
#
# CONFIG_PTA is not set
# end of PHY

#
# I2S
#
# CONFIG_I2S is not set
# end of I2S

#
# pwm
#
CONFIG_PWM=y
# end of pwm

# CONFIG_SUPPORT_IRDA is not set
# CONFIG_MAILBOX is not set
# end of Driver

# CONFIG_EASY_FLASH is not set

#
# LwIP 2.0.2
#
CONFIG_LWIP=y
CONFIG_DHCP=y
CONFIG_TASK_LWIP_PRIO=4
# CONFIG_LWIP_MEM_DEFAULT is not set
CONFIG_LWIP_MEM_REDUCE=y
# end of LwIP 2.0.2

#
# LwIP 2.1.2
#
# end of LwIP 2.1.2

# CONFIG_MP3PLAYER is not set
# CONFIG_PCM_RESAMPLER is not set

#
# Power Save
#
# CONFIG_AP_IDLE is not set
# CONFIG_FAKE_RTC_PS is not set
# CONFIG_PM_MODEM_PWD is not set
# CONFIG_PM_STANDALONE is not set
# end of Power Save

#
# RF Test
#
CONFIG_TX_EVM_TEST=y
CONFIG_RX_SENSE_TEST=y
# end of RF Test

#
# WiFi RWNX Interface
#
CONFIG_WIFI_KMSG_TASK_PRIO=3
CONFIG_WIFI_KMSG_TASK_STACK_SIZE=4096
CONFIG_WIFI_CORE_TASK_PRIO=2
CONFIG_WIFI_CORE_TASK_STACK_SIZE=2048
CONFIG_RWNX_QOS_MSDU=y
# end of WiFi RWNX Interface

# CONFIG_SARADC_CALI is not set
# CONFIG_SPIDMA is not set
CONFIG_TEMP_DETECT=y
# CONFIG_UART_DEBUG is not set
# CONFIG_UDISK_MP3 is not set
# CONFIG_WFA_CA is not set

#
# Supplicant
#
CONFIG_TASK_WPAS_PRIO=5
CONFIG_WPA3=y
CONFIG_WPA_CTRL_IFACE=y
# CONFIG_AP_HT_IE is not set
# CONFIG_WPA_LOG is not set
# end of Supplicant
# end of Components Configuration
# end of ARMINO Configuration

CONFIG_SARADC_RANGE_DIVIDE=y
```

## middleware/soc/bk7235/bk7235.defconfig
```kconfig
#The value config in bk7235.defconfig will over write the Kconfig's default value.
#If the default value in Kconfig satisfy your needs, then you needn't to config again here.

CONFIG_SOC_ARCH="riscv"
CONFIG_SOC_BK7256XX=y
CONFIG_SOC_BK7235=y
CONFIG_SOC_STR="bk7235"

#
# ARMINO Configuration
#

#
# Common Configuration
#

#
# Compile/Build
#
CONFIG_TOOLCHAIN_PATH="/opt/risc-v/nds32le-elf-mculib-v5/bin"
CONFIG_TOOLCHAIN_PREFIX="riscv32-elf-"

#
# Debug
#
CONFIG_DEBUG_FIRMWARE=y
CONFIG_ASSERT_IGNORE=y
# CONFIG_ASSERT_HALT is not set
# CONFIG_ASSERT_REBOOT is not set
# CONFIG_JTAG is not set
# end of Debug
# end of Common Configuration

#
# Features Configuration
#
#CONFIG_LWIP_V2_0 is not set
CONFIG_LWIP_V2_1=y
CONFIG_NO_HOSTED=y
# CONFIG_SEMI_HOSTED is not set
# CONFIG_FULLY_HOSTED is not set
# CONFIG_WIFI_SENSOR is not set
# end of Features Configuration

#
# Components Configuration
#

#
# Application
#
# CONFIG_DEMO_TEST is not set
# CONFIG_FTPD_UPGRADE is not set
CONFIG_OTA_HTTP=y
# CONFIG_OTA_TFTP is not set

# CONFIG_HTTP_OTA_WITH_BLE is not set
CONFIG_HTTP_OTA_WITH_BLE=y
# end of Application

# CONFIG_AT is not set
CONFIG_AT_CMD=y

#
# PSRAM
#
CONFIG_PSRAM=n
# end of PSRAM

CONFIG_MEDIA=y
#
# Audio
#
CONFIG_AUDIO=n
CONFIG_AUDIO_RISCV_IP_V1_0=n
#
# end of Audio

#
# Video
#
CONFIG_LCD=n
CONFIG_DMA2D=n
CONFIG_JPEG_DEC=n
CONFIG_JPEG_ENCODE=y
CONFIG_JPEG_DECODE=n
# end of Video
#

#
# Video transfer
#
CONFIG_CAMERA=y
CONFIG_USE_APP_DEMO_VIDEO_TRANSSER=y
CONFIG_APP_DEMO_VIDEO_TRANSFER=y
CONFIG_NET_WORK_VIDEO_TRANSFER=y
CONFIG_CAMERA_USE_I2C0=y
#CONFIG_WIFI_P2P is not set
#CONFIG_P2P is not set
#CONFIG_P2P_GO is not set
#CONFIG_WIFI_WPS is not set
#CONFIG_WPS is not set
#
#end of Video transfer

# Touch
#
CONFIG_TOUCH=y
#
# end of Touch

#
# Calibration
#
CONFIG_CALI=y
CONFIG_MANUAL_CALI=y
CONFIG_TPC_PA_MAP=y
# end of Calibration

#
# ATE
#
CONFIG_ATE=y
# end of ATE

#
# BLE
#
CONFIG_BLE=y
CONFIG_BLE_5_X=n
CONFIG_BTDM_5_2=y
CONFIG_BT=n
# CONFIG_BLE_4_2 is not set
# end of BLE

#
# Cli
#
CONFIG_CLI=y
CONFIG_BKREG=y
CONFIG_MAX_COMMANDS=320
# CONFIG_TCP_SERVER_TEST is not set
# CONFIG_AIRKISS_TEST is not set
# CONFIG_WIFI_RAW_TX_TEST is not set
# CONFIG_I2C1_TEST is not set
CONFIG_I2C2_TEST=y
# CONFIG_UART_TEST is not set
CONFIG_SPI_TEST=y
CONFIG_PERI_TEST=y
CONFIG_AON_RTC_TEST=y
# CONFIG_RF_OTA_TEST is not set
CONFIG_SHELL_ASYNCLOG=y
CONFIG_AUDIO_TEST=n
CONFIG_AUDIO_AEC_TEST=n
CONFIG_AUDIO_G711_TEST=n
CONFIG_FFT_TEST=n
CONFIG_I2S_TEST=n
# end of Cli

#
# DEMOS_CONFIG
#
CONFIG_LCD_TEST=n
CONFIG_DMA2D_TEST=n
CONFIG_DOORBELL=n
CONFIG_FFT=n
# end of DEMOS_CONFIG

#
# RF
#
CONFIG_RF_POLICY_BLE_REQ=y
# CONFIG_RF_POLICY_WIFI_REQ is not set
# CONFIG_RF_POLICY_CO_REQ is not set
# end of RF

#
# Internal Kconfig
#
CONFIG_CHECK_MISMATCH=y
CONFIG_MCU_PS=y
CONFIG_DEEP_PS=n
CONFIG_TICK_CALI=y
CONFIG_STA_PS=y
# end of Internal Kconfig

#
# FreeRTOS
#
CONFIG_FREERTOS=y
# CONFIG_LITEOS_M is not set
CONFIG_FREERTOS_V9=n
CONFIG_FREERTOS_V10=y

#
# Memory Debug
#
# CONFIG_MALLOC_STATIS is not set
CONFIG_MEM_DEBUG=y
MEM_DEBUG_FUNC_NAME=y
MEM_DEBUG_TASK_NAME=y
# end of Memory Debug
# end of FreeRTOS

#
# Startup
#
CONFIG_APP_MAIN_TASK_PRIO=4
CONFIG_APP_MAIN_TASK_STACK_SIZE=4096
# end of Startup

#
# System
#
# CONFIG_SLAVE_CORE_OFFSET is not set
# CONFIG_SLAVE_CORE_OFFSET is not set
# CONFIG_SLAVE_CORE_RESET_VALUE is not set
# CONFIG_BASE_MAC_FROM_EFUSE is not set
CONFIG_BASE_MAC_FROM_RF_OTP_FLASH=y
# CONFIG_BASE_MAC_FROM_NVS is not set
CONFIG_ARCH_RISCV=y
CONFIG_NEST_INT_SUPPORT=y
# end of System

#
# USB configuration
#
CONFIG_USB=n

#
# USB
#
CONFIG_USB_HOST=n
# CONFIG_USB_DEVICE is not set
# CONFIG_USB1_PORT is not set
#CONFIG_TASK_USB_PRIO=5 is not set
CONFIG_USB_MSD=n
# CONFIG_USB_HID is not set
# CONFIG_USB_CCD is not set
# CONFIG_USB_UVC is not set
# CONFIG_USB_CHARGE is not set
# end of USB configuration

CONFIG_VND_CAL=y
#
# WiFi
#
CONFIG_WIFI_IP_AX=y
CONFIG_WIFI6_CODE_STACK=y
CONFIG_WIFI6=y
CONFIG_WIFI4=y
CONFIG_MSDU_RESV_HEAD_LENGTH=96
CONFIG_MSDU_RESV_TAIL_LENGTH=16
CONFIG_TASK_RECONNECT_PRIO=4
CONFIG_WIFI6_IP_DEBUG=y
CONFIG_WIFI_MAC_VERSION="V21"
CONFIG_WIFI_MDM_VERSION="v30"
CONFIG_WIFI_PLF_VERSION="v31"
CONFIG_MM_PS_SET_LISTEN_INTERVAL_VALUE=30
CONFIG_MOBILE_CONNECT_SAP_STATISTICS=y
CONFIG_HE_MCS_LIMIT_7=y
# CONFIG_AP_MONITOR_COEXIST is not set
# CONFIG_WIFI_FAST_CONNECT is not set
CONFIG_ENABLE_WIFI_DEFAULT_CONNECT=y
# CONFIG_LWIP_FAST_DHCP is not set
# CONFIG_BSSID_CONNECT is not set
# CONFIG_WFA_CERT is not set
# CONFIG_LESS_MEMERY_IN_RWNX is not set
# CONFIG_AP_PROBEREQ_CB is not set
# CONFIG_MM_PS_BASED_ON_LISTEN_INTERVAL is not set
# end of WiFi

CONFIG_BLE_PS=y

#
# BLE 5.x
#
# CONFIG_BLE_HOST_NONE is not set
# CONFIG_BLE_HOST_ZEPHYR is not set
# CONFIG_BLE_MESH_RW is not set
# end of BLE 5.x

CONFIG_MAC_BSSID=y
#
# Driver
#

#
# Watchdog
#
CONFIG_INT_WDT=y
CONFIG_INT_WDT_PERIOD_MS=20000
CONFIG_TASK_WDT=y
CONFIG_TASK_WDT_PERIOD_MS=60000
CONFIG_NMI_WDT_EN=y
# end of Watchdog

#
# UART
#
CONFIG_UART1=y
CONFIG_UART2=y
CONFIG_UART_ATE_PORT=0
#
CONFIG_PRINT_PORT_UART1=y
CONFIG_UART_PRINT_PORT=0
# CONFIG_PRINT_PORT_UART2=y
# CONFIG_UART_PRINT_PORT=1
#
CONFIG_PRINTF_BUF_SIZE=128
# CONFIG_BACKGROUND_PRINT is not set
CONFIG_KFIFO_SIZE=128
# CONFIG_UART_STATIS is not set
CONFIG_UART1_FLOW_CTRL=n
# CONFIG_UART2_FLOW_CTRL is not set
# CONFIG_UART3_FLOW_CTRL is not set
CONFIG_IDLE_UART_OUT_TEST=y
# end of UART

#
# TRNG
#
CONFIG_TRNG_SUPPORT=y
# end of TRNG

#depends on CONFIG_TRNG_SUPPORT
CONFIG_RANDOM_MAC_ADDR=y

CONFIG_MAC_PHY_BYPASS=y

#
# SDCARD
#
CONFIG_SDCARD_HOST=n
CONFIG_SDCARD_BUSWIDTH_4LINE=n
# end of SDCARD

#
# SDIO
#
# CONFIG_SDIO is not set
# end of SDIO

#
# FATFS
#
CONFIG_FATFS=n
# end of FATFS

#
# SPI
#
CONFIG_SPI_DMA=y
CONFIG_SPI_SLAVE=y
CONFIG_SPI_MASTER=y
CONFIG_SPI_STATIS=y
CONFIG_SPI_SUPPORT_TX_FIFO_WR_READY=y
# CONFIG_HSLAVE_SPI is not set
# CONFIG_QSPI is not set
# CONFIG_SPI_MST_FLASH is not set
# CONFIG_SPI_MST_PSRAM is not set
# end of SPI

#
# AON_RTC
#
CONFIG_AON_RTC=y
CONFIG_AON_RTC_MANY_USERS=y
CONFIG_AON_RTC_DEBUG=n
# end of AON_RTC

#
# DMA
#
CONFIG_GENERAL_DMA=y
# end of DMA

#
# System control
#
# CONFIG_SYS_REDUCE_NORMAL_POWER is not set
# CONFIG_XTAL_FREQ_40M is not set
CONFIG_XTAL_FREQ_26M=y
CONFIG_XTAL_FREQ=26000000
CONFIG_DCO_FREQ=120000000
# end of System control

#
# PHY
#
# CONFIG_PTA is not set
# end of PHY

#
# I2S
#
CONFIG_I2S=n
# end of I2S

#
# pwm
#
CONFIG_PWM=y
# end of pwm

#
# mailbox
#
CONFIG_MAILBOX=n
# end of mailbox

# CONFIG_SUPPORT_IRDA is not set
CONFIG_ICU=n
# CONFIG_EASY_FLASH is not set

# end of Driver



#
# LwIP 2.0.2
#
CONFIG_LWIP=y
CONFIG_DHCP=y
CONFIG_TASK_LWIP_PRIO=4
# CONFIG_LWIP_MEM_DEFAULT is not set
CONFIG_LWIP_MEM_REDUCE=y
# end of LwIP 2.0.2

#
# LwIP 2.1.2
#
# end of LwIP 2.1.2

# CONFIG_MP3PLAYER is not set
# CONFIG_PCM_RESAMPLER is not set

#
# Power Save
#
# CONFIG_AP_IDLE is not set
# CONFIG_FAKE_RTC_PS is not set
# CONFIG_PM_MODEM_PWD is not set
# CONFIG_PM_STANDALONE is not set
CONFIG_PM_V2=y
# end of Power Save

#
#GPIO for Power Save: WANIING: modify it should check properties/soc/bk7256/bk7256.defconfig also
#
CONFIG_GPIO_WAKEUP_SUPPORT=y
CONFIG_GPIO_DYNAMIC_WAKEUP_SUPPORT=y
CONFIG_GPIO_WAKEUP_DEBUG=n
CONFIG_GPIO_DYNAMIC_WAKEUP_SOURCE_MAX_CNT=4

#
#GPIO special feature
#
CONFIG_GPIO_SIMULATE_UART_WRITE=y

#
# RF Test
#
CONFIG_TX_EVM_TEST=y
CONFIG_RX_SENSE_TEST=y
# end of RF Test

#
# WiFi RWNX Interface
#
CONFIG_WIFI_KMSG_TASK_PRIO=3
CONFIG_WIFI_KMSG_TASK_STACK_SIZE=4096
CONFIG_WIFI_CORE_TASK_PRIO=2
CONFIG_WIFI_CORE_TASK_STACK_SIZE=2048
CONFIG_RWNX_QOS_MSDU=y
# end of WiFi RWNX Interface

# CONFIG_SPIDMA is not set
CONFIG_TEMP_DETECT=y
CONFIG_SARADC_CALI=y
# CONFIG_UART_DEBUG is not set
# CONFIG_UDISK_MP3 is not set
# CONFIG_WFA_CA is not set

#
# Supplicant
#
CONFIG_TASK_WPAS_PRIO=5
# CONFIG_WPA3 is not set
# CONFIG_PMF is not set
CONFIG_WPA_CTRL_IFACE=y
# CONFIG_AP_HT_IE is not set
CONFIG_COMPONENTS_WPA_TWT_TEST=y
# CONFIG_WPA_LOG is not set
# end of Supplicant
# end of Components Configuration
# end of ARMINO Configuration

#
# system ctrl
#
CONFIG_SYSTEM_CTRL=y
#
# end of system ctrl
#

CONFIG_FLASH_QUAD_ENABLE=y

CONFIG_FLASH_SRC_CLK_60M=y

#
# securityip config
#
CONFIG_SECURITYIP=y
#
# end of securityip config
#



#
# timer
#
CONFIG_TIMER=y
#
#bit[0] ID-0 0x1 bit[1] ID-1 0x2
#if support id0 and id1 set 0x3
#
CONFIG_TIMER_SUPPORT_ID_BITS=63
#
# end of timer
#
CONFIG_AON_PMU=y
CONFIG_POWER_CLOCK_RF=y
CONFIG_FM_I2C=n
CONFIG_SARADC_NEED_FLUSH=n
CONFIG_SARADC_RANGE_DIVIDE=y


#
#mqtt
#
CONFIG_ALI_MQTT=y
CONFIG_PAHO_MQTT=n

#
# midea
#
CONFIG_MIDEA=n

# chip support id
#
#
CONFIG_CHIP_SUPPORT=n

# jtag change group gpio
#
#
CONFIG_CHANGE_JTAG_GPIO=y
```

## middleware/soc/bk7236/Kconfig
```kconfig
menu "bk7236"
	config CPU_WITHOUT_BOOTLOADER
		bool "Build binary for legacy uart download"
		default n

	config ITCM_SIZE
		hex "Total ITCM size"
		default 0x4000

	config DTCM_SIZE
		hex "Total DTCM size"
		default 0x4000

	config SPE_TOTAL_RAM_SIZE
		hex "Total RAM size for SPE"
		default 0x80000

	config NSPE_TOTAL_RAM_SIZE
		hex "Total RAM size for NSPE"
		default 0x40000

	config PRIMARY_APP_IRAM_SIZE
		hex "Primary app IRAM size"
		default 0x2000

	config PRIMARY_APP_NOCACHE_SIZE
		hex "Primary app NOCACHE size"
		default 0x14000

	config SECOND_APP_RAM_SIZE
		hex "Second app RAM size"
		default 0x00000

	config ANA_REG_WRITE_POLL_REG_B
		bool "Write analog register polls sys reg0xb"
		default y

	config PM_HAL_DEBUG
		bool "Enable PM hal debug"
		default n

	config PM_HAL_CTRL
		bool "Enable PM hal debug"
		default n
endmenu
```
