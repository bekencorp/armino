/* This file is generated by nds_ldsag (version (2021-12-20) ). */
ENTRY(_start)
SECTIONS
{
	PROVIDE (__executable_start = 0x00010000);
	NDS_SAG_LMA_CPU0_LOAD1 = 0x00010000 ;
	CPU0_LOAD1_BEGIN = NDS_SAG_LMA_CPU0_LOAD1;
	. = 0x00010000;
	FLASH1_BEGIN = .;
	. = ALIGN(ALIGNOF(.nds_vector));
	.nds_vector 	: { KEEP(*(.nds_vector )) KEEP(*(SORT(.nds_vector.* ))) }
	FLASH1_SIZE = . - FLASH1_BEGIN;
	. = 0x10000000;
	ITCM_BEGIN = .;
	. = ALIGN(8);
	. = ALIGN(ALIGNOF(".init_*txl_he.c.obj"));
	".init_*txl_he.c.obj" 	: AT(ALIGN(ALIGN(LOADADDR (.nds_vector) + SIZEOF (.nds_vector), ALIGNOF(".init_*txl_he.c.obj")), 8))
		{ KEEP(*txl_he.c.obj(.init )) }
	_itcm_lma_start =  LOADADDR (".init_*txl_he.c.obj");
	_itcm_ema_start = ADDR(".init_*txl_he.c.obj");
	. = ALIGN(ALIGNOF(".text_*txl_he.c.obj"));
	".text_*txl_he.c.obj" 	: AT(ALIGN(LOADADDR (".init_*txl_he.c.obj") + SIZEOF (".init_*txl_he.c.obj"), ALIGNOF(".text_*txl_he.c.obj")))
		{ *txl_he.c.obj(.text .stub .text.* .gnu.linkonce.t.* ) KEEP(*txl_he.c.obj(.text.*personality* )) *txl_he.c.obj(.gnu.warning ) . = ALIGN(4); } = 0x0100
	. = ALIGN(ALIGNOF(".fini_*txl_he.c.obj"));
	".fini_*txl_he.c.obj" 	: AT(ALIGN(LOADADDR (".text_*txl_he.c.obj") + SIZEOF (".text_*txl_he.c.obj"), ALIGNOF(".fini_*txl_he.c.obj")))
		{ KEEP(*txl_he.c.obj(.fini )) }
	. = ALIGN(ALIGNOF(".exec.itable_*txl_he.c.obj"));
	".exec.itable_*txl_he.c.obj" 	: AT(ALIGN(LOADADDR (".fini_*txl_he.c.obj") + SIZEOF (".fini_*txl_he.c.obj"), ALIGNOF(".exec.itable_*txl_he.c.obj")))
		{ *txl_he.c.obj(.exec.itable ) }
	PROVIDE (__etext = .);
	PROVIDE (_etext = .);
	PROVIDE (etext = .);
	. = ALIGN(8);
	. = ALIGN(ALIGNOF(".init_*txl_agg.c.obj"));
	".init_*txl_agg.c.obj" 	: AT(ALIGN(ALIGN(LOADADDR (".exec.itable_*txl_he.c.obj") + SIZEOF (".exec.itable_*txl_he.c.obj"), ALIGNOF(".init_*txl_agg.c.obj")), 8))
		{ KEEP(*txl_agg.c.obj(.init )) }
	. = ALIGN(ALIGNOF(".text_*txl_agg.c.obj"));
	".text_*txl_agg.c.obj" 	: AT(ALIGN(LOADADDR (".init_*txl_agg.c.obj") + SIZEOF (".init_*txl_agg.c.obj"), ALIGNOF(".text_*txl_agg.c.obj")))
		{ *txl_agg.c.obj(.text .stub .text.* .gnu.linkonce.t.* ) KEEP(*txl_agg.c.obj(.text.*personality* )) *txl_agg.c.obj(.gnu.warning ) . = ALIGN(4); } = 0x0100
	. = ALIGN(ALIGNOF(".fini_*txl_agg.c.obj"));
	".fini_*txl_agg.c.obj" 	: AT(ALIGN(LOADADDR (".text_*txl_agg.c.obj") + SIZEOF (".text_*txl_agg.c.obj"), ALIGNOF(".fini_*txl_agg.c.obj")))
		{ KEEP(*txl_agg.c.obj(.fini )) }
	. = ALIGN(ALIGNOF(".exec.itable_*txl_agg.c.obj"));
	".exec.itable_*txl_agg.c.obj" 	: AT(ALIGN(LOADADDR (".fini_*txl_agg.c.obj") + SIZEOF (".fini_*txl_agg.c.obj"), ALIGNOF(".exec.itable_*txl_agg.c.obj")))
		{ *txl_agg.c.obj(.exec.itable ) }
	PROVIDE (__etext = .);
	PROVIDE (_etext = .);
	PROVIDE (etext = .);
	. = ALIGN(8);
	. = ALIGN(ALIGNOF(".init_*txl_cfm.c.obj"));
	".init_*txl_cfm.c.obj" 	: AT(ALIGN(ALIGN(LOADADDR (".exec.itable_*txl_agg.c.obj") + SIZEOF (".exec.itable_*txl_agg.c.obj"), ALIGNOF(".init_*txl_cfm.c.obj")), 8))
		{ KEEP(*txl_cfm.c.obj(.init )) }
	. = ALIGN(ALIGNOF(".text_*txl_cfm.c.obj"));
	".text_*txl_cfm.c.obj" 	: AT(ALIGN(LOADADDR (".init_*txl_cfm.c.obj") + SIZEOF (".init_*txl_cfm.c.obj"), ALIGNOF(".text_*txl_cfm.c.obj")))
		{ *txl_cfm.c.obj(.text .stub .text.* .gnu.linkonce.t.* ) KEEP(*txl_cfm.c.obj(.text.*personality* )) *txl_cfm.c.obj(.gnu.warning ) . = ALIGN(4); } = 0x0100
	. = ALIGN(ALIGNOF(".fini_*txl_cfm.c.obj"));
	".fini_*txl_cfm.c.obj" 	: AT(ALIGN(LOADADDR (".text_*txl_cfm.c.obj") + SIZEOF (".text_*txl_cfm.c.obj"), ALIGNOF(".fini_*txl_cfm.c.obj")))
		{ KEEP(*txl_cfm.c.obj(.fini )) }
	. = ALIGN(ALIGNOF(".exec.itable_*txl_cfm.c.obj"));
	".exec.itable_*txl_cfm.c.obj" 	: AT(ALIGN(LOADADDR (".fini_*txl_cfm.c.obj") + SIZEOF (".fini_*txl_cfm.c.obj"), ALIGNOF(".exec.itable_*txl_cfm.c.obj")))
		{ *txl_cfm.c.obj(.exec.itable ) }
	PROVIDE (__etext = .);
	PROVIDE (_etext = .);
	PROVIDE (etext = .);
	. = ALIGN(8);
	. = ALIGN(ALIGNOF(".init_*txl_cntrl.c.obj"));
	".init_*txl_cntrl.c.obj" 	: AT(ALIGN(ALIGN(LOADADDR (".exec.itable_*txl_cfm.c.obj") + SIZEOF (".exec.itable_*txl_cfm.c.obj"), ALIGNOF(".init_*txl_cntrl.c.obj")), 8))
		{ KEEP(*txl_cntrl.c.obj(.init )) KEEP(*rxl_hwdesc.c.obj(.init )) KEEP(*rxu_cntrl.c.obj(.init )) }
	. = ALIGN(ALIGNOF(".text_*txl_cntrl.c.obj"));
	".text_*txl_cntrl.c.obj" 	: AT(ALIGN(LOADADDR (".init_*txl_cntrl.c.obj") + SIZEOF (".init_*txl_cntrl.c.obj"), ALIGNOF(".text_*txl_cntrl.c.obj")))
		{ *txl_cntrl.c.obj(.text .stub .text.* .gnu.linkonce.t.* ) *rxl_hwdesc.c.obj(.text .stub .text.* .gnu.linkonce.t.* ) *rxu_cntrl.c.obj(.text .stub .text.* .gnu.linkonce.t.* ) KEEP(*txl_cntrl.c.obj(.text.*personality* )) KEEP(*rxl_hwdesc.c.obj(.text.*personality* )) KEEP(*rxu_cntrl.c.obj(.text.*personality* )) *txl_cntrl.c.obj(.gnu.warning ) *rxl_hwdesc.c.obj(.gnu.warning ) *rxu_cntrl.c.obj(.gnu.warning ) . = ALIGN(4); } = 0x0100
	. = ALIGN(ALIGNOF(".fini_*txl_cntrl.c.obj"));
	".fini_*txl_cntrl.c.obj" 	: AT(ALIGN(LOADADDR (".text_*txl_cntrl.c.obj") + SIZEOF (".text_*txl_cntrl.c.obj"), ALIGNOF(".fini_*txl_cntrl.c.obj")))
		{ KEEP(*txl_cntrl.c.obj(.fini )) KEEP(*rxl_hwdesc.c.obj(.fini )) KEEP(*rxu_cntrl.c.obj(.fini )) }
	. = ALIGN(ALIGNOF(".exec.itable_*txl_cntrl.c.obj"));
	".exec.itable_*txl_cntrl.c.obj" 	: AT(ALIGN(LOADADDR (".fini_*txl_cntrl.c.obj") + SIZEOF (".fini_*txl_cntrl.c.obj"), ALIGNOF(".exec.itable_*txl_cntrl.c.obj")))
		{ *txl_cntrl.c.obj(.exec.itable ) *rxl_hwdesc.c.obj(.exec.itable ) *rxu_cntrl.c.obj(.exec.itable ) }
	PROVIDE (__etext = .);
	PROVIDE (_etext = .);
	PROVIDE (etext = .);
	.itcm_sec_code 	: AT(LOADADDR (".exec.itable_*txl_cntrl.c.obj") + SIZEOF (".exec.itable_*txl_cntrl.c.obj"))
		{ KEEP(*(.itcm_sec_code )) }
	_itcm_lma_end =  LOADADDR (.itcm_sec_code) + SIZEOF (.itcm_sec_code);
	_itcm_ema_end = .;
	ITCM_SIZE = . - ITCM_BEGIN;
	CPU0_LOAD1_SIZE = LOADADDR(.itcm_sec_code) + SIZEOF(.itcm_sec_code) - CPU0_LOAD1_BEGIN;
	NDS_SAG_LMA_CPU0_LOAD2 = 0x00018800 ;
	CPU0_LOAD2_BEGIN = NDS_SAG_LMA_CPU0_LOAD2;
	. = 0 + NDS_SAG_LMA_CPU0_LOAD2;
	.interrupt.text .	: AT(NDS_SAG_LMA_CPU0_LOAD2)	{ KEEP(*(.interrupt.text )) }
	.interrupt.HalTrapVector.text.HalTrapVector 	: AT(LOADADDR (.interrupt.text) + SIZEOF (.interrupt.text))
		{ KEEP(*(.interrupt.HalTrapVector.text.HalTrapVector )) }
	.itcm 	: AT(LOADADDR (.interrupt.HalTrapVector.text.HalTrapVector) + SIZEOF (.interrupt.HalTrapVector.text.HalTrapVector))
		{ KEEP(*(.itcm )) }
	. = ALIGN(8);
	. = ALIGN(ALIGNOF(.interp));
	.interp 	: AT(ALIGN(ALIGN(LOADADDR (.itcm) + SIZEOF (.itcm), ALIGNOF(.interp)), 8))
		{ *(.interp ) }
	. = ALIGN(ALIGNOF(.note.gnu.build-id));
	.note.gnu.build-id 	: AT(ALIGN(LOADADDR (.interp) + SIZEOF (.interp), ALIGNOF(.note.gnu.build-id)))
		{ *(.note.gnu.build-id ) }
	. = ALIGN(ALIGNOF(.note.ABI-tag));
	.note.ABI-tag 	: AT(ALIGN(LOADADDR (.note.gnu.build-id) + SIZEOF (.note.gnu.build-id), ALIGNOF(.note.ABI-tag)))
		{ *(.note.ABI-tag ) }
	. = ALIGN(ALIGNOF(.hash));
	.hash 	: AT(ALIGN(LOADADDR (.note.ABI-tag) + SIZEOF (.note.ABI-tag), ALIGNOF(.hash)))
		{ *(.hash ) }
	. = ALIGN(ALIGNOF(.gnu.hash));
	.gnu.hash 	: AT(ALIGN(LOADADDR (.hash) + SIZEOF (.hash), ALIGNOF(.gnu.hash)))
		{ *(.gnu.hash ) }
	. = ALIGN(ALIGNOF(.dynsym));
	.dynsym 	: AT(ALIGN(LOADADDR (.gnu.hash) + SIZEOF (.gnu.hash), ALIGNOF(.dynsym)))
		{ *(.dynsym ) }
	. = ALIGN(ALIGNOF(.dynstr));
	.dynstr 	: AT(ALIGN(LOADADDR (.dynsym) + SIZEOF (.dynsym), ALIGNOF(.dynstr)))
		{ *(.dynstr ) }
	. = ALIGN(ALIGNOF(.gnu.version));
	.gnu.version 	: AT(ALIGN(LOADADDR (.dynstr) + SIZEOF (.dynstr), ALIGNOF(.gnu.version)))
		{ *(.gnu.version ) }
	. = ALIGN(ALIGNOF(.gnu.version_d));
	.gnu.version_d 	: AT(ALIGN(LOADADDR (.gnu.version) + SIZEOF (.gnu.version), ALIGNOF(.gnu.version_d)))
		{ *(.gnu.version_d ) }
	. = ALIGN(ALIGNOF(.gnu.version_r));
	.gnu.version_r 	: AT(ALIGN(LOADADDR (.gnu.version_d) + SIZEOF (.gnu.version_d), ALIGNOF(.gnu.version_r)))
		{ *(.gnu.version_r ) }
	. = ALIGN(ALIGNOF(.rela.init));
	.rela.init 	: AT(ALIGN(LOADADDR (.gnu.version_r) + SIZEOF (.gnu.version_r), ALIGNOF(.rela.init)))
		{ *(.rela.init ) }
	. = ALIGN(ALIGNOF(.rela.text));
	.rela.text 	: AT(ALIGN(LOADADDR (.rela.init) + SIZEOF (.rela.init), ALIGNOF(.rela.text)))
		{ *(.rela.text .rela.text.* .rela.gnu.linkonce.t.* ) }
	. = ALIGN(ALIGNOF(.rela.fini));
	.rela.fini 	: AT(ALIGN(LOADADDR (.rela.text) + SIZEOF (.rela.text), ALIGNOF(.rela.fini)))
		{ *(.rela.fini ) }
	. = ALIGN(ALIGNOF(.rela.rodata));
	.rela.rodata 	: AT(ALIGN(LOADADDR (.rela.fini) + SIZEOF (.rela.fini), ALIGNOF(.rela.rodata)))
		{ *(.rela.rodata .rela.rodata.* .rela.gnu.linkonce.r.* ) }
	. = ALIGN(ALIGNOF(.rela.data.rel.ro));
	.rela.data.rel.ro 	: AT(ALIGN(LOADADDR (.rela.rodata) + SIZEOF (.rela.rodata), ALIGNOF(.rela.data.rel.ro)))
		{ *(.rel.data.rel.ro* ) }
	. = ALIGN(ALIGNOF(.rela.data));
	.rela.data 	: AT(ALIGN(LOADADDR (.rela.data.rel.ro) + SIZEOF (.rela.data.rel.ro), ALIGNOF(.rela.data)))
		{ *(.rela.data .rela.data.* .rela.gnu.linkonce.d.* ) }
	. = ALIGN(ALIGNOF(.rela.tdata));
	.rela.tdata 	: AT(ALIGN(LOADADDR (.rela.data) + SIZEOF (.rela.data), ALIGNOF(.rela.tdata)))
		{ *(.rela.tdata .rela.tdata.* .rela.gnu.linkonce.td.* ) }
	. = ALIGN(ALIGNOF(.rela.tbss));
	.rela.tbss 	: AT(ALIGN(LOADADDR (.rela.tdata) + SIZEOF (.rela.tdata), ALIGNOF(.rela.tbss)))
		{ *(.rela.tbss .rela.tbss.* .rela.gnu.linkonce.tb.* ) }
	. = ALIGN(ALIGNOF(.rela.ctors));
	.rela.ctors 	: AT(ALIGN(LOADADDR (.rela.tbss) + SIZEOF (.rela.tbss), ALIGNOF(.rela.ctors)))
		{ *(.rela.ctors ) }
	. = ALIGN(ALIGNOF(.rela.dtors));
	.rela.dtors 	: AT(ALIGN(LOADADDR (.rela.ctors) + SIZEOF (.rela.ctors), ALIGNOF(.rela.dtors)))
		{ *(.rela.dtors ) }
	. = ALIGN(ALIGNOF(.rela.dyn));
	.rela.dyn 	: AT(ALIGN(LOADADDR (.rela.dtors) + SIZEOF (.rela.dtors), ALIGNOF(.rela.dyn)))
		{ *(rela.dyn ) *(.rela__libc_subfreeres ) *(.rela__libc_atexit ) *(.rela__libc_thread_subfreeres ) *(.rela.init_array ) *(.rela.fini_array ) }
	. = ALIGN(ALIGNOF(.rela.got));
	.rela.got 	: AT(ALIGN(LOADADDR (.rela.dyn) + SIZEOF (.rela.dyn), ALIGNOF(.rela.got)))
		{ *(.rela.got ) }
	. = ALIGN(ALIGNOF(.rela.sdata));
	.rela.sdata 	: AT(ALIGN(LOADADDR (.rela.got) + SIZEOF (.rela.got), ALIGNOF(.rela.sdata)))
		{ *(.rela.sdata .rela.sdata.* .rela.gnu.linkonce.s.* ) }
	. = ALIGN(ALIGNOF(.rela.sbss));
	.rela.sbss 	: AT(ALIGN(LOADADDR (.rela.sdata) + SIZEOF (.rela.sdata), ALIGNOF(.rela.sbss)))
		{ *(.rela.sbss .rela.sbss.* .rela.gnu.linkonce.sb.* ) }
	. = ALIGN(ALIGNOF(.rela.sdata2));
	.rela.sdata2 	: AT(ALIGN(LOADADDR (.rela.sbss) + SIZEOF (.rela.sbss), ALIGNOF(.rela.sdata2)))
		{ *(.rela.sdata2 .rela.sdata2.* .rela.gnu.linkonce.s2.* ) }
	. = ALIGN(ALIGNOF(.rela.sbss2));
	.rela.sbss2 	: AT(ALIGN(LOADADDR (.rela.sdata2) + SIZEOF (.rela.sdata2), ALIGNOF(.rela.sbss2)))
		{ *(.rela.sbss2 .rela.sbss2.* .rela.gnu.linkonce.sb2.* ) }
	. = ALIGN(ALIGNOF(.rela.bss));
	.rela.bss 	: AT(ALIGN(LOADADDR (.rela.sbss2) + SIZEOF (.rela.sbss2), ALIGNOF(.rela.bss)))
		{ *(.rela.bss .rela.bss.* .rela.gnu.linkonce.b.* ) }
	. = ALIGN(ALIGNOF(.rela.plt));
	.rela.plt 	: AT(ALIGN(LOADADDR (.rela.bss) + SIZEOF (.rela.bss), ALIGNOF(.rela.plt)))
		{ *(.rela.plt ) }
	. = ALIGN(ALIGNOF(.init));
	.init 	: AT(ALIGN(LOADADDR (.rela.plt) + SIZEOF (.rela.plt), ALIGNOF(.init)))
		{ KEEP(*(.init )) }
	. = ALIGN(ALIGNOF(.text));
	.text 	: AT(ALIGN(LOADADDR (.init) + SIZEOF (.init), ALIGNOF(.text)))
		{ *(.text .stub .text.* .gnu.linkonce.t.* ) KEEP(*(.text.*personality* )) *(.gnu.warning ) . = ALIGN(4); } = 0x0100
	. = ALIGN(ALIGNOF(.fini));
	.fini 	: AT(ALIGN(LOADADDR (.text) + SIZEOF (.text), ALIGNOF(.fini)))
		{ KEEP(*(.fini )) }
	. = ALIGN(ALIGNOF(.exec.itable));
	.exec.itable 	: AT(ALIGN(LOADADDR (.fini) + SIZEOF (.fini), ALIGNOF(.exec.itable)))
		{ *(.exec.itable ) }
	PROVIDE (__etext = .);
	PROVIDE (_etext = .);
	PROVIDE (etext = .);
	. = ALIGN(ALIGNOF(.rodata));
	.rodata 	: AT(ALIGN(LOADADDR (.exec.itable) + SIZEOF (.exec.itable), ALIGNOF(.rodata)))
		{ *(.rodata .rodata.* .gnu.linkonce.r.* ) }
	. = ALIGN(ALIGNOF(.rodata1));
	.rodata1 	: AT(ALIGN(LOADADDR (.rodata) + SIZEOF (.rodata), ALIGNOF(.rodata1)))
		{ *(.rodata1 ) }
	. = ALIGN(ALIGNOF(.sdata2));
	.sdata2 	: AT(ALIGN(LOADADDR (.rodata1) + SIZEOF (.rodata1), ALIGNOF(.sdata2)))
		{ *(.sdata2 .sdata2.* .gnu.linkonce.s2.* ) }
	. = ALIGN(ALIGNOF(.sbss2));
	.sbss2 	: AT(ALIGN(LOADADDR (.sdata2) + SIZEOF (.sdata2), ALIGNOF(.sbss2)))
		{ *(.sbss2 .sbss2.* .gnu.linkonce.sb2.* ) }
	. = ALIGN(ALIGNOF(.eh_frame_hdr));
	.eh_frame_hdr 	: AT(ALIGN(LOADADDR (.sbss2) + SIZEOF (.sbss2), ALIGNOF(.eh_frame_hdr)))
		{ *(.eh_frame_hdr ) }
	. = 0x20000000;
	DTCM_BEGIN = .;
	.dtcm_sec_data 	: AT(LOADADDR (.eh_frame_hdr) + SIZEOF (.eh_frame_hdr))
		{ KEEP(*(.dtcm_sec_data )) }
	_dtcm_lma_start =  LOADADDR (.dtcm_sec_data);
	_dtcm_ema_start = ADDR(.dtcm_sec_data);
	"*data*_*bam.c.obj" 	: AT(LOADADDR (.dtcm_sec_data) + SIZEOF (.dtcm_sec_data))
		{ *bam.c.obj(*data* ) *ke_env.c.obj(*data* ) *hal_dma.c.obj(*data* ) *hal_machw.c.obj(*data* ) *txu_cntrl.c.obj(*data* ) *bam_task.c.obj(*data* ) }
	"*data*_*rxl_cntrl.c.obj" 	: AT(LOADADDR ("*data*_*bam.c.obj") + SIZEOF ("*data*_*bam.c.obj"))
		{ *rxl_cntrl.c.obj(*data* ) *tx_swdesc.c.obj(*data* ) *txl_cfm.c.obj(*data* ) *txl_cntrl.c.obj(*data* ) }
	"*data*_*sta_mgmt.c.obj" 	: AT(LOADADDR ("*data*_*rxl_cntrl.c.obj") + SIZEOF ("*data*_*rxl_cntrl.c.obj"))
		{ *sta_mgmt.c.obj(*data* ) *vif_mgmt.c.obj(*data* ) *rc.c.obj(*data* ) *rwnx.c.obj(*data* ) *me_task.c.obj(*data* ) *sm.c.obj(*data* ) }
	"*data*_*sm_task.c.obj" 	: AT(LOADADDR ("*data*_*sta_mgmt.c.obj") + SIZEOF ("*data*_*sta_mgmt.c.obj"))
		{ *sm_task.c.obj(*data* ) *me.c.obj(*data* ) *mm.c.obj(*data* ) *mm_bcn.c.obj(*data* ) *mm_task.c.obj(*data* ) *mm_timer.c.obj(*data* ) }
	"*data*_*td.c.obj" 	: AT(LOADADDR ("*data*_*sm_task.c.obj") + SIZEOF ("*data*_*sm_task.c.obj"))
		{ *td.c.obj(*data* ) *chan.c.obj(*data* ) *ps.c.obj(*data* ) }
	"*data*_*scan_task.c.obj" 	: AT(LOADADDR ("*data*_*td.c.obj") + SIZEOF ("*data*_*td.c.obj"))
		{ *scan_task.c.obj(*data* ) *scan.c.obj(*data* ) *scanu.c.obj(*data* ) *scanu_task.c.obj(*data* ) }
	_dtcm_lma_end =  LOADADDR ("*data*_*scan_task.c.obj") + SIZEOF ("*data*_*scan_task.c.obj");
	_dtcm_ema_end = .;
	_dtcm_bss_start = .;
	.dtcm_sec_bss 	: AT(LOADADDR ("*data*_*scan_task.c.obj") + SIZEOF ("*data*_*scan_task.c.obj"))
		{ KEEP(*(.dtcm_sec_bss )) }
	. = ALIGN(8);
	__bss_start = .;
	PROVIDE (__sbss_start = .);
	PROVIDE (___sbss_start = .);
	".tbss_*bam.c.obj" 	(NOLOAD)	: { *bam.c.obj(.tbss .tbss.* .gnu.linkonce.tb.* ) *ke_env.c.obj(.tbss .tbss.* .gnu.linkonce.tb.* ) *hal_dma.c.obj(.tbss .tbss.* .gnu.linkonce.tb.* ) *hal_machw.c.obj(.tbss .tbss.* .gnu.linkonce.tb.* ) *txu_cntrl.c.obj(.tbss .tbss.* .gnu.linkonce.tb.* ) *bam_task.c.obj(.tbss .tbss.* .gnu.linkonce.tb.* ) *bam.c.obj(.tcommon ) *ke_env.c.obj(.tcommon ) *hal_dma.c.obj(.tcommon ) *hal_machw.c.obj(.tcommon ) *txu_cntrl.c.obj(.tcommon ) *bam_task.c.obj(.tcommon ) }
	".sbss_*bam.c.obj" 	(NOLOAD)	: { *bam.c.obj(.dynsbss ) *ke_env.c.obj(.dynsbss ) *hal_dma.c.obj(.dynsbss ) *hal_machw.c.obj(.dynsbss ) *txu_cntrl.c.obj(.dynsbss ) *bam_task.c.obj(.dynsbss ) *bam.c.obj(.sbss .sbss.* .gnu.linkonce.sb.* ) *ke_env.c.obj(.sbss .sbss.* .gnu.linkonce.sb.* ) *hal_dma.c.obj(.sbss .sbss.* .gnu.linkonce.sb.* ) *hal_machw.c.obj(.sbss .sbss.* .gnu.linkonce.sb.* ) *txu_cntrl.c.obj(.sbss .sbss.* .gnu.linkonce.sb.* ) *bam_task.c.obj(.sbss .sbss.* .gnu.linkonce.sb.* ) *bam.c.obj(.scommon .scommon.* ) *ke_env.c.obj(.scommon .scommon.* ) *hal_dma.c.obj(.scommon .scommon.* ) *hal_machw.c.obj(.scommon .scommon.* ) *txu_cntrl.c.obj(.scommon .scommon.* ) *bam_task.c.obj(.scommon .scommon.* ) }
	".sbss_f_*bam.c.obj" 	(NOLOAD)	: { *bam.c.obj(.sbss_f .sbss_f.* ) *ke_env.c.obj(.sbss_f .sbss_f.* ) *hal_dma.c.obj(.sbss_f .sbss_f.* ) *hal_machw.c.obj(.sbss_f .sbss_f.* ) *txu_cntrl.c.obj(.sbss_f .sbss_f.* ) *bam_task.c.obj(.sbss_f .sbss_f.* ) *bam.c.obj(.scommon_f .scommon_f.* ) *ke_env.c.obj(.scommon_f .scommon_f.* ) *hal_dma.c.obj(.scommon_f .scommon_f.* ) *hal_machw.c.obj(.scommon_f .scommon_f.* ) *txu_cntrl.c.obj(.scommon_f .scommon_f.* ) *bam_task.c.obj(.scommon_f .scommon_f.* ) }
	".sbss_b_*bam.c.obj" 	(NOLOAD)	: { *bam.c.obj(.sbss_b .sbss_b.* ) *ke_env.c.obj(.sbss_b .sbss_b.* ) *hal_dma.c.obj(.sbss_b .sbss_b.* ) *hal_machw.c.obj(.sbss_b .sbss_b.* ) *txu_cntrl.c.obj(.sbss_b .sbss_b.* ) *bam_task.c.obj(.sbss_b .sbss_b.* ) *bam.c.obj(.scommon_b .scommon_b.* ) *ke_env.c.obj(.scommon_b .scommon_b.* ) *hal_dma.c.obj(.scommon_b .scommon_b.* ) *hal_machw.c.obj(.scommon_b .scommon_b.* ) *txu_cntrl.c.obj(.scommon_b .scommon_b.* ) *bam_task.c.obj(.scommon_b .scommon_b.* ) . = ALIGN(2); }
	".sbss_h_*bam.c.obj" 	(NOLOAD)	: { *bam.c.obj(.sbss_h .sbss_h.* ) *ke_env.c.obj(.sbss_h .sbss_h.* ) *hal_dma.c.obj(.sbss_h .sbss_h.* ) *hal_machw.c.obj(.sbss_h .sbss_h.* ) *txu_cntrl.c.obj(.sbss_h .sbss_h.* ) *bam_task.c.obj(.sbss_h .sbss_h.* ) *bam.c.obj(.scommon_h .scommon_h.* ) *ke_env.c.obj(.scommon_h .scommon_h.* ) *hal_dma.c.obj(.scommon_h .scommon_h.* ) *hal_machw.c.obj(.scommon_h .scommon_h.* ) *txu_cntrl.c.obj(.scommon_h .scommon_h.* ) *bam_task.c.obj(.scommon_h .scommon_h.* ) . = ALIGN(4); }
	".sbss_w_*bam.c.obj" 	(NOLOAD)	: { *bam.c.obj(.sbss_w .sbss_w.* ) *ke_env.c.obj(.sbss_w .sbss_w.* ) *hal_dma.c.obj(.sbss_w .sbss_w.* ) *hal_machw.c.obj(.sbss_w .sbss_w.* ) *txu_cntrl.c.obj(.sbss_w .sbss_w.* ) *bam_task.c.obj(.sbss_w .sbss_w.* ) *bam.c.obj(.scommon_w .scommon_w.* ) *ke_env.c.obj(.scommon_w .scommon_w.* ) *hal_dma.c.obj(.scommon_w .scommon_w.* ) *hal_machw.c.obj(.scommon_w .scommon_w.* ) *txu_cntrl.c.obj(.scommon_w .scommon_w.* ) *bam_task.c.obj(.scommon_w .scommon_w.* ) *bam.c.obj(.dynsbss ) *ke_env.c.obj(.dynsbss ) *hal_dma.c.obj(.dynsbss ) *hal_machw.c.obj(.dynsbss ) *txu_cntrl.c.obj(.dynsbss ) *bam_task.c.obj(.dynsbss ) *bam.c.obj(.scommon ) *ke_env.c.obj(.scommon ) *hal_dma.c.obj(.scommon ) *hal_machw.c.obj(.scommon ) *txu_cntrl.c.obj(.scommon ) *bam_task.c.obj(.scommon ) . = ALIGN(8); }
	".sbss_d_*bam.c.obj" 	(NOLOAD)	: { *bam.c.obj(.sbss_d .sbss_d.* ) *ke_env.c.obj(.sbss_d .sbss_d.* ) *hal_dma.c.obj(.sbss_d .sbss_d.* ) *hal_machw.c.obj(.sbss_d .sbss_d.* ) *txu_cntrl.c.obj(.sbss_d .sbss_d.* ) *bam_task.c.obj(.sbss_d .sbss_d.* ) *bam.c.obj(.scommon_d .scommon_d.* ) *ke_env.c.obj(.scommon_d .scommon_d.* ) *hal_dma.c.obj(.scommon_d .scommon_d.* ) *hal_machw.c.obj(.scommon_d .scommon_d.* ) *txu_cntrl.c.obj(.scommon_d .scommon_d.* ) *bam_task.c.obj(.scommon_d .scommon_d.* ) }
	".bss_*bam.c.obj" 	(NOLOAD)	: { *bam.c.obj(.dynbss ) *ke_env.c.obj(.dynbss ) *hal_dma.c.obj(.dynbss ) *hal_machw.c.obj(.dynbss ) *txu_cntrl.c.obj(.dynbss ) *bam_task.c.obj(.dynbss ) *bam.c.obj(.bss .bss.* .gnu.linkonce.b.* ) *ke_env.c.obj(.bss .bss.* .gnu.linkonce.b.* ) *hal_dma.c.obj(.bss .bss.* .gnu.linkonce.b.* ) *hal_machw.c.obj(.bss .bss.* .gnu.linkonce.b.* ) *txu_cntrl.c.obj(.bss .bss.* .gnu.linkonce.b.* ) *bam_task.c.obj(.bss .bss.* .gnu.linkonce.b.* ) *bam.c.obj(COMMON ) *ke_env.c.obj(COMMON ) *hal_dma.c.obj(COMMON ) *hal_machw.c.obj(COMMON ) *txu_cntrl.c.obj(COMMON ) *bam_task.c.obj(COMMON ) . = ALIGN(8); }
	. = ALIGN(8);
	".tbss_*rxl_cntrl.c.obj" 	(NOLOAD)	: { *rxl_cntrl.c.obj(.tbss .tbss.* .gnu.linkonce.tb.* ) *tx_swdesc.c.obj(.tbss .tbss.* .gnu.linkonce.tb.* ) *txl_cfm.c.obj(.tbss .tbss.* .gnu.linkonce.tb.* ) *txl_cntrl.c.obj(.tbss .tbss.* .gnu.linkonce.tb.* ) *rxl_cntrl.c.obj(.tcommon ) *tx_swdesc.c.obj(.tcommon ) *txl_cfm.c.obj(.tcommon ) *txl_cntrl.c.obj(.tcommon ) }
	".sbss_*rxl_cntrl.c.obj" 	(NOLOAD)	: { *rxl_cntrl.c.obj(.dynsbss ) *tx_swdesc.c.obj(.dynsbss ) *txl_cfm.c.obj(.dynsbss ) *txl_cntrl.c.obj(.dynsbss ) *rxl_cntrl.c.obj(.sbss .sbss.* .gnu.linkonce.sb.* ) *tx_swdesc.c.obj(.sbss .sbss.* .gnu.linkonce.sb.* ) *txl_cfm.c.obj(.sbss .sbss.* .gnu.linkonce.sb.* ) *txl_cntrl.c.obj(.sbss .sbss.* .gnu.linkonce.sb.* ) *rxl_cntrl.c.obj(.scommon .scommon.* ) *tx_swdesc.c.obj(.scommon .scommon.* ) *txl_cfm.c.obj(.scommon .scommon.* ) *txl_cntrl.c.obj(.scommon .scommon.* ) }
	".sbss_f_*rxl_cntrl.c.obj" 	(NOLOAD)	: { *rxl_cntrl.c.obj(.sbss_f .sbss_f.* ) *tx_swdesc.c.obj(.sbss_f .sbss_f.* ) *txl_cfm.c.obj(.sbss_f .sbss_f.* ) *txl_cntrl.c.obj(.sbss_f .sbss_f.* ) *rxl_cntrl.c.obj(.scommon_f .scommon_f.* ) *tx_swdesc.c.obj(.scommon_f .scommon_f.* ) *txl_cfm.c.obj(.scommon_f .scommon_f.* ) *txl_cntrl.c.obj(.scommon_f .scommon_f.* ) }
	".sbss_b_*rxl_cntrl.c.obj" 	(NOLOAD)	: { *rxl_cntrl.c.obj(.sbss_b .sbss_b.* ) *tx_swdesc.c.obj(.sbss_b .sbss_b.* ) *txl_cfm.c.obj(.sbss_b .sbss_b.* ) *txl_cntrl.c.obj(.sbss_b .sbss_b.* ) *rxl_cntrl.c.obj(.scommon_b .scommon_b.* ) *tx_swdesc.c.obj(.scommon_b .scommon_b.* ) *txl_cfm.c.obj(.scommon_b .scommon_b.* ) *txl_cntrl.c.obj(.scommon_b .scommon_b.* ) . = ALIGN(2); }
	".sbss_h_*rxl_cntrl.c.obj" 	(NOLOAD)	: { *rxl_cntrl.c.obj(.sbss_h .sbss_h.* ) *tx_swdesc.c.obj(.sbss_h .sbss_h.* ) *txl_cfm.c.obj(.sbss_h .sbss_h.* ) *txl_cntrl.c.obj(.sbss_h .sbss_h.* ) *rxl_cntrl.c.obj(.scommon_h .scommon_h.* ) *tx_swdesc.c.obj(.scommon_h .scommon_h.* ) *txl_cfm.c.obj(.scommon_h .scommon_h.* ) *txl_cntrl.c.obj(.scommon_h .scommon_h.* ) . = ALIGN(4); }
	".sbss_w_*rxl_cntrl.c.obj" 	(NOLOAD)	: { *rxl_cntrl.c.obj(.sbss_w .sbss_w.* ) *tx_swdesc.c.obj(.sbss_w .sbss_w.* ) *txl_cfm.c.obj(.sbss_w .sbss_w.* ) *txl_cntrl.c.obj(.sbss_w .sbss_w.* ) *rxl_cntrl.c.obj(.scommon_w .scommon_w.* ) *tx_swdesc.c.obj(.scommon_w .scommon_w.* ) *txl_cfm.c.obj(.scommon_w .scommon_w.* ) *txl_cntrl.c.obj(.scommon_w .scommon_w.* ) *rxl_cntrl.c.obj(.dynsbss ) *tx_swdesc.c.obj(.dynsbss ) *txl_cfm.c.obj(.dynsbss ) *txl_cntrl.c.obj(.dynsbss ) *rxl_cntrl.c.obj(.scommon ) *tx_swdesc.c.obj(.scommon ) *txl_cfm.c.obj(.scommon ) *txl_cntrl.c.obj(.scommon ) . = ALIGN(8); }
	".sbss_d_*rxl_cntrl.c.obj" 	(NOLOAD)	: { *rxl_cntrl.c.obj(.sbss_d .sbss_d.* ) *tx_swdesc.c.obj(.sbss_d .sbss_d.* ) *txl_cfm.c.obj(.sbss_d .sbss_d.* ) *txl_cntrl.c.obj(.sbss_d .sbss_d.* ) *rxl_cntrl.c.obj(.scommon_d .scommon_d.* ) *tx_swdesc.c.obj(.scommon_d .scommon_d.* ) *txl_cfm.c.obj(.scommon_d .scommon_d.* ) *txl_cntrl.c.obj(.scommon_d .scommon_d.* ) }
	".bss_*rxl_cntrl.c.obj" 	(NOLOAD)	: { *rxl_cntrl.c.obj(.dynbss ) *tx_swdesc.c.obj(.dynbss ) *txl_cfm.c.obj(.dynbss ) *txl_cntrl.c.obj(.dynbss ) *rxl_cntrl.c.obj(.bss .bss.* .gnu.linkonce.b.* ) *tx_swdesc.c.obj(.bss .bss.* .gnu.linkonce.b.* ) *txl_cfm.c.obj(.bss .bss.* .gnu.linkonce.b.* ) *txl_cntrl.c.obj(.bss .bss.* .gnu.linkonce.b.* ) *rxl_cntrl.c.obj(COMMON ) *tx_swdesc.c.obj(COMMON ) *txl_cfm.c.obj(COMMON ) *txl_cntrl.c.obj(COMMON ) . = ALIGN(8); }
	. = ALIGN(8);
	".tbss_*sta_mgmt.c.obj" 	(NOLOAD)	: { *sta_mgmt.c.obj(.tbss .tbss.* .gnu.linkonce.tb.* ) *vif_mgmt.c.obj(.tbss .tbss.* .gnu.linkonce.tb.* ) *rc.c.obj(.tbss .tbss.* .gnu.linkonce.tb.* ) *rwnx.c.obj(.tbss .tbss.* .gnu.linkonce.tb.* ) *me_task.c.obj(.tbss .tbss.* .gnu.linkonce.tb.* ) *sm.c.obj(.tbss .tbss.* .gnu.linkonce.tb.* ) *sta_mgmt.c.obj(.tcommon ) *vif_mgmt.c.obj(.tcommon ) *rc.c.obj(.tcommon ) *rwnx.c.obj(.tcommon ) *me_task.c.obj(.tcommon ) *sm.c.obj(.tcommon ) }
	".sbss_*sta_mgmt.c.obj" 	(NOLOAD)	: { *sta_mgmt.c.obj(.dynsbss ) *vif_mgmt.c.obj(.dynsbss ) *rc.c.obj(.dynsbss ) *rwnx.c.obj(.dynsbss ) *me_task.c.obj(.dynsbss ) *sm.c.obj(.dynsbss ) *sta_mgmt.c.obj(.sbss .sbss.* .gnu.linkonce.sb.* ) *vif_mgmt.c.obj(.sbss .sbss.* .gnu.linkonce.sb.* ) *rc.c.obj(.sbss .sbss.* .gnu.linkonce.sb.* ) *rwnx.c.obj(.sbss .sbss.* .gnu.linkonce.sb.* ) *me_task.c.obj(.sbss .sbss.* .gnu.linkonce.sb.* ) *sm.c.obj(.sbss .sbss.* .gnu.linkonce.sb.* ) *sta_mgmt.c.obj(.scommon .scommon.* ) *vif_mgmt.c.obj(.scommon .scommon.* ) *rc.c.obj(.scommon .scommon.* ) *rwnx.c.obj(.scommon .scommon.* ) *me_task.c.obj(.scommon .scommon.* ) *sm.c.obj(.scommon .scommon.* ) }
	".sbss_f_*sta_mgmt.c.obj" 	(NOLOAD)	: { *sta_mgmt.c.obj(.sbss_f .sbss_f.* ) *vif_mgmt.c.obj(.sbss_f .sbss_f.* ) *rc.c.obj(.sbss_f .sbss_f.* ) *rwnx.c.obj(.sbss_f .sbss_f.* ) *me_task.c.obj(.sbss_f .sbss_f.* ) *sm.c.obj(.sbss_f .sbss_f.* ) *sta_mgmt.c.obj(.scommon_f .scommon_f.* ) *vif_mgmt.c.obj(.scommon_f .scommon_f.* ) *rc.c.obj(.scommon_f .scommon_f.* ) *rwnx.c.obj(.scommon_f .scommon_f.* ) *me_task.c.obj(.scommon_f .scommon_f.* ) *sm.c.obj(.scommon_f .scommon_f.* ) }
	".sbss_b_*sta_mgmt.c.obj" 	(NOLOAD)	: { *sta_mgmt.c.obj(.sbss_b .sbss_b.* ) *vif_mgmt.c.obj(.sbss_b .sbss_b.* ) *rc.c.obj(.sbss_b .sbss_b.* ) *rwnx.c.obj(.sbss_b .sbss_b.* ) *me_task.c.obj(.sbss_b .sbss_b.* ) *sm.c.obj(.sbss_b .sbss_b.* ) *sta_mgmt.c.obj(.scommon_b .scommon_b.* ) *vif_mgmt.c.obj(.scommon_b .scommon_b.* ) *rc.c.obj(.scommon_b .scommon_b.* ) *rwnx.c.obj(.scommon_b .scommon_b.* ) *me_task.c.obj(.scommon_b .scommon_b.* ) *sm.c.obj(.scommon_b .scommon_b.* ) . = ALIGN(2); }
	".sbss_h_*sta_mgmt.c.obj" 	(NOLOAD)	: { *sta_mgmt.c.obj(.sbss_h .sbss_h.* ) *vif_mgmt.c.obj(.sbss_h .sbss_h.* ) *rc.c.obj(.sbss_h .sbss_h.* ) *rwnx.c.obj(.sbss_h .sbss_h.* ) *me_task.c.obj(.sbss_h .sbss_h.* ) *sm.c.obj(.sbss_h .sbss_h.* ) *sta_mgmt.c.obj(.scommon_h .scommon_h.* ) *vif_mgmt.c.obj(.scommon_h .scommon_h.* ) *rc.c.obj(.scommon_h .scommon_h.* ) *rwnx.c.obj(.scommon_h .scommon_h.* ) *me_task.c.obj(.scommon_h .scommon_h.* ) *sm.c.obj(.scommon_h .scommon_h.* ) . = ALIGN(4); }
	".sbss_w_*sta_mgmt.c.obj" 	(NOLOAD)	: { *sta_mgmt.c.obj(.sbss_w .sbss_w.* ) *vif_mgmt.c.obj(.sbss_w .sbss_w.* ) *rc.c.obj(.sbss_w .sbss_w.* ) *rwnx.c.obj(.sbss_w .sbss_w.* ) *me_task.c.obj(.sbss_w .sbss_w.* ) *sm.c.obj(.sbss_w .sbss_w.* ) *sta_mgmt.c.obj(.scommon_w .scommon_w.* ) *vif_mgmt.c.obj(.scommon_w .scommon_w.* ) *rc.c.obj(.scommon_w .scommon_w.* ) *rwnx.c.obj(.scommon_w .scommon_w.* ) *me_task.c.obj(.scommon_w .scommon_w.* ) *sm.c.obj(.scommon_w .scommon_w.* ) *sta_mgmt.c.obj(.dynsbss ) *vif_mgmt.c.obj(.dynsbss ) *rc.c.obj(.dynsbss ) *rwnx.c.obj(.dynsbss ) *me_task.c.obj(.dynsbss ) *sm.c.obj(.dynsbss ) *sta_mgmt.c.obj(.scommon ) *vif_mgmt.c.obj(.scommon ) *rc.c.obj(.scommon ) *rwnx.c.obj(.scommon ) *me_task.c.obj(.scommon ) *sm.c.obj(.scommon ) . = ALIGN(8); }
	".sbss_d_*sta_mgmt.c.obj" 	(NOLOAD)	: { *sta_mgmt.c.obj(.sbss_d .sbss_d.* ) *vif_mgmt.c.obj(.sbss_d .sbss_d.* ) *rc.c.obj(.sbss_d .sbss_d.* ) *rwnx.c.obj(.sbss_d .sbss_d.* ) *me_task.c.obj(.sbss_d .sbss_d.* ) *sm.c.obj(.sbss_d .sbss_d.* ) *sta_mgmt.c.obj(.scommon_d .scommon_d.* ) *vif_mgmt.c.obj(.scommon_d .scommon_d.* ) *rc.c.obj(.scommon_d .scommon_d.* ) *rwnx.c.obj(.scommon_d .scommon_d.* ) *me_task.c.obj(.scommon_d .scommon_d.* ) *sm.c.obj(.scommon_d .scommon_d.* ) }
	".bss_*sta_mgmt.c.obj" 	(NOLOAD)	: { *sta_mgmt.c.obj(.dynbss ) *vif_mgmt.c.obj(.dynbss ) *rc.c.obj(.dynbss ) *rwnx.c.obj(.dynbss ) *me_task.c.obj(.dynbss ) *sm.c.obj(.dynbss ) *sta_mgmt.c.obj(.bss .bss.* .gnu.linkonce.b.* ) *vif_mgmt.c.obj(.bss .bss.* .gnu.linkonce.b.* ) *rc.c.obj(.bss .bss.* .gnu.linkonce.b.* ) *rwnx.c.obj(.bss .bss.* .gnu.linkonce.b.* ) *me_task.c.obj(.bss .bss.* .gnu.linkonce.b.* ) *sm.c.obj(.bss .bss.* .gnu.linkonce.b.* ) *sta_mgmt.c.obj(COMMON ) *vif_mgmt.c.obj(COMMON ) *rc.c.obj(COMMON ) *rwnx.c.obj(COMMON ) *me_task.c.obj(COMMON ) *sm.c.obj(COMMON ) . = ALIGN(8); }
	. = ALIGN(8);
	".tbss_*sm_task.c.obj" 	(NOLOAD)	: { *sm_task.c.obj(.tbss .tbss.* .gnu.linkonce.tb.* ) *me.c.obj(.tbss .tbss.* .gnu.linkonce.tb.* ) *mm.c.obj(.tbss .tbss.* .gnu.linkonce.tb.* ) *mm_bcn.c.obj(.tbss .tbss.* .gnu.linkonce.tb.* ) *mm_task.c.obj(.tbss .tbss.* .gnu.linkonce.tb.* ) *mm_timer.c.obj(.tbss .tbss.* .gnu.linkonce.tb.* ) *sm_task.c.obj(.tcommon ) *me.c.obj(.tcommon ) *mm.c.obj(.tcommon ) *mm_bcn.c.obj(.tcommon ) *mm_task.c.obj(.tcommon ) *mm_timer.c.obj(.tcommon ) }
	".sbss_*sm_task.c.obj" 	(NOLOAD)	: { *sm_task.c.obj(.dynsbss ) *me.c.obj(.dynsbss ) *mm.c.obj(.dynsbss ) *mm_bcn.c.obj(.dynsbss ) *mm_task.c.obj(.dynsbss ) *mm_timer.c.obj(.dynsbss ) *sm_task.c.obj(.sbss .sbss.* .gnu.linkonce.sb.* ) *me.c.obj(.sbss .sbss.* .gnu.linkonce.sb.* ) *mm.c.obj(.sbss .sbss.* .gnu.linkonce.sb.* ) *mm_bcn.c.obj(.sbss .sbss.* .gnu.linkonce.sb.* ) *mm_task.c.obj(.sbss .sbss.* .gnu.linkonce.sb.* ) *mm_timer.c.obj(.sbss .sbss.* .gnu.linkonce.sb.* ) *sm_task.c.obj(.scommon .scommon.* ) *me.c.obj(.scommon .scommon.* ) *mm.c.obj(.scommon .scommon.* ) *mm_bcn.c.obj(.scommon .scommon.* ) *mm_task.c.obj(.scommon .scommon.* ) *mm_timer.c.obj(.scommon .scommon.* ) }
	".sbss_f_*sm_task.c.obj" 	(NOLOAD)	: { *sm_task.c.obj(.sbss_f .sbss_f.* ) *me.c.obj(.sbss_f .sbss_f.* ) *mm.c.obj(.sbss_f .sbss_f.* ) *mm_bcn.c.obj(.sbss_f .sbss_f.* ) *mm_task.c.obj(.sbss_f .sbss_f.* ) *mm_timer.c.obj(.sbss_f .sbss_f.* ) *sm_task.c.obj(.scommon_f .scommon_f.* ) *me.c.obj(.scommon_f .scommon_f.* ) *mm.c.obj(.scommon_f .scommon_f.* ) *mm_bcn.c.obj(.scommon_f .scommon_f.* ) *mm_task.c.obj(.scommon_f .scommon_f.* ) *mm_timer.c.obj(.scommon_f .scommon_f.* ) }
	".sbss_b_*sm_task.c.obj" 	(NOLOAD)	: { *sm_task.c.obj(.sbss_b .sbss_b.* ) *me.c.obj(.sbss_b .sbss_b.* ) *mm.c.obj(.sbss_b .sbss_b.* ) *mm_bcn.c.obj(.sbss_b .sbss_b.* ) *mm_task.c.obj(.sbss_b .sbss_b.* ) *mm_timer.c.obj(.sbss_b .sbss_b.* ) *sm_task.c.obj(.scommon_b .scommon_b.* ) *me.c.obj(.scommon_b .scommon_b.* ) *mm.c.obj(.scommon_b .scommon_b.* ) *mm_bcn.c.obj(.scommon_b .scommon_b.* ) *mm_task.c.obj(.scommon_b .scommon_b.* ) *mm_timer.c.obj(.scommon_b .scommon_b.* ) . = ALIGN(2); }
	".sbss_h_*sm_task.c.obj" 	(NOLOAD)	: { *sm_task.c.obj(.sbss_h .sbss_h.* ) *me.c.obj(.sbss_h .sbss_h.* ) *mm.c.obj(.sbss_h .sbss_h.* ) *mm_bcn.c.obj(.sbss_h .sbss_h.* ) *mm_task.c.obj(.sbss_h .sbss_h.* ) *mm_timer.c.obj(.sbss_h .sbss_h.* ) *sm_task.c.obj(.scommon_h .scommon_h.* ) *me.c.obj(.scommon_h .scommon_h.* ) *mm.c.obj(.scommon_h .scommon_h.* ) *mm_bcn.c.obj(.scommon_h .scommon_h.* ) *mm_task.c.obj(.scommon_h .scommon_h.* ) *mm_timer.c.obj(.scommon_h .scommon_h.* ) . = ALIGN(4); }
	".sbss_w_*sm_task.c.obj" 	(NOLOAD)	: { *sm_task.c.obj(.sbss_w .sbss_w.* ) *me.c.obj(.sbss_w .sbss_w.* ) *mm.c.obj(.sbss_w .sbss_w.* ) *mm_bcn.c.obj(.sbss_w .sbss_w.* ) *mm_task.c.obj(.sbss_w .sbss_w.* ) *mm_timer.c.obj(.sbss_w .sbss_w.* ) *sm_task.c.obj(.scommon_w .scommon_w.* ) *me.c.obj(.scommon_w .scommon_w.* ) *mm.c.obj(.scommon_w .scommon_w.* ) *mm_bcn.c.obj(.scommon_w .scommon_w.* ) *mm_task.c.obj(.scommon_w .scommon_w.* ) *mm_timer.c.obj(.scommon_w .scommon_w.* ) *sm_task.c.obj(.dynsbss ) *me.c.obj(.dynsbss ) *mm.c.obj(.dynsbss ) *mm_bcn.c.obj(.dynsbss ) *mm_task.c.obj(.dynsbss ) *mm_timer.c.obj(.dynsbss ) *sm_task.c.obj(.scommon ) *me.c.obj(.scommon ) *mm.c.obj(.scommon ) *mm_bcn.c.obj(.scommon ) *mm_task.c.obj(.scommon ) *mm_timer.c.obj(.scommon ) . = ALIGN(8); }
	".sbss_d_*sm_task.c.obj" 	(NOLOAD)	: { *sm_task.c.obj(.sbss_d .sbss_d.* ) *me.c.obj(.sbss_d .sbss_d.* ) *mm.c.obj(.sbss_d .sbss_d.* ) *mm_bcn.c.obj(.sbss_d .sbss_d.* ) *mm_task.c.obj(.sbss_d .sbss_d.* ) *mm_timer.c.obj(.sbss_d .sbss_d.* ) *sm_task.c.obj(.scommon_d .scommon_d.* ) *me.c.obj(.scommon_d .scommon_d.* ) *mm.c.obj(.scommon_d .scommon_d.* ) *mm_bcn.c.obj(.scommon_d .scommon_d.* ) *mm_task.c.obj(.scommon_d .scommon_d.* ) *mm_timer.c.obj(.scommon_d .scommon_d.* ) }
	".bss_*sm_task.c.obj" 	(NOLOAD)	: { *sm_task.c.obj(.dynbss ) *me.c.obj(.dynbss ) *mm.c.obj(.dynbss ) *mm_bcn.c.obj(.dynbss ) *mm_task.c.obj(.dynbss ) *mm_timer.c.obj(.dynbss ) *sm_task.c.obj(.bss .bss.* .gnu.linkonce.b.* ) *me.c.obj(.bss .bss.* .gnu.linkonce.b.* ) *mm.c.obj(.bss .bss.* .gnu.linkonce.b.* ) *mm_bcn.c.obj(.bss .bss.* .gnu.linkonce.b.* ) *mm_task.c.obj(.bss .bss.* .gnu.linkonce.b.* ) *mm_timer.c.obj(.bss .bss.* .gnu.linkonce.b.* ) *sm_task.c.obj(COMMON ) *me.c.obj(COMMON ) *mm.c.obj(COMMON ) *mm_bcn.c.obj(COMMON ) *mm_task.c.obj(COMMON ) *mm_timer.c.obj(COMMON ) . = ALIGN(8); }
	. = ALIGN(8);
	".tbss_*td.c.obj" 	(NOLOAD)	: { *td.c.obj(.tbss .tbss.* .gnu.linkonce.tb.* ) *chan.c.obj(.tbss .tbss.* .gnu.linkonce.tb.* ) *ps.c.obj(.tbss .tbss.* .gnu.linkonce.tb.* ) *td.c.obj(.tcommon ) *chan.c.obj(.tcommon ) *ps.c.obj(.tcommon ) }
	".sbss_*td.c.obj" 	(NOLOAD)	: { *td.c.obj(.dynsbss ) *chan.c.obj(.dynsbss ) *ps.c.obj(.dynsbss ) *td.c.obj(.sbss .sbss.* .gnu.linkonce.sb.* ) *chan.c.obj(.sbss .sbss.* .gnu.linkonce.sb.* ) *ps.c.obj(.sbss .sbss.* .gnu.linkonce.sb.* ) *td.c.obj(.scommon .scommon.* ) *chan.c.obj(.scommon .scommon.* ) *ps.c.obj(.scommon .scommon.* ) }
	".sbss_f_*td.c.obj" 	(NOLOAD)	: { *td.c.obj(.sbss_f .sbss_f.* ) *chan.c.obj(.sbss_f .sbss_f.* ) *ps.c.obj(.sbss_f .sbss_f.* ) *td.c.obj(.scommon_f .scommon_f.* ) *chan.c.obj(.scommon_f .scommon_f.* ) *ps.c.obj(.scommon_f .scommon_f.* ) }
	".sbss_b_*td.c.obj" 	(NOLOAD)	: { *td.c.obj(.sbss_b .sbss_b.* ) *chan.c.obj(.sbss_b .sbss_b.* ) *ps.c.obj(.sbss_b .sbss_b.* ) *td.c.obj(.scommon_b .scommon_b.* ) *chan.c.obj(.scommon_b .scommon_b.* ) *ps.c.obj(.scommon_b .scommon_b.* ) . = ALIGN(2); }
	".sbss_h_*td.c.obj" 	(NOLOAD)	: { *td.c.obj(.sbss_h .sbss_h.* ) *chan.c.obj(.sbss_h .sbss_h.* ) *ps.c.obj(.sbss_h .sbss_h.* ) *td.c.obj(.scommon_h .scommon_h.* ) *chan.c.obj(.scommon_h .scommon_h.* ) *ps.c.obj(.scommon_h .scommon_h.* ) . = ALIGN(4); }
	".sbss_w_*td.c.obj" 	(NOLOAD)	: { *td.c.obj(.sbss_w .sbss_w.* ) *chan.c.obj(.sbss_w .sbss_w.* ) *ps.c.obj(.sbss_w .sbss_w.* ) *td.c.obj(.scommon_w .scommon_w.* ) *chan.c.obj(.scommon_w .scommon_w.* ) *ps.c.obj(.scommon_w .scommon_w.* ) *td.c.obj(.dynsbss ) *chan.c.obj(.dynsbss ) *ps.c.obj(.dynsbss ) *td.c.obj(.scommon ) *chan.c.obj(.scommon ) *ps.c.obj(.scommon ) . = ALIGN(8); }
	".sbss_d_*td.c.obj" 	(NOLOAD)	: { *td.c.obj(.sbss_d .sbss_d.* ) *chan.c.obj(.sbss_d .sbss_d.* ) *ps.c.obj(.sbss_d .sbss_d.* ) *td.c.obj(.scommon_d .scommon_d.* ) *chan.c.obj(.scommon_d .scommon_d.* ) *ps.c.obj(.scommon_d .scommon_d.* ) }
	".bss_*td.c.obj" 	(NOLOAD)	: { *td.c.obj(.dynbss ) *chan.c.obj(.dynbss ) *ps.c.obj(.dynbss ) *td.c.obj(.bss .bss.* .gnu.linkonce.b.* ) *chan.c.obj(.bss .bss.* .gnu.linkonce.b.* ) *ps.c.obj(.bss .bss.* .gnu.linkonce.b.* ) *td.c.obj(COMMON ) *chan.c.obj(COMMON ) *ps.c.obj(COMMON ) . = ALIGN(8); }
	. = ALIGN(8);
	".tbss_*scan_task.c.obj" 	(NOLOAD)	: { *scan_task.c.obj(.tbss .tbss.* .gnu.linkonce.tb.* ) *scan.c.obj(.tbss .tbss.* .gnu.linkonce.tb.* ) *scanu.c.obj(.tbss .tbss.* .gnu.linkonce.tb.* ) *scanu_task.c.obj(.tbss .tbss.* .gnu.linkonce.tb.* ) *scan_task.c.obj(.tcommon ) *scan.c.obj(.tcommon ) *scanu.c.obj(.tcommon ) *scanu_task.c.obj(.tcommon ) }
	".sbss_*scan_task.c.obj" 	(NOLOAD)	: { *scan_task.c.obj(.dynsbss ) *scan.c.obj(.dynsbss ) *scanu.c.obj(.dynsbss ) *scanu_task.c.obj(.dynsbss ) *scan_task.c.obj(.sbss .sbss.* .gnu.linkonce.sb.* ) *scan.c.obj(.sbss .sbss.* .gnu.linkonce.sb.* ) *scanu.c.obj(.sbss .sbss.* .gnu.linkonce.sb.* ) *scanu_task.c.obj(.sbss .sbss.* .gnu.linkonce.sb.* ) *scan_task.c.obj(.scommon .scommon.* ) *scan.c.obj(.scommon .scommon.* ) *scanu.c.obj(.scommon .scommon.* ) *scanu_task.c.obj(.scommon .scommon.* ) }
	".sbss_f_*scan_task.c.obj" 	(NOLOAD)	: { *scan_task.c.obj(.sbss_f .sbss_f.* ) *scan.c.obj(.sbss_f .sbss_f.* ) *scanu.c.obj(.sbss_f .sbss_f.* ) *scanu_task.c.obj(.sbss_f .sbss_f.* ) *scan_task.c.obj(.scommon_f .scommon_f.* ) *scan.c.obj(.scommon_f .scommon_f.* ) *scanu.c.obj(.scommon_f .scommon_f.* ) *scanu_task.c.obj(.scommon_f .scommon_f.* ) }
	".sbss_b_*scan_task.c.obj" 	(NOLOAD)	: { *scan_task.c.obj(.sbss_b .sbss_b.* ) *scan.c.obj(.sbss_b .sbss_b.* ) *scanu.c.obj(.sbss_b .sbss_b.* ) *scanu_task.c.obj(.sbss_b .sbss_b.* ) *scan_task.c.obj(.scommon_b .scommon_b.* ) *scan.c.obj(.scommon_b .scommon_b.* ) *scanu.c.obj(.scommon_b .scommon_b.* ) *scanu_task.c.obj(.scommon_b .scommon_b.* ) . = ALIGN(2); }
	".sbss_h_*scan_task.c.obj" 	(NOLOAD)	: { *scan_task.c.obj(.sbss_h .sbss_h.* ) *scan.c.obj(.sbss_h .sbss_h.* ) *scanu.c.obj(.sbss_h .sbss_h.* ) *scanu_task.c.obj(.sbss_h .sbss_h.* ) *scan_task.c.obj(.scommon_h .scommon_h.* ) *scan.c.obj(.scommon_h .scommon_h.* ) *scanu.c.obj(.scommon_h .scommon_h.* ) *scanu_task.c.obj(.scommon_h .scommon_h.* ) . = ALIGN(4); }
	".sbss_w_*scan_task.c.obj" 	(NOLOAD)	: { *scan_task.c.obj(.sbss_w .sbss_w.* ) *scan.c.obj(.sbss_w .sbss_w.* ) *scanu.c.obj(.sbss_w .sbss_w.* ) *scanu_task.c.obj(.sbss_w .sbss_w.* ) *scan_task.c.obj(.scommon_w .scommon_w.* ) *scan.c.obj(.scommon_w .scommon_w.* ) *scanu.c.obj(.scommon_w .scommon_w.* ) *scanu_task.c.obj(.scommon_w .scommon_w.* ) *scan_task.c.obj(.dynsbss ) *scan.c.obj(.dynsbss ) *scanu.c.obj(.dynsbss ) *scanu_task.c.obj(.dynsbss ) *scan_task.c.obj(.scommon ) *scan.c.obj(.scommon ) *scanu.c.obj(.scommon ) *scanu_task.c.obj(.scommon ) . = ALIGN(8); }
	".sbss_d_*scan_task.c.obj" 	(NOLOAD)	: { *scan_task.c.obj(.sbss_d .sbss_d.* ) *scan.c.obj(.sbss_d .sbss_d.* ) *scanu.c.obj(.sbss_d .sbss_d.* ) *scanu_task.c.obj(.sbss_d .sbss_d.* ) *scan_task.c.obj(.scommon_d .scommon_d.* ) *scan.c.obj(.scommon_d .scommon_d.* ) *scanu.c.obj(.scommon_d .scommon_d.* ) *scanu_task.c.obj(.scommon_d .scommon_d.* ) }
	".bss_*scan_task.c.obj" 	(NOLOAD)	: { *scan_task.c.obj(.dynbss ) *scan.c.obj(.dynbss ) *scanu.c.obj(.dynbss ) *scanu_task.c.obj(.dynbss ) *scan_task.c.obj(.bss .bss.* .gnu.linkonce.b.* ) *scan.c.obj(.bss .bss.* .gnu.linkonce.b.* ) *scanu.c.obj(.bss .bss.* .gnu.linkonce.b.* ) *scanu_task.c.obj(.bss .bss.* .gnu.linkonce.b.* ) *scan_task.c.obj(COMMON ) *scan.c.obj(COMMON ) *scanu.c.obj(COMMON ) *scanu_task.c.obj(COMMON ) . = ALIGN(8); }
	_dtcm_bss_end = .;
	DTCM_SIZE = . - DTCM_BEGIN;
	. = 0x30000000;
	SRAM1_BEGIN = .;
	.bt_spec_data 	: AT(LOADADDR (.dtcm_sec_bss) + SIZEOF (.dtcm_sec_bss))
		{ KEEP(*(.bt_spec_data )) }
	_bt_data_lmastart =  LOADADDR (.bt_spec_data);
	_bt_data_start = ADDR(.bt_spec_data);
	_bt_data_end =  LOADADDR (.bt_spec_data) + SIZEOF (.bt_spec_data);
	SRAM1_SIZE = . - SRAM1_BEGIN;
	. = 0x30010000;
	SRAM2_BEGIN = .;
	. = ALIGN(8);
	. = ALIGN(0x20);
	. = ALIGN(ALIGNOF(.eh_frame));
	.eh_frame 	: AT(ALIGN(LOADADDR (.bt_spec_data) + SIZEOF (.bt_spec_data), 32))
		{ KEEP(*(.eh_frame )) }
	_data_lmastart =  LOADADDR (.eh_frame);
	_data_start = ADDR(.eh_frame);
	. = ALIGN(ALIGNOF(.gcc_except_table));
	.gcc_except_table 	: AT(ALIGN(LOADADDR (.eh_frame) + SIZEOF (.eh_frame), ALIGNOF(.gcc_except_table)))
		{ KEEP(*(.gcc_except_table )) *(.gcc_except_table.* ) }
	. = ALIGN(ALIGNOF(.tdata));
	.tdata 	: AT(ALIGN(LOADADDR (.gcc_except_table) + SIZEOF (.gcc_except_table), ALIGNOF(.tdata)))
		{ *(.tdata .tdata.* .gnu.linkonce.td.* ) }
	. = ALIGN(8);
	. = ALIGN(ALIGNOF(.preinit_array));
	.preinit_array 	: AT(ALIGN(ALIGN(LOADADDR (.tdata) + SIZEOF (.tdata), ALIGNOF(.preinit_array)), 8))
		{; PROVIDE (__preinit_array_start = .); KEEP(*(.preinit_array )); PROVIDE (__preinit_array_end = .); }
	. = ALIGN(ALIGNOF(.init_array));
	.init_array 	: AT(ALIGN(LOADADDR (.preinit_array) + SIZEOF (.preinit_array), ALIGNOF(.init_array)))
		{; PROVIDE (__init_array_start = .); KEEP(*(SORT_BY_INIT_PRIORITY(.init_array.* ))) KEEP(*(.init_array )); PROVIDE (__init_array_end = .); }
	. = ALIGN(ALIGNOF(.fini_array));
	.fini_array 	: AT(ALIGN(LOADADDR (.init_array) + SIZEOF (.init_array), ALIGNOF(.fini_array)))
		{; PROVIDE (__fini_array_start = .); KEEP(*(SORT_BY_INIT_PRIORITY(.fini_array.* ))) KEEP(*(.fini_array )); PROVIDE (__fini_array_end = .); }
	. = ALIGN(ALIGNOF(.tm_clone_table));
	.tm_clone_table 	: AT(ALIGN(LOADADDR (.fini_array) + SIZEOF (.fini_array), ALIGNOF(.tm_clone_table)))
		{ *(.tm_clone_table ) }
	. = ALIGN(ALIGNOF(.ctors));
	.ctors 	: AT(ALIGN(LOADADDR (.tm_clone_table) + SIZEOF (.tm_clone_table), ALIGNOF(.ctors)))
		{ KEEP(*crtbegin*.o(.ctors)) KEEP(*(EXCLUDE_FILE (*crtend*.o) .ctors)) KEEP(*(SORT(.ctors.* ))) KEEP(*(.ctors )) }
	. = ALIGN(ALIGNOF(.dtors));
	.dtors 	: AT(ALIGN(LOADADDR (.ctors) + SIZEOF (.ctors), ALIGNOF(.dtors)))
		{ KEEP(*crtbegin*.o(.dtors)) KEEP(*(EXCLUDE_FILE (*crtend*.o) .dtors)) KEEP(*(SORT(.dtors.* ))) KEEP(*(.dtors )) }
	. = ALIGN(ALIGNOF(.jcr));
	.jcr 	: AT(ALIGN(LOADADDR (.dtors) + SIZEOF (.dtors), ALIGNOF(.jcr)))
		{ KEEP(*(.jcr )) }
	. = ALIGN(ALIGNOF(.data.rel.ro));
	.data.rel.ro 	: AT(ALIGN(LOADADDR (.jcr) + SIZEOF (.jcr), ALIGNOF(.data.rel.ro)))
		{ *(.data.rel.ro.local ) *(.data.rel.ro* ) }
	. = ALIGN(ALIGNOF(.dynamic));
	.dynamic 	: AT(ALIGN(LOADADDR (.data.rel.ro) + SIZEOF (.data.rel.ro), ALIGNOF(.dynamic)))
		{ *(.dynamic ) }
	. = ALIGN(8);
	. = ALIGN(ALIGNOF(.got));
	.got 	: AT(ALIGN(ALIGN(LOADADDR (.dynamic) + SIZEOF (.dynamic), ALIGNOF(.got)), 8))
		{ *(.got.plt ) *(.got ) }
	. = ALIGN(ALIGNOF(.data));
	.data 	: AT(ALIGN(LOADADDR (.got) + SIZEOF (.got), ALIGNOF(.data)))
		{ *(.data .data.* .gnu.linkonce.d.* ) KEEP(*(.gnu.linkonce.d.*personality* )) SORT(CONSTRUCTORS) . = ALIGN(8); }
	. = ALIGN(ALIGNOF(.data1));
	.data1 	: AT(ALIGN(LOADADDR (.data) + SIZEOF (.data), ALIGNOF(.data1)))
		{ *(.data1 ) . = ALIGN(8); }
	. = ALIGN(8);
	. = ALIGN(ALIGNOF(.sdata));
	.sdata 	: AT(ALIGN(ALIGN(LOADADDR (.data1) + SIZEOF (.data1), ALIGNOF(.sdata)), 8))
		{ *(.srodata.cst16 ) *(.srodata.cst8 ) *(.srodata.cst4 ) *(.srodata.cst2 ) *(.srodata .srodata.* ) *(.sdata .sdata.* .gnu.linkonce.s.* ) }
	. = ALIGN(ALIGNOF(.sdata_d));
	.sdata_d 	: AT(ALIGN(LOADADDR (.sdata) + SIZEOF (.sdata), ALIGNOF(.sdata_d)))
		{ *(.sdata_d .sdata_d.* ) }
	. = ALIGN(ALIGNOF(.sdata_w));
	.sdata_w 	: AT(ALIGN(LOADADDR (.sdata_d) + SIZEOF (.sdata_d), ALIGNOF(.sdata_w)))
		{ *(.sdata_w .sdata_w.* ) }
	. = ALIGN(ALIGNOF(.sdata_h));
	.sdata_h 	: AT(ALIGN(LOADADDR (.sdata_w) + SIZEOF (.sdata_w), ALIGNOF(.sdata_h)))
		{ *(.sdata_h .sdata_h.* ) }
	. = ALIGN(ALIGNOF(.sdata_b));
	.sdata_b 	: AT(ALIGN(LOADADDR (.sdata_h) + SIZEOF (.sdata_h), ALIGNOF(.sdata_b)))
		{ *(.sdata_b .sdata_b.* ) }
	. = ALIGN(ALIGNOF(.sdata_f));
	.sdata_f 	: AT(ALIGN(LOADADDR (.sdata_b) + SIZEOF (.sdata_b), ALIGNOF(.sdata_f)))
		{ *(.sdata_f .sdata_f.* ) }
	. = ALIGN(8);
	_edata = .;
	PROVIDE (edata = .);
	. = ALIGN(8);
	.tbss 	(NOLOAD)	: { *(.tbss .tbss.* .gnu.linkonce.tb.* ) *(.tcommon ) }
	.sbss 	(NOLOAD)	: { *(.dynsbss ) *(.sbss .sbss.* .gnu.linkonce.sb.* ) *(.scommon .scommon.* ) }
	.sbss_f 	(NOLOAD)	: { *(.sbss_f .sbss_f.* ) *(.scommon_f .scommon_f.* ) }
	.sbss_b 	(NOLOAD)	: { *(.sbss_b .sbss_b.* ) *(.scommon_b .scommon_b.* ) . = ALIGN(2); }
	.sbss_h 	(NOLOAD)	: { *(.sbss_h .sbss_h.* ) *(.scommon_h .scommon_h.* ) . = ALIGN(4); }
	.sbss_w 	(NOLOAD)	: { *(.sbss_w .sbss_w.* ) *(.scommon_w .scommon_w.* ) *(.dynsbss ) *(.scommon ) . = ALIGN(8); }
	.sbss_d 	(NOLOAD)	: { *(.sbss_d .sbss_d.* ) *(.scommon_d .scommon_d.* ) }
	.bss 	(NOLOAD)	: { *(.dynbss ) *(.bss .bss.* .gnu.linkonce.b.* ) *(COMMON ) . = ALIGN(8); }
	PROVIDE (__sbss_end = .);
	PROVIDE (___sbss_end = .);
	. = ALIGN(8);
	_end = .;
	PROVIDE (end = .);
	PROVIDE (_stack = 0x20007FE0);
	SRAM2_SIZE = . - SRAM2_BEGIN;
	CPU0_LOAD2_SIZE = LOADADDR(.sdata_f) + SIZEOF(.sdata_f) - CPU0_LOAD2_BEGIN;
	.stab	0 : { *(.stab) }
	.stabstr	0 : { *(.stabstr) }
	.stab.excl	0 : { *(.stab.excl) }
	.stab.exclstr	0 : { *(.stab.exclstr) }
	.stab.index	0 : { *(.stab.index) }
	.stab.indexstr	0 : { *(.stab.indexstr) }
	.comment	0 : { *(.comment) }
	.debug	0 : { *(.debug) }
	.line	0 : { *(.line) }
	.debug_srcinfo	0 : { *(.debug_srcinfo) }
	.debug_sfnames	0 : { *(.debug_sfnames) }
	.debug_aranges	0 : { *(.debug_aranges) }
	.debug_pubnames	0 : { *(.debug_pubnames) }
	.debug_info	0 : { *(.debug_info .gnu.linkonce.wi.*) }
	.debug_abbrev	0 : { *(.debug_abbrev) }
	.debug_line	0 : { *(.debug_line) }
	.debug_frame	0 : { *(.debug_frame) }
	.debug_str	0 : { *(.debug_str) }
	.debug_loc	0 : { *(.debug_loc) }
	.debug_macinfo	0 : { *(.debug_macinfo) }
	.debug_macro	0 : { KEEP(*(.debug_macro)) }
	.debug_weaknames	0 : { *(.debug_weaknames) }
	.debug_funcnames	0 : { *(.debug_funcnames) }
	.debug_typenames	0 : { *(.debug_typenames) }
	.debug_varnames	0 : { *(.debug_varnames) }
}
ASSERT((DEFINED (_RELAX_END_) ? FLASH1_SIZE : 0x0)<= 0x800, "FLASH1 OVERFLOW");
ASSERT((DEFINED (_RELAX_END_) ? ITCM_SIZE : 0x0)<= 0x8000, "ITCM OVERFLOW");
ASSERT((DEFINED (_RELAX_END_) ? CPU0_LOAD1_SIZE : 0x0)<= 0x8800, "CPU0_LOAD1 OVERFLOW");
ASSERT((DEFINED (_RELAX_END_) ? DTCM_SIZE : 0x0)<= 0x7800, "DTCM OVERFLOW");
ASSERT((DEFINED (_RELAX_END_) ? SRAM1_SIZE : 0x0)<= 0x10000, "SRAM1 OVERFLOW");
ASSERT((DEFINED (_RELAX_END_) ? SRAM2_SIZE : 0x0)<= 0x70000, "SRAM2 OVERFLOW");
ASSERT((DEFINED (_RELAX_END_) ? CPU0_LOAD2_SIZE : 0x0)<= 0x217800, "CPU0_LOAD2 OVERFLOW");
