## middleware/soc/bk7258/bk7258.defconfig
```kconfig
#The value config in bk7258.defconfig will over write the Kconfig's default value.
#If the default value in Kconfig satisfy your needs, then you needn't to config again here.

CONFIG_SOC_ARCH="cm33"
CONFIG_SOC_BK7236XX=y
CONFIG_SOC_BK7258=y
CONFIG_SOC_STR="bk7258"
CONFIG_ARCH_CM33=y
CONFIG_CMSIS=y
CONFIG_DEFAULT_CMSIS_START=y

#Enable for FPGA board
CONFIG_FPGA=y
CONFIG_SPE=1

#
# ARMINO Configuration
#

#
# Common Configuration
#

#
# Compile/Build
#
#CONFIG_TOOLCHAIN_PATH="/opt/gcc-arm-none-eabi-9-2020-q2-update/bin"
CONFIG_TOOLCHAIN_PATH="/opt/gcc-arm-none-eabi-10.3-2021.10/bin"
#
# Debug
#
CONFIG_ASSERT_REBOOT=y
# CONFIG_ASSERT_HALT is not set
# CONFIG_ASSERT_REBOOT is not set
# CONFIG_JTAG is not set
# end of Debug
# end of Common Configuration

#
# Features Configuration
#
#CONFIG_LWIP_V2_0 is not set
CONFIG_LWIP_V2_1=y
CONFIG_NO_HOSTED=y
# CONFIG_SEMI_HOSTED is not set
# CONFIG_FULLY_HOSTED is not set
# CONFIG_WIFI_SENSOR is not set
# end of Features Configuration

#
# Components Configuration
#

#
# Application
#
# CONFIG_DEMO_TEST is not set
# CONFIG_FTPD_UPGRADE is not set
CONFIG_OTA_HTTP=y
# CONFIG_OTA_TFTP is not set
# end of Application

# CONFIG_AT is not set
CONFIG_AT_CMD=y

#
# Audio
#
CONFIG_AUDIO=y
CONFIG_AUDIO_TEST=y
# end of Audio

#
# Calibration
#
CONFIG_CALI=y
CONFIG_MANUAL_CALI=y
CONFIG_TPC_PA_MAP=y
# end of Calibration

#
# ATE
#
CONFIG_ATE=y
CONFIG_ATE_TEST=n
# end of ATE

#
# BLE
#
CONFIG_BLE=y
CONFIG_BLE_5_X=n
CONFIG_BLE_HOST_RW=y
CONFIG_BTDM_5_2=y
CONFIG_BTDM_5_T_MINDTREE=n
CONFIG_BT=n
# CONFIG_BLE_4_2 is not set
# end of BLE

#
# Cli
#
CONFIG_CLI=y
CONFIG_BKREG=y
# CONFIG_TCP_SERVER_TEST is not set
# CONFIG_AIRKISS_TEST is not set
# CONFIG_WIFI_RAW_TX_TEST is not set
# CONFIG_I2C1_TEST is not set
# CONFIG_I2C2_TEST is not set
# CONFIG_UART_TEST is not set
# CONFIG_SPI_TEST is not set
# CONFIG_PERI_TEST is not set
# CONFIG_RF_OTA_TEST is not set
# CONFIG_SHELL_ASYNCLOG is not set
CONFIG_DMA2D_TEST=y
# end of Cli

#
# RF
#
CONFIG_RF_POLICY_BLE_REQ=y
# CONFIG_RF_POLICY_WIFI_REQ is not set
# CONFIG_RF_POLICY_CO_REQ is not set
# end of RF

#
# Internal Kconfig
#
CONFIG_CHECK_MISMATCH=y
CONFIG_MCU_PS=y
CONFIG_DEEP_PS=y
CONFIG_TICK_CALI=y
CONFIG_STA_PS=y
# end of Internal Kconfig

#
# FreeRTOS
#
CONFIG_FREERTOS=y
# CONFIG_LITEOS_M is not set
CONFIG_FREERTOS_V9=n
CONFIG_FREERTOS_V10=y

#
# Memory Debug
#
# CONFIG_MALLOC_STATIS is not set
CONFIG_MEM_DEBUG=y
MEM_DEBUG_FUNC_NAME=y
CONFIG_MEM_DEBUG_FUNC_NAME_LEN=24
MEM_DEBUG_TASK_NAME=y
# end of Memory Debug
# end of FreeRTOS
CONFIG_CM_BACKTRACE=y

#
# Startup
#
CONFIG_APP_MAIN_TASK_PRIO=4
CONFIG_APP_MAIN_TASK_STACK_SIZE=4096
# end of Startup

#
# System
#
CONFIG_FLASH_SIZE_4M=y
# CONFIG_BASE_MAC_FROM_EFUSE is not set
# CONFIG_BASE_MAC_FROM_RF_OTP_FLASH is not set
CONFIG_NEW_MAC_POLICY=y
CONFIG_BK_MAC_ADDR_CHECK=y
# end of System

#
# USB configuration
#
CONFIG_USB=n
#CONFIG_USB_HOST=y
#CONFIG_TASK_USB_PRIO=5
#CONFIG_USB_MSD=n
CONFIG_USB_UVC=y
#CONFIG_USB1_PORT=y
#CONFIG_USB2_PORT=n
#CONFIG_USB_UVC_DEBUG=n
#CONFIG_USB_UAC=y
#CONFIG_USB_UAC_DEBUG=y
#CONFIG_USB_UAC_MIC=y
#CONFIG_USB_UAC_SPEAKER=y
# end of USB configuration

#
# WiFi
#
CONFIG_WIFI_IP_AX_NEXT=y
CONFIG_WIFI6_CODE_STACK=y
CONFIG_WIFI6=y
CONFIG_WIFI4=y
CONFIG_MSDU_RESV_HEAD_LENGTH=96
CONFIG_MSDU_RESV_TAIL_LENGTH=16
CONFIG_TASK_RECONNECT_PRIO=4
CONFIG_WIFI_MAC_VERSION="V22"
CONFIG_WIFI_MDM_VERSION="v32"
CONFIG_WIFI_PLF_VERSION="v32"
CONFIG_MM_PS_SET_LISTEN_INTERVAL_VALUE=30
CONFIG_MOBILE_CONNECT_SAP_STATISTICS=y
# CONFIG_AP_MONITOR_COEXIST is not set
# CONFIG_WIFI_FAST_CONNECT is not set
# CONFIG_BSSID_CONNECT is not set
# CONFIG_WFA_CERT is not set
# CONFIG_LESS_MEMERY_IN_RWNX is not set
# CONFIG_AP_PROBEREQ_CB is not set
# CONFIG_MM_PS_BASED_ON_LISTEN_INTERVAL is not set
CONFIG_WIFI6_IP_DEBUG=y
# end of WiFi

CONFIG_BLE_PS=y

#
# BLE 5.x
#
# CONFIG_BLE_HOST_NONE is not set
CONFIG_BLE_HOST_RW=y
# CONFIG_BLE_HOST_ZEPHYR is not set
CONFIG_BLE_MESH_NONE=y
# CONFIG_BLE_MESH_RW is not set
CONFIG_BLE_ADV_NUM=1
CONFIG_BLE_SCAN_NUM=1
CONFIG_BLE_INIT_NUM=1
CONFIG_BLE_CONN_NUM=1
# end of BLE 5.x

#
# Driver
#

#
# AON_RTC
#
CONFIG_AON_RTC=y
CONFIG_AON_RTC_MANY_USERS=y
CONFIG_AON_RTC_DEBUG=n
# end of AON_RTC


CONFIG_MPC=y
CONFIG_MPC_TEST=y
CONFIG_AON_RTC_TEST=y
CONFIG_PRRO=y
CONFIG_PRRO_TEST=y
CONFIG_SYSTEM_CTRL=y
CONFIG_HAL_DEBUG_SYS=y
CONFIG_AON_PMU=y

#
# Watchdog
#
CONFIG_INT_WDT=y
CONFIG_INT_WDT_PERIOD_MS=1000
CONFIG_TASK_WDT=y
CONFIG_TASK_WDT_PERIOD_MS=60000
CONFIG_NMI_WDT_EN=y
CONFIG_AON_WDT=y
CONFIG_INT_AON_WDT=y
# end of Watchdog

# I2C
#
#
CONFIG_I2C=y
CONFIG_FM_I2C=n
# end of I2C

#
# UART
#
CONFIG_UART1=y
CONFIG_UART2=y
CONFIG_UART_ATE_PORT=0
# CONFIG_PRINT_PORT_UART1 is not set
CONFIG_PRINT_PORT_UART1=y
CONFIG_UART_PRINT_PORT=0
CONFIG_PRINTF_BUF_SIZE=256
# CONFIG_BACKGROUND_PRINT is not set
CONFIG_KFIFO_SIZE=128
CONFIG_UART_ERR_INTERRUPT=y
# CONFIG_UART_STATIS is not set
# end of UART

#
# TRNG
#
CONFIG_TRNG_SUPPORT=y
# end of TRNG

#depends on CONFIG_TRNG_SUPPORT
CONFIG_RANDOM_MAC_ADDR=y

#
# SDCARD
#
CONFIG_SDCARD=y
CONFIG_SDCARD_BUSWIDTH_4LINE=n
CONFIG_SDCARD_DEFAULT_CLOCK_FREQ=0
# end of SDCARD

#
# FATFS
#
CONFIG_FATFS=y
CONFIG_FATFS_SDCARD=y
# end of FATFS

CONFIG_MAC_PHY_BYPASS=y

#
# SDIO
#
CONFIG_SDIO=y
CONFIG_SDIO_V1P0=n
CONFIG_SDIO_V2P0=y
CONFIG_SDIO_HOST=y
CONFIG_SDIO_SLAVE=n
CONFIG_SDIO_CHANNEL_EN=n
CONFIG_SDIO_BIDIRECT_CHANNEL_EN=n
CONFIG_SDIO_GDMA_EN=n
CONFIG_GPIO_NOTIFY_TRANSACTION_EN=n
CONFIG_SDIO_4LINES_EN=n
CONFIG_SDIO_TEST_EN=n
CONFIG_SDIO_DEBUG_EN=n
CONFIG_SDIO_HOST_DEFAULT_CLOCK_FREQ=7
CONFIG_SDIO_HOST_CLR_WRITE_INT=y
# end of SDIO

#
# SPI
#
# CONFIG_SPI_DMA=y
# CONFIG_SPI_SLAVE is not set
# CONFIG_SPI_MASTER is not set
CONFIG_SPI_STATIS=y
CONFIG_SPI_SUPPORT_TX_FIFO_WR_READY=y
# CONFIG_HSLAVE_SPI is not set
CONFIG_QSPI=y
CONFIG_QSPI_FLASH_GD=y
# CONFIG_SPI_MST_FLASH is not set
# CONFIG_SPI_MST_PSRAM is not set
# end of SPI

#
# DMA
#
CONFIG_GENERAL_DMA=y
# end of DMA

#
# PSRAM
#
CONFIG_PSRAM=y
CONFIG_PSRAM_TEST=y
# end of PSRAM

#
# Video
#
CONFIG_MEDIA=y
CONFIG_MEDIA_APP=y
CONFIG_LCD=y

CONFIG_LCD_GC9503V=n
CONFIG_LCD_H050IWV=n
CONFIG_LCD_HX8282=n
CONFIG_LCD_MD0430R=n
CONFIG_LCD_MD0700R=n
CONFIG_LCD_NT35512=n
CONFIG_LCD_NT35510=n
CONFIG_LCD_NT35510_MCU=n
CONFIG_LCD_ST7282=n
CONFIG_LCD_ST7796S=y

CONFIG_DMA2D=n

CONFIG_YUV_BUF=n
CONFIG_JPEGENC_HW=n
CONFIG_JPEGDEC_HW=n
CONFIG_JPEGDEC_SW=n
CONFIG_H264=n
CONFIG_H264_STATIS=n
CONFIG_CAMERA=n
CONFIG_CAMERA_TEST=n
CONFIG_CAMERA_USE_I2C1=n

CONFIG_APP_DEMO_VIDEO_TRANSFER=n
CONFIG_WIFI_TRANSFER=y
CONFIG_IMAGE_STORAGE=y
# end of Video

#
# LVGL
#
CONFIG_LVGL=n
CONFIG_LV_FONT_MONTSERRAT_14=n
# end of LVGL

#
# CALENDAR
#
CONFIG_CALENDAR=y
# end of CALENDAR

#
# System control
#
# CONFIG_SYS_REDUCE_NORMAL_POWER is not set
CONFIG_PM_V2=y
# CONFIG_XTAL_FREQ_40M is not set
CONFIG_XTAL_FREQ_26M=y
CONFIG_XTAL_FREQ=26000000
CONFIG_DCO_FREQ=120000000
CONFIG_SYSTEM_CLOCK=y
# end of System control

#
# PHY
#
# CONFIG_PTA is not set
# end of PHY

#
# I2S
#
CONFIG_I2S=y
# end of I2S

#
# pwm
#
CONFIG_PWM=y
# end of pwm

# CONFIG_SUPPORT_IRDA is not set
# CONFIG_MAILBOX is not set
# end of Driver

# CONFIG_EASY_FLASH is not set
CONFIG_EASY_FLASH=n
CONFIG_EASY_FLASH_V3=n
CONFIG_EASY_FLASH_V4=n

#
# LwIP 2.0.2
#
CONFIG_LWIP=y
CONFIG_DHCP=y
CONFIG_TASK_LWIP_PRIO=4
# CONFIG_LWIP_MEM_DEFAULT is not set
CONFIG_LWIP_MEM_REDUCE=y
# end of LwIP 2.0.2

#
# LwIP 2.1.2
#
# end of LwIP 2.1.2

# CONFIG_MP3PLAYER is not set
# CONFIG_PCM_RESAMPLER is not set

#
# Power Save
#
# CONFIG_AP_IDLE is not set
# CONFIG_FAKE_RTC_PS is not set
# CONFIG_PM_MODEM_PWD is not set
# CONFIG_PM_STANDALONE is not set
CONFIG_PM_V2=y
# end of Power Save

#
# RF Test
#
CONFIG_TX_EVM_TEST=y
CONFIG_RX_SENSE_TEST=y
# end of RF Test

#
# WiFi RWNX Interface
#
CONFIG_WIFI_KMSG_TASK_PRIO=3
CONFIG_WIFI_KMSG_TASK_STACK_SIZE=4096
CONFIG_WIFI_CORE_TASK_PRIO=2
CONFIG_WIFI_CORE_TASK_STACK_SIZE=2048
CONFIG_RWNX_QOS_MSDU=y
CONFIG_RWNX_SW_TXQ=n
CONFIG_RWNX_FAST_CONNECT=y
# end of WiFi RWNX Interface

# CONFIG_SARADC_CALI=y
# CONFIG_SPIDMA is not set
CONFIG_TEMP_DETECT=y
CONFIG_SARADC_NEED_FLUSH=n
CONFIG_SARADC_RANGE_DIVIDE=y
# CONFIG_UART_DEBUG is not set
# CONFIG_UDISK_MP3 is not set
# CONFIG_WFA_CA is not set

#
# Supplicant
#
CONFIG_TASK_WPAS_PRIO=5
CONFIG_WPA3=y
CONFIG_PMF=y
CONFIG_WPA_CTRL_IFACE=y
CONFIG_AP_HT_IE=y
CONFIG_AP_VHT=y
CONFIG_AP_HE=y
# CONFIG_WPA_TWT_TEST is not set
CONFIG_STA_AUTO_RECONNECT=y
# CONFIG_WPA_LOG is not set
# end of Supplicant
# end of Components Configuration
# end of ARMINO Configuration

#
# DEMOS_CONFIG
#
CONFIG_LCD_TEST=n
CONFIG_DMA2D_TEST=n
CONFIG_DOORBELL=y
CONFIG_FFT=n
# end of DEMOS_CONFIG

CONFIG_TFM=n
CONFIG_LIB_HASH_CHECK=n
CONFIG_SDMADC=y
CONFIG_SDMADC_TEST=y

CONFIG_HW_ROTATE_PFC=n
CONFIG_HW_ROTT_TEST=n
#
# CONFIG_FREERTOS_USE_TICKLESS_IDLE
#
CONFIG_FREERTOS_USE_TICKLESS_IDLE=2
#
# CONFIG_SYSTICK_32K
#
CONFIG_SYSTICK_32K=y

CONFIG_TIMER_US=y

CONFIG_UART_LOW_VOLTAGE_SUPPORT=y
#
#GPIO for Power Save: WANIING: modify it should check properties/soc/bk7256/bk7256.defconfig also
#
CONFIG_GPIO_WAKEUP_SUPPORT=y
CONFIG_GPIO_DYNAMIC_WAKEUP_SUPPORT=y
CONFIG_GPIO_DYNAMIC_WAKEUP_SOURCE_MAX_CNT=4
CONFIG_GPIO_WAKEUP_DEBUG=n
CONFIG_DEBUG_FIRMWARE=n
CONFIG_GPIO_DEFAULT_SET_SUPPORT=y
```
