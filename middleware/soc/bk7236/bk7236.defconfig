## middleware/soc/bk7256_cp1/bk7256_cp1.defconfig
```kconfig
#The value config in bk7256.defconfig will over write the Kconfig's default value.
#If the default value in Kconfig satisfy your needs, then you needn't to config again here.

CONFIG_SOC_ARCH="riscv"
CONFIG_SOC_BK7256XX=y
CONFIG_SOC_BK7256=y
CONFIG_SOC_STR="bk7256_cp1"


#
# ARMINO Configuration
#

#
# Common Configuration
#

#
# Compile/Build
#
CONFIG_TOOLCHAIN_PATH="/opt/risc-v/nds32le-elf-mculib-v5f/bin"
CONFIG_TOOLCHAIN_PREFIX="riscv32-elf-"

#
# Debug
#

# CONFIG_ASSERT_IGNORE is not set
# CONFIG_ASSERT_HALT is not set
# CONFIG_ASSERT_REBOOT is not set
# CONFIG_JTAG is not set
# end of Debug
# end of Common Configuration

#
# Features Configuration
#
CONFIG_LWIP=n
CONFIG_LWIP_V2_0=n
CONFIG_LWIP_V2_1=n
CONFIG_NO_HOSTED=y
# CONFIG_SEMI_HOSTED is not set
# CONFIG_FULLY_HOSTED is not set
# CONFIG_WIFI_SENSOR is not set
# end of Features Configuration

#
# Components Configuration
#

#
# Application
#
# CONFIG_DEMO_TEST is not set
# CONFIG_FTPD_UPGRADE is not set
# CONFIG_OTA_HTTP is not set
# CONFIG_OTA_TFTP is not set
# end of Application

CONFIG_AT=n
CONFIG_AT_CMD=n

CONFIG_MAX_COMMANDS=32

#
# PSRAM
#
CONFIG_PSRAM=y
# end of PSRAM

CONFIG_MEDIA=y
#
# Audio
#
CONFIG_AUDIO=n
CONFIG_AUDIO_RISCV_IP_V1_0=n
CONFIG_AUDIO_TRANSFER=n
CONFIG_AUD_TRAS_MODE_CPU0=n
CONFIG_AUD_TRAS_AEC_DUMP_DEBUG=n
#
# end of Audio

#
# SBC
#
CONFIG_SBC=n
#
# end of SBC

# Video
#
CONFIG_LCD=y
CONFIG_DMA2D=n
CONFIG_JPEGDEC_HW=n
CONFIG_JPEGENC_HW=n
# JPEG DECODE SW
CONFIG_JPEGDEC_SW=y
CONFIG_LCD_FLASH_JPEG_DISPLAY=n
CONFIG_LCD_DMA2D_BLEND_FLASH_IMG=n
CONFIG_LVGL=n
CONFIG_LVGL_DEMO=n
# end of Video
#

#
# Video transfer
#
CONFIG_CAMERA=n
CONFIG_CAMERA_USE_I2C1=n
#
#end of Video 

# Calibration
#
# CONFIG_CALI is not set
# CONFIG_MANUAL_CALI is not set
# CONFIG_TPC_PA_MAP is not set
# end of Calibration

#
# ATE
#
# CONFIG_ATE is not set
# end of ATE

#
# BLE
#
# CONFIG_BLE is not set
# CONFIG_BLE_5_X is not set
# CONFIG_BTDM_5_2 is not set
# CONFIG_BLE_4_2 is not set
CONFIG_BLUETOOTH=n
# end of BLE

#
# Cli
#
CONFIG_CLI=y
CONFIG_BKREG=n
# CONFIG_IPERF_TEST is not set
# CONFIG_TCP_SERVER_TEST is not set
# CONFIG_AIRKISS_TEST is not set
# CONFIG_WIFI_RAW_TX_TEST is not set
# CONFIG_I2C1_TEST is not set
# CONFIG_I2C2_TEST is not set
# CONFIG_UART_TEST is not set
# CONFIG_SPI_TEST is not set
# CONFIG_PERI_TEST is not set
# CONFIG_RF_OTA_TEST is not set
CONFIG_AUDIO_TEST=n
CONFIG_SBC_TEST=n
CONFIG_SHELL_ASYNCLOG=y
CONFIG_I2S_TEST=n
CONFIG_FFT_TEST=n
CONFIG_LCD_TEST=n
CONFIG_DMA2D_TEST=n
# end of Cli

#
# RF
#
CONFIG_RF_POLICY=n
CONFIG_RF_POLICY_BLE_REQ=n
# CONFIG_RF_POLICY_WIFI_REQ is not set
# CONFIG_RF_POLICY_CO_REQ is not set
# end of RF

#
# Internal Kconfig
#
# CONFIG_CHECK_MISMATCH is not set
CONFIG_MCU_PS=n
CONFIG_DEEP_PS=n
# CONFIG_TICK_CALI is not set
# CONFIG_STA_PS is not set
# end of Internal Kconfig
CONFIG_STA_PS=y
#
# FreeRTOS
#
CONFIG_FREERTOS=y
# CONFIG_LITEOS_M is not set
CONFIG_FREERTOS_V9=n
CONFIG_FREERTOS_V10=y
CONFIG_FREERTOS_USE_TICKLESS_IDLE=1

#
# Memory Debug
#
# CONFIG_MALLOC_STATIS is not set
# CONFIG_MEM_DEBUG is not set
# end of Memory Debug
# end of FreeRTOS

#
# Startup
#
CONFIG_APP_MAIN_TASK_PRIO=4
CONFIG_APP_MAIN_TASK_STACK_SIZE=4096
# end of Startup

#
# System
#
CONFIG_DUAL_CORE=y
CONFIG_SLAVE_CORE=y
CONFIG_EFUSE=n
CONFIG_ICU=n
# CONFIG_BASE_MAC_FROM_EFUSE is not set
# CONFIG_BASE_MAC_FROM_RF_OTP_FLASH is not set
# CONFIG_BASE_MAC_FROM_NVS is not set
CONFIG_ARCH_RISCV=y
# CONFIG_NEST_INT_SUPPORT is not set
# end of System

#
# USB configuration
#
CONFIG_USB=n

#
# USB
#
CONFIG_USB_HOST=n
# CONFIG_USB_DEVICE is not set
# CONFIG_USB1_PORT is not set
# CONFIG_TASK_USB_PRIO=5
# CONFIG_USB_UVC is not set
# CONFIG_USB_HID is not set
# CONFIG_USB_CCD is not set
# CONFIG_USB_MSD is not set
# CONFIG_USB_CHARGE is not set
# end of USB configuration



#
# WiFi
#
CONFIG_WIFI_IP_AX=n
CONFIG_WIFI_ENABLE=n
CONFIG_WIFI6_CODE_STACK=n
CONFIG_WIFI6=n
CONFIG_WIFI4=n
CONFIG_MSDU_RESV_HEAD_LENGTH=96
CONFIG_MSDU_RESV_TAIL_LENGTH=16
CONFIG_TASK_RECONNECT_PRIO=4
CONFIG_WIFI_MAC_VERSION="V21"
CONFIG_WIFI_MDM_VERSION="v30"
CONFIG_WIFI_PLF_VERSION="v31"
# CONFIG_AP_MONITOR_COEXIST is not set
# CONFIG_WIFI_FAST_CONNECT is not set
# CONFIG_BSSID_CONNECT is not set
# CONFIG_WFA_CERT is not set
# CONFIG_LESS_MEMERY_IN_RWNX is not set
# CONFIG_AP_PROBEREQ_CB is not set
# end of WiFi

CONFIG_BLE_PS=n

#
# BLE 5.x
#
# CONFIG_BLE_HOST_NONE is not set
# CONFIG_BLE_HOST_RW is not set
# CONFIG_BLE_HOST_ZEPHYR is not set
# CONFIG_BLE_MESH_NONE is not set
# CONFIG_BLE_MESH_RW is not set
# CONFIG_BLE_ADV_NUM is not set
# CONFIG_BLE_SCAN_NUM is not set
# CONFIG_BLE_INIT_NUM is not set
# CONFIG_BLE_CONN_NUM is not set
# end of BLE 5.x

#
# Driver
#

#
# Watchdog
#
# CONFIG_INT_WDT is not set
# CONFIG_INT_WDT_PERIOD_MS is not set
CONFIG_TASK_WDT=y
CONFIG_TASK_WDT_PERIOD_MS=60000
CONFIG_INT_AON_WDT=n
# end of Watchdog

#
# UART
#
# CONFIG_UART1 is not set
# CONFIG_UART2 is not set
CONFIG_UART3=y
# CONFIG_PRINT_PORT_UART1 is not set
# CONFIG_PRINT_PORT_UART2 is not set

# UART print port is set to uart3
CONFIG_PRINT_PORT_UART3=y
CONFIG_UART_PRINT_PORT=2
CONFIG_PRINTF_BUF_SIZE=128
# CONFIG_BACKGROUND_PRINT is not set
CONFIG_KFIFO_SIZE=128
# CONFIG_UART_STATIS is not set
# end of UART

#
# TRNG
#
# CONFIG_TRNG_SUPPORT is not set
# end of TRNG

#
# SDCARD
#
# CONFIG_SDCARD is not set
# end of SDCARD

# CONFIG_MAC_PHY_BYPASS is not set

#
# SDIO
#
# CONFIG_SDIO is not set

# end of SDIO

#
# SPI
#
CONFIG_SPI_DMA=n
CONFIG_SPI_SLAVE=n
CONFIG_SPI_MASTER=n
CONFIG_SPI_STATIS=n
CONFIG_SPI_SUPPORT_TX_FIFO_WR_READY=n
# CONFIG_HSLAVE_SPI is not set
# CONFIG_QSPI is not set
# CONFIG_SPI_MST_FLASH is not set
# CONFIG_SPI_MST_PSRAM is not set
# end of SPI

#
# DMA
#
CONFIG_GENERAL_DMA=n
# end of DMA

#
# System control
#
# CONFIG_SYS_REDUCE_NORMAL_POWER is not set
# CONFIG_XTAL_FREQ_40M is not set
CONFIG_XTAL_FREQ_26M=y
CONFIG_XTAL_FREQ=26000000
CONFIG_DCO_FREQ=120000000
# end of System control

#
# PHY
#
# CONFIG_PTA is not set
# end of PHY

#
# I2S
#
CONFIG_I2S=n
# end of I2S

#
# FFT
#
CONFIG_FFT=n
# end of FFT

#
# pwm
#
CONFIG_PWM=y
# end of pwm

CONFIG_SUPPORT_IRDA=n
CONFIG_MAILBOX=y
# end of Driver

# CONFIG_EASY_FLASH is not set
CONFIG_EASY_FLASH=n
CONFIG_EASY_FLASH_V3=n
CONFIG_EASY_FLASH_V4=n

#
# LwIP 2.0.2
#
CONFIG_LWIP=n
# CONFIG_DHCP is not set
# CONFIG_TASK_LWIP_PRIO is not set
# CONFIG_LWIP_MEM_DEFAULT is not set
# CONFIG_LWIP_MEM_REDUCE is not set
# end of LwIP 2.0.2

#
# LwIP 2.1.2
#
# end of LwIP 2.1.2

# CONFIG_MP3PLAYER is not set
# CONFIG_PCM_RESAMPLER is not set

#
# Power Save
#
# CONFIG_AP_IDLE is not set
# CONFIG_FAKE_RTC_PS is not set
# CONFIG_PM_MODEM_PWD is not set
# CONFIG_PM_STANDALONE is not set
# end of Power Save

#
# RF Test
#
# CONFIG_TX_EVM_TEST is not set
# CONFIG_RX_SENSE_TEST is not set
# end of RF Test

CONFIG_RF_POLICY_SUPPORT=n

#
# WiFi RWNX Interface
#
CONFIG_WIFI_RWNX=n
# CONFIG_WIFI_KMSG_TASK_PRIO is not set
# CONFIG_WIFI_KMSG_TASK_STACK_SIZE is not set
# CONFIG_WIFI_CORE_TASK_PRIO is not set
# CONFIG_WIFI_CORE_TASK_STACK_SIZE is not set
# CONFIG_RWNX_QOS_MSDU is not set
# end of WiFi RWNX Interface

# CONFIG_SARADC_CALI is not set
# CONFIG_SPIDMA is not set
# CONFIG_TEMP_DETECT is not set
# CONFIG_UART_DEBUG is not set
# CONFIG_UDISK_MP3 is not set
# CONFIG_WFA_CA is not set

#
# Supplicant
#
# CONFIG_TASK_WPAS_PRIO is not set
# CONFIG_WPA3 is not set
# CONFIG_PMF is not set
# CONFIG_WPA_CTRL_IFACE is not set
# CONFIG_AP_HT_IE is not set
# CONFIG_WPA_LOG is not set
# end of Supplicant
# end of Components Configuration
# end of ARMINO Configuration

#
# system ctrl
#
CONFIG_SYSTEM_CTRL=y
#
# end of system ctrl
#

#
# secure vault
#
# CONFIG_VAULT is not set
#
# end of secure vault
#

#
# i2c
#
CONFIG_I2C=n
#
#bit[0] ID-0 0x1 bit[1] ID-1 0x2
#if support id0 and id1 set 0x3
#
CONFIG_I2C_SUPPORT_ID_BITS=2
#
CONFIG_FM_I2C=n
# end of i2c
#

#
# timer
#
CONFIG_TIMER=y
#
#bit[0] ID-0 0x1 bit[1] ID-1 0x2
#if support id0 and id1 set 0x3
#
CONFIG_TIMER_SUPPORT_ID_BITS=32
#
# end of timer
#

#
# Components
#
CONFIG_MAC_TX_CACHE=n
CONFIG_SIM_UART=n
CONFIG_BK_NETIF=n
CONFIG_DEMOS_IPERF=n
CONFIG_RF_TEST=n
CONFIG_WPA_SUPPLICANT_2_9=n
CONFIG_BK_HOSTAPD=n
CONFIG_HTTP=n
CONFIG_VAD=n
CONFIG_BK_AIRKISS=n
CONFIG_BLE_WIFI_EXCHANGE=n
CONFIG_NET_PARAM_INTF=n
CONFIG_POWER_SAVE=n

CONFIG_AON_PMU=y
CONFIG_FLASH=n
CONFIG_PWM=n
CONFIG_TRNG_SUPPORT=n
CONFIG_EFUSE=n
CONFIG_SARADC=n
CONFIG_SARADC_NEED_FLUSH=n
CONFIG_TIMER_COUNTER=n

#
#mqtt
#
CONFIG_ALI_MQTT=n

# jtag change group gpio
#
#
CONFIG_CHANGE_JTAG_GPIO=y

# adc key support
#
#
CONFIG_ADC_KEY=n
```
