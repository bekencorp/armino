## middleware/soc/bk7271/bk7271.defconfig
```kconfig
#The value config in bk7271.defconfig will over write the Kconfig's default value.
#If the default value in Kconfig satisfy your needs, then you needn't to config again here.

CONFIG_SOC_ARCH="arm9"
CONFIG_SOC_BK7271=y
CONFIG_SOC_STR="bk7271"

#
# ARMINO Configuration
#

#
# Common Configuration
#

#
# Compile/Build
#

#
# Debug
#
CONFIG_DEBUG_FIRMWARE=y
CONFIG_ASSERT_IGNORE=y
# CONFIG_ASSERT_HALT is not set
# CONFIG_ASSERT_REBOOT is not set
# CONFIG_JTAG is not set
# end of Debug
# end of Common Configuration

#
# Features Configuration
#
CONFIG_LWIP_V2_0=y
# CONFIG_LWIP_V2_1 is not set
CONFIG_NO_HOSTED=y
# CONFIG_SEMI_HOSTED is not set
# CONFIG_FULLY_HOSTED is not set
# CONFIG_WIFI_SENSOR is not set
# end of Features Configuration

#
# Components Configuration
#

#
# Application
#
# CONFIG_DEMO_TEST is not set
# CONFIG_FTPD_UPGRADE is not set
CONFIG_OTA_HTTP=y
# CONFIG_OTA_TFTP is not set
# end of Application

# CONFIG_AT is not set

#
# Audio
#
CONFIG_AUDIO=y
CONFIG_AUDIO_ADC=y
CONFIG_AUDIO_DAC=y
CONFIG_AUDIO_DSP_IP_V1_0=y
# end of Audio
CONFIG_DMA2D_TEST=n
#
# Video transfer
#
CONFIG_USE_APP_DEMO_VIDEO_TRANSSER=y
CONFIG_APP_DEMO_VIDEO_TRANSFER=y
CONFIG_NET_WORK_VIDEO_TRANSFER=y
#
#end of Video transfer
#

#
# Calibration
#
CONFIG_CALI=y
CONFIG_MANUAL_CALI=y
# CONFIG_TPC_PA_MAP is not set
# end of Calibration

#
# ATE
#
CONFIG_ATE=y
# end of ATE

#
# BLE
#
# CONFIG_BLE is not set
# end of BLE

#
# Cli
#
CONFIG_CLI=y
CONFIG_BKREG=y
# CONFIG_IPERF_TEST is not set
# CONFIG_TCP_SERVER_TEST is not set
# CONFIG_AIRKISS_TEST is not set
# CONFIG_WIFI_RAW_TX_TEST is not set
CONFIG_I2C1_TEST=y
# CONFIG_I2C2_TEST is not set
# CONFIG_UART_TEST is not set
# CONFIG_SPI_TEST is not set
# CONFIG_PERI_TEST is not set
# CONFIG_RF_OTA_TEST is not set
# end of Cli

#
# RF
#
CONFIG_RF_POLICY_BLE_REQ=y
# CONFIG_RF_POLICY_WIFI_REQ is not set
# CONFIG_RF_POLICY_CO_REQ is not set
# end of RF

#
# Internal Kconfig
#
CONFIG_CHECK_MISMATCH=y
# CONFIG_MCU_PS is not set
# CONFIG_DEEP_PS is not set
CONFIG_TICK_CALI=y
# CONFIG_STA_PS is not set
# end of Internal Kconfig

#
# FreeRTOS
#
CONFIG_FREERTOS=y
# CONFIG_LITEOS_M is not set
CONFIG_FREERTOS_V9=y
# CONFIG_FREERTOS_V10 is not set

#
# Memory Debug
#
# CONFIG_MALLOC_STATIS is not set
# CONFIG_MEM_DEBUG is not set
# end of Memory Debug
# end of FreeRTOS

#
# Startup
#
CONFIG_APP_MAIN_TASK_PRIO=4
CONFIG_APP_MAIN_TASK_STACK_SIZE=4096
# end of Startup

#
# System
#
# CONFIG_BASE_MAC_FROM_EFUSE is not set
CONFIG_BASE_MAC_FROM_RF_OTP_FLASH=y
# CONFIG_BASE_MAC_FROM_NVS is not set
# end of System

#
# USB configuration
#
CONFIG_USB=y

#
# USB
#
CONFIG_USB_HOST=y
# CONFIG_USB_DEVICE is not set
# CONFIG_USB1_PORT is not set
CONFIG_TASK_USB_PRIO=5
CONFIG_USB_MSD=y
# CONFIG_USB_HID is not set
# CONFIG_USB_CCD is not set
# CONFIG_USB_UVC is not set
# CONFIG_USB_CHARGE is not set

#
# DSP
#
CONFIG_DSP=y
CONFIG_DSP_SRC_ADD=0x130000
# end of DSP
# end of USB
# end of USB configuration

#
# WiFi
#
CONFIG_WIFI_IP=y
# CONFIG_WIFI6_CODE_STACK is not set
CONFIG_WIFI4=y
CONFIG_MSDU_RESV_HEAD_LENGTH=96
CONFIG_MSDU_RESV_TAIL_LENGTH=16
CONFIG_TASK_RECONNECT_PRIO=4
# CONFIG_AP_MONITOR_COEXIST is not set
# CONFIG_WIFI_FAST_CONNECT is not set
# CONFIG_BSSID_CONNECT is not set
# CONFIG_WFA_CERT is not set
# CONFIG_LESS_MEMERY_IN_RWNX is not set
# CONFIG_AP_PROBEREQ_CB is not set
# end of WiFi

#
# BT Configuration
#
CONFIG_BT=y
CONFIG_BT_HOST_JUNGO=y
CONFIG_BT_SRC_ADD=0x280000
# end of BT Configuration

#
# Camera
#
CONFIG_CAMERA=y
CONFIG_CAMERA_USE_I2C0=n
CONFIG_CAMERA_USE_I2C1=n
CONFIG_CAMERA_USE_I2C2=y
CONFIG_CAMERA_I2C_ID=2
# end of Camera

CONFIG_MAC_BSSID=y

#
# Driver
#

#
# Watchdog
#
CONFIG_INT_WDT=y
CONFIG_INT_WDT_PERIOD_MS=1000
CONFIG_TASK_WDT=y
CONFIG_TASK_WDT_PERIOD_MS=60000
# end of Watchdog

#
# UART
#
CONFIG_UART3=y
CONFIG_UART_ATE_PORT=1
CONFIG_PRINT_PORT_UART1=y
CONFIG_UART_PRINT_PORT=0
CONFIG_PRINTF_BUF_SIZE=128
# CONFIG_BACKGROUND_PRINT is not set
CONFIG_KFIFO_SIZE=128
# CONFIG_UART_STATIS is not set
# end of UART

#
# TRNG
#
CONFIG_TRNG_SUPPORT=y
# end of TRNG

#depends on CONFIG_TRNG_SUPPORT
CONFIG_RANDOM_MAC_ADDR=y

#
# SDCARD
#
# CONFIG_SDCARD_HOST is not set
# end of SDCARD

CONFIG_MAC_PHY_BYPASS=y

#
# SDIO
#
# CONFIG_SDIO is not set
# end of SDIO

#
# SPI
#
CONFIG_SPI_DMA=y
CONFIG_SPI_SLAVE=y
CONFIG_SPI_MASTER=y
CONFIG_SPI_STATIS=y
CONFIG_SPI_SUPPORT_TX_FIFO_WR_READY=y
# CONFIG_HSLAVE_SPI is not set
# CONFIG_QSPI is not set
# CONFIG_SPI_MST_FLASH is not set
# CONFIG_SPI_MST_PSRAM is not set
# end of SPI

#
# DMA
#
CONFIG_GENERAL_DMA=y
# end of DMA

#
# JPEG ENCODE
#
CONFIG_JPEG_ENCODE=y
# end of JPEG ENCODE

#
# System control
#
# CONFIG_SYS_REDUCE_NORMAL_POWER is not set
# CONFIG_XTAL_FREQ_40M is not set
CONFIG_XTAL_FREQ_26M=y
CONFIG_XTAL_FREQ=26000000
CONFIG_DCO_FREQ=320000000
# end of System control

#
# PHY
#
# CONFIG_PTA is not set
# end of PHY

#
# I2S
#
# CONFIG_I2S is not set
# end of I2S

#
# pwm
#
CONFIG_PWM=y
# end of pwm

#
# mailbox
#
CONFIG_MAILBOX=y
# end of mailbox

CONFIG_SUPPORT_IRDA=y
CONFIG_CALENDAR=y
# end of Driver

# CONFIG_EASY_FLASH is not set

#
# LwIP 2.0.2
#
CONFIG_LWIP=y
CONFIG_DHCP=y
CONFIG_TASK_LWIP_PRIO=4
CONFIG_LWIP_MEM_DEFAULT=y
# CONFIG_LWIP_MEM_REDUCE is not set
# end of LwIP 2.0.2

#
# LwIP 2.1.2
#
# end of LwIP 2.1.2

# CONFIG_MP3PLAYER is not set
CONFIG_PCM_RESAMPLER=y

#
# Power Save
#
# CONFIG_AP_IDLE is not set
# CONFIG_FAKE_RTC_PS is not set
# CONFIG_PM_MODEM_PWD is not set
# CONFIG_PM_STANDALONE is not set
# end of Power Save

#
# RF Test
#
CONFIG_TX_EVM_TEST=y
CONFIG_RX_SENSE_TEST=y
# end of RF Test

#
# WiFi RWNX Interface
#
CONFIG_WIFI_KMSG_TASK_PRIO=3
CONFIG_WIFI_KMSG_TASK_STACK_SIZE=4096
CONFIG_WIFI_CORE_TASK_PRIO=2
CONFIG_WIFI_CORE_TASK_STACK_SIZE=2048
CONFIG_RWNX_QOS_MSDU=y
# end of WiFi RWNX Interface

# CONFIG_SARADC_CALI is not set
# CONFIG_SPIDMA is not set
# CONFIG_TEMP_DETECT is not set
# CONFIG_UART_DEBUG is not set
# CONFIG_UDISK_MP3 is not set

#
# USB
#
CONFIG_USB2_PORT=y

#
# DSP
#
# end of DSP
# end of USB

# CONFIG_WFA_CA is not set

#
# Supplicant
#
CONFIG_TASK_WPAS_PRIO=5
# CONFIG_WPA3 is not set
# CONFIG_PMF is not set
CONFIG_WPA_CTRL_IFACE=y
# CONFIG_AP_HT_IE is not set
# CONFIG_WPA_LOG is not set
# end of Supplicant
# end of Components Configuration
# end of ARMINO Configuration

CONFIG_PWM_HAS_TWO_INT=y
CONFIG_ICU_GPIO=y
```

## projects/bluetooth/hci/main/Kconfig.projbuild
```kconfig
menu "LVLG Music Configuration"

    config LV_USE_DEMO_MUSIC
        bool "LVLG Music"
        default n
endmenu
```

## projects/controller/sdkconfig.defaults
```kconfig
#os choice
#CONFIG_FREERTOS=y
#CONFIG_LITEOS_M=n
#CONFIG_FREERTOS_V9=y
#CONFIG_FREERTOS_V10=n
```

## projects/examples/build_system/202_global_kconfig/components/c1/Kconfig.projbuild
```kconfig
menu "Top config in c1 component"

    config GLOBAL_IN_C1
        bool "Config item in top menu"
        default y
        help
            Add config item to top menu in menuconfig

endmenu
```

## projects/examples/build_system/202_global_kconfig/main/Kconfig.projbuild
```kconfig
menu "Top config in main component"

    config GLOBAL_IN_MAIN
        bool "Config item in top menu"
        default y
        help
            Add config item to top menu in menuconfig

endmenu
```

## projects/examples/build_system/203_config_only/components/config_only/Kconfig
```kconfig
menu "Config-only"
	config CONFIG_ONLY
		bool "Enable config-only"
		default y
endmenu
```

## projects/examples/peripherals/uart/main/Kconfig.projbuild
```kconfig
menu "Example Configuration"
	choice
		prompt "UART ID"
		default UART_EXAMPLE_UART1

		config UART_EXAMPLE_UART1
			bool "UART1"

		config UART_EXAMPLE_UART2
			bool "UART2"

		config UART_EXAMPLE_UART3
			bool "UART3"
			depends on SOC_BK7271
	endchoice

	config UART_EXAMPLE_UART_ID
		int
		default 0 if UART_EXAMPLE_UART1
		default 1 if UART_EXAMPLE_UART2
		default 2 if UART_EXAMPLE_UART3

	config UART_EXAMPLE_BAUD_RATE
		int "Baud Rate"
		default 115200

	choice
		prompt "Data Bits"
		default UART_EXAMPLE_DATA_BITS_8

		config UART_EXAMPLE_DATA_BITS_5
			bool "5 bits"

		config UART_EXAMPLE_DATA_BITS_6
			bool "6 bits"

		config UART_EXAMPLE_DATA_BITS_7
			bool "7 bits"

		config UART_EXAMPLE_DATA_BITS_8
			bool "8 bits"
	endchoice

	config UART_EXAMPLE_DATA_BITS
		int
		default 0 if UART_EXAMPLE_DATA_BITS_5
		default 1 if UART_EXAMPLE_DATA_BITS_6
		default 2 if UART_EXAMPLE_DATA_BITS_7
		default 3 if UART_EXAMPLE_DATA_BITS_8

	choice
		prompt "Parity"
		default UART_EXAMPLE_PARITY_NONE

		config UART_EXAMPLE_PARITY_NONE
			bool "NONE"

		config UART_EXAMPLE_PARITY_ODD
			bool "ODD"

		config UART_EXAMPLE_PARITY_EVEN
			bool "EVEN"
	endchoice

	config UART_EXAMPLE_PARITY
		int
		default 0 if UART_EXAMPLE_PARITY_NONE
		default 1 if UART_EXAMPLE_PARITY_ODD
		default 2 if UART_EXAMPLE_PARITY_EVEN

	choice
		prompt "Stop Bits"
		default UART_EXAMPLE_STOP_BITS_1

		config UART_EXAMPLE_STOP_BITS_1
			bool "1 bit"

		config UART_EXAMPLE_STOP_BITS_2
			bool "2 bits"
	endchoice

	config UART_EXAMPLE_STOP_BITS
		int
		default 0 if UART_EXAMPLE_STOP_BITS_1
		default 1 if UART_EXAMPLE_STOP_BITS_2

	choice
		prompt "Flow Control"
		default UART_EXAMPLE_FLOW_CTRL_DISABLE

		config UART_EXAMPLE_FLOW_CTRL_DISABLE
			bool "Disable"

		config UART_EXAMPLE_FLOW_CTRL_CTS_RTS
			bool "CTS/RTS"
	endchoice

	config UART_EXAMPLE_FLOW_CTRL
		int
		default 0 if UART_EXAMPLE_FLOW_CTRL_DISABLE
		default 1 if UART_EXAMPLE_FLOW_CTRL_CTS_RTS

	choice
		prompt "Source Clock"
		default UART_EXAMPLE_SRC_CLK_XTAL_26M

		config UART_EXAMPLE_SRC_CLK_DCO
			bool "DCO"

		config UART_EXAMPLE_SRC_CLK_XTAL_26M
			bool "XTAL 26M"
	endchoice

	config UART_EXAMPLE_SRC_CLK
		int
		default 0 if UART_EXAMPLE_SRC_CLK_DCO
		default 1 if UART_EXAMPLE_SRC_CLK_XTAL_26M
endmenu
```

## projects/examples/wifi/ap/main/Kconfig.projbuild
```kconfig
menu "Example Configuration"

    config EXAMPLE_WIFI_SSID
        string "WiFi SSID"
        default "myssid"
        help
            SSID (network name) for the example to connect to.

    config EXAMPLE_WIFI_PASSWORD
        string "WiFi Password"
        default "mypassword"
        help
            WiFi password (WPA or WPA2) for the example to use.

    config EXAMPLE_IP
        string "IP4 Address of AP"
        default "192.168.10.1"
        help
            Set the IP4 address of AP

    config EXAMPLE_MASK 
        string "Network mask of AP"
        default "255.255.255.0"
        help
            Set the network mask address of AP

    config EXAMPLE_GW
        string "Gateway address of AP"
        default "192.168.10.1"
        help
            Set the gateway address of AP

    config EXAMPLE_DNS
        string "DNS address of AP"
        default "192.168.10.1"
        help
            Set the DNS address of AP
endmenu
```

## projects/examples/wifi/scan/main/Kconfig.projbuild
```kconfig
menu "Example Configuration"

    config EXAMPLE_SCAN_ALL_SSID
        bool "Scan All SSID"
        default y
 
    config EXAMPLE_WIFI_SSID
        string "WiFi SSID"
	depends on !EXAMPLE_SCAN_ALL_SSID
        default "myssid"
        help
            Set the SSID to be scaned
endmenu
```

## projects/lvgl/86box_smart_panel/main/Kconfig.projbuild
```kconfig
menu "LVGL 86box Configuration"

    config LV_USE_DEMO_86BOX
        bool "LVGL 86Box"
        default n
endmenu
```

## projects/lvgl/benchmark/main/Kconfig.projbuild
```kconfig
menu "LVGL Benchmark Configuration"

    config LV_USE_DEMO_BENCHMARK
        bool "LVGL Benchmark"
        default n
endmenu
```

## projects/lvgl/camera/main/Kconfig.projbuild
```kconfig
menu "LVGL Meter Configuration"

    config LV_USE_DEMO_METER
        bool "LVGL Meter"
        default n
endmenu
```

## projects/lvgl/keypad_encoder/main/Kconfig.projbuild
```kconfig
menu "LVGL Keypad encoder Configuration"

    config LV_USE_DEMO_KEYPAD_AND_ENCODER
        bool "LVGL Keypad encoder"
        default n
endmenu
```

## projects/lvgl/lcd_qspi_meter/main/Kconfig.projbuild
```kconfig
menu "LVGL Meter Configuration"

    config LV_QSPI_USE_DEMO_METER
        bool "LVGL QSPI Meter"
        default n
endmenu
```

## projects/lvgl/qspi/main/Kconfig.projbuild
```kconfig
menu "LVGL QSPI Configuration"

    config LV_QSPI_DEMO
        bool "Enable LVGL QSPI Demo"
        default n
endmenu
```
