## middleware/soc/bk7256/bk7256.defconfig
```kconfig
CONFIG_SOC_ARCH="riscv"
CONFIG_SOC_BK7256XX=y
CONFIG_SOC_BK7256=y
CONFIG_SOC_STR="bk7256"
CONFIG_TOOLCHAIN_PATH="/opt/risc-v/nds32le-elf-mculib-v5/bin"
CONFIG_TOOLCHAIN_PREFIX="riscv32-elf-"
# CONFIG_ASSERT_IGNORE is not set
# CONFIG_ASSERT_HALT is not set
# CONFIG_ASSERT_REBOOT is not set
# CONFIG_JTAG is not set
CONFIG_LWIP_V2_1=y
CONFIG_NO_HOSTED=y
# CONFIG_SEMI_HOSTED is not set
# CONFIG_FULLY_HOSTED is not set
# CONFIG_WIFI_SENSOR is not set
CONFIG_WEBCLIENT=y
# CONFIG_DEMO_TEST is not set
CONFIG_OTA_HTTP=y
# CONFIG_OTA_TFTP is not set
CONFIG_HTTP_OTA_WITH_BLE=y
# CONFIG_FTPD_UPGRADE is not set
CONFIG_HTTP_AB_PARTITION=n
CONFIG_OTA=n
# CONFIG_AT is not set
CONFIG_AT_CMD=y
CONFIG_PSRAM=y
CONFIG_PSRAM_AS_SYS_MEMORY=y
CONFIG_PSRAM_TEST=y
CONFIG_AUDIO=y
CONFIG_AUDIO_RISCV_IP_V1_0=y
CONFIG_AUD_INTF=y
CONFIG_AUD_INTF_TEST=n
CONFIG_AUDIO_TRANSFER=y
CONFIG_AUD_TRAS_MODE_CPU0=y
CONFIG_AUD_TRAS_AEC_DUMP_DEBUG=n
CONFIG_AUD_TRAS_AEC_DUMP_MODE_TF=n
CONFIG_AUD_TRAS_AEC_DUMP_UART_BAUDRATE=921600
CONFIG_AUD_TRAS_AEC_DUMP_UART_ID=1
CONFIG_AUD_TRAS_LOST_COUNT_DEBUG=y
CONFIG_AUD_TRAS_AEC_MIC_DELAY_DEBUG=n
CONFIG_AUD_TRAS_AEC_MIC_DELAY_POINTS=55
CONFIG_DOORBELL_DEMO2=n
CONFIG_AUD_TRAS_DAC_DEBUG=n
CONFIG_AUD_TRAS_DAC_PA_CTRL=n
CONFIG_AUD_TRAS_UAC_SPK_VOL_CTRL_MODE_DIRECT=y
CONFIG_ES8311=n
CONFIG_MEDIA=y
CONFIG_WIFI_TRANSFER=y
CONFIG_IMAGE_STORAGE=y
CONFIG_JPEG_YUV_MIX=y
CONFIG_LCD=y
CONFIG_LCD_GC9503V=y
CONFIG_LCD_H050IWV=y
CONFIG_LCD_HX8282=y
CONFIG_LCD_MD0430R=y
CONFIG_LCD_MD0700R=y
CONFIG_LCD_NT35512=y
CONFIG_LCD_NT35510=y
CONFIG_LCD_NT35510_MCU=y
CONFIG_LCD_ST7282=y
CONFIG_LCD_ST7796S=y
CONFIG_LCD_ST7710S=y
CONFIG_LCD_ST7701S=y
CONFIG_LCD_ST7701S_LY=y
CONFIG_LCD_ST7789V=y
CONFIG_LVGL=n
CONFIG_LVGL_DEMO=n
CONFIG_LVGL_USE_DIRECT_MODE=y
CONFIG_DMA2D=y
CONFIG_JPEGDEC_HW=y
CONFIG_JPEGENC_HW=y
CONFIG_JPEGDEC_SW=y
CONFIG_LCD_FLASH_JPEG_DISPLAY=n
CONFIG_LCD_DMA2D_BLEND=n
CONFIG_LCD_FONT_BLEND=y
CONFIG_LCD_POWER_GPIO_CTRL=y
CONFIG_CAMERA_POWER_GPIO_CTRL=y
CONFIG_DVP_CAMERA=y
CONFIG_USE_APP_DEMO_VIDEO_TRANSSER=y
CONFIG_APP_DEMO_VIDEO_TRANSFER=y
CONFIG_NET_WORK_VIDEO_TRANSFER=y
CONFIG_DVP_CAMERA_I2C_ID=1
CONFIG_DVP_CAMERA_TEST=y
CONFIG_VIDEO_AVI=n
CONFIG_QRCODEGEN_TEST=y
CONFIG_TOUCH=y
CONFIG_TOUCH_TEST=y
CONFIG_TOUCH_INTERNAL_SERIAL_CAP=y
CONFIG_TOUCH_PM_SUPPORT=n
CONFIG_TP=n
CONFIG_CALI=y
CONFIG_MANUAL_CALI=y
CONFIG_TPC_PA_MAP=y
CONFIG_ATE=y
CONFIG_ATE_TEST=n
CONFIG_BLE=y
CONFIG_BLE_5_X=n
CONFIG_BTDM_5_2=y
CONFIG_BT=n
# CONFIG_BLE_4_2 is not set
CONFIG_CLI=y
CONFIG_BKREG=y
CONFIG_MAX_COMMANDS=255
# CONFIG_TCP_SERVER_TEST is not set
# CONFIG_AIRKISS_TEST is not set
# CONFIG_WIFI_RAW_TX_TEST is not set
# CONFIG_I2C1_TEST is not set
# CONFIG_I2C2_TEST is not set
# CONFIG_UART_TEST is not set
# CONFIG_SPI_TEST is not set
CONFIG_PERI_TEST=n
CONFIG_AON_RTC_TEST=y
# CONFIG_RF_OTA_TEST is not set
CONFIG_SHELL_ASYNCLOG=y
CONFIG_AUDIO_TEST=n
CONFIG_AUDIO_AEC_TEST=n
CONFIG_AUDIO_G711_TEST=n
CONFIG_AUDIO_MP3_TEST=y
CONFIG_AUDIO_RSP_TEST=n
CONFIG_AUDIO_VAD_TEST=n
CONFIG_AUDIO_NS_TEST=n
CONFIG_AUDIO_OPUS_TEST=n
CONFIG_AUDIO_ADPCM_TEST=n
CONFIG_SBC=n
CONFIG_SBC_TEST=n
CONFIG_FFT_TEST=n
CONFIG_I2S_TEST=n
CONFIG_ES8311_TEST=n
CONFIG_LCD_TEST=n
CONFIG_DMA2D_TEST=n
CONFIG_DOORBELL=y
CONFIG_FFT=n
CONFIG_AV_DEMO=n
CONFIG_RF_POLICY_BLE_REQ=y
# CONFIG_RF_POLICY_WIFI_REQ is not set
# CONFIG_RF_POLICY_CO_REQ is not set
CONFIG_CHECK_MISMATCH=y
CONFIG_MCU_PS=y
CONFIG_DEEP_PS=n
CONFIG_TICK_CALI=y
CONFIG_STA_PS=y
CONFIG_FREERTOS=y
# CONFIG_LITEOS_M is not set
CONFIG_FREERTOS_V9=n
CONFIG_FREERTOS_V10=y
CONFIG_CUSTOMIZE_HEAP_SIZE=217088
# CONFIG_MALLOC_STATIS is not set
CONFIG_MEM_DEBUG=y
CONFIG_APP_MAIN_TASK_PRIO=4
CONFIG_APP_MAIN_TASK_STACK_SIZE=4096
CONFIG_SLAVE_CORE_RESET_VALUE=1
# CONFIG_BASE_MAC_FROM_EFUSE is not set
# CONFIG_BASE_MAC_FROM_RF_OTP_FLASH is not set
CONFIG_NEW_MAC_POLICY=y
CONFIG_ARCH_RISCV=y
CONFIG_NEST_INT_SUPPORT=y
CONFIG_USB=y
CONFIG_USB_HOST=y
# CONFIG_USB_DEVICE is not set
# CONFIG_USB1_PORT is not set
CONFIG_TASK_USB_PRIO=5
# CONFIG_USB_MSD is not set
# CONFIG_USB_HID is not set
# CONFIG_USB_CCD is not set
CONFIG_USB_UVC=y
CONFIG_USB_UVC_DEBUG=n
CONFIG_UVC_OTA_DEMO=n
CONFIG_USB_UAC=y
CONFIG_USB_UAC_DEBUG=n
CONFIG_USB_UAC_MIC=y
CONFIG_USB_UAC_SPEAKER=y
# CONFIG_USB_CHARGE is not set
CONFIG_VND_CAL=y
CONFIG_WIFI_ENABLE=y
CONFIG_WIFI_IP_AX=y
CONFIG_WIFI6_CODE_STACK=y
CONFIG_WIFI6=y
CONFIG_WIFI4=y
CONFIG_MSDU_RESV_HEAD_LENGTH=96
CONFIG_MSDU_RESV_TAIL_LENGTH=16
CONFIG_TASK_RECONNECT_PRIO=4
CONFIG_WIFI6_IP_DEBUG=y
CONFIG_WIFI_MAC_VERSION="V21"
CONFIG_WIFI_MDM_VERSION="v30"
CONFIG_WIFI_PLF_VERSION="v31"
CONFIG_MM_PS_SET_LISTEN_INTERVAL_VALUE=30
CONFIG_MOBILE_CONNECT_SAP_STATISTICS=y
CONFIG_HE_MCS_LIMIT_7=y
# CONFIG_AP_MONITOR_COEXIST is not set
CONFIG_WIFI_FAST_CONNECT=y
CONFIG_ENABLE_WIFI_DEFAULT_CONNECT=n
# CONFIG_WIFI_FAST_DHCP is not set
CONFIG_BSSID_CONNECT=y
# CONFIG_WFA_CERT is not set
# CONFIG_LESS_MEMERY_IN_RWNX is not set
# CONFIG_AP_PROBEREQ_CB is not set
# CONFIG_MM_PS_BASED_ON_LISTEN_INTERVAL is not set
CONFIG_BLE_PS=y
CONFIG_BLE_USE_HIGH_POWER_LEVEL=y
# CONFIG_BLE_HOST_NONE is not set
# CONFIG_BLE_HOST_ZEPHYR is not set
# CONFIG_BLE_MESH_RW is not set
CONFIG_MAC_BSSID=y
CONFIG_INT_WDT=y
CONFIG_INT_WDT_PERIOD_MS=8000
CONFIG_TASK_WDT=y
CONFIG_TASK_WDT_PERIOD_MS=16000
CONFIG_UART1=y
CONFIG_UART2=y
CONFIG_UART_ATE_PORT=0
CONFIG_PRINT_PORT_UART1=y
CONFIG_UART_PRINT_PORT=0
CONFIG_PRINTF_BUF_SIZE=128
# CONFIG_BACKGROUND_PRINT is not set
CONFIG_KFIFO_SIZE=256
# CONFIG_UART_STATIS is not set
CONFIG_UART1_FLOW_CTRL=n
# CONFIG_UART2_FLOW_CTRL is not set
# CONFIG_UART3_FLOW_CTRL is not set
CONFIG_IDLE_UART_OUT_TEST=n
CONFIG_UART_LOW_VOLTAGE_SUPPORT=y
CONFIG_UART_ERR_INTERRUPT=y
CONFIG_UART_RX_DMA=y
CONFIG_UART_RX_DMA_KFIFO_SIZE=512
CONFIG_TRNG_SUPPORT=y
CONFIG_RANDOM_MAC_ADDR=y
CONFIG_MAC_PHY_BYPASS=y
CONFIG_BK_MAC_ADDR_CHECK=y
CONFIG_SDIO=y
CONFIG_SDIO_V1P0=n
CONFIG_SDIO_V2P0=y
CONFIG_SDIO_HOST=y
CONFIG_SDIO_SLAVE=n
CONFIG_SDIO_CHANNEL_EN=n
CONFIG_SDIO_BIDIRECT_CHANNEL_EN=n
CONFIG_SDIO_GDMA_EN=n
CONFIG_GPIO_NOTIFY_TRANSACTION_EN=n
CONFIG_SDIO_4LINES_EN=n
CONFIG_SDIO_TEST_EN=n
CONFIG_SDIO_DEBUG_EN=n
CONFIG_SDIO_HOST_DEFAULT_CLOCK_FREQ=7
CONFIG_SDCARD=y
CONFIG_SDCARD_BUSWIDTH_4LINE=n
CONFIG_SDCARD_POWER_GPIO_CTRL=y
CONFIG_SDCARD_CHECK_INSERTION_EN=n
CONFIG_SDCARD_CHECK_INSERTION_GPIO_ID=6
CONFIG_FATFS=y
CONFIG_FATFS_SDCARD=y
CONFIG_SPI_DMA=y
CONFIG_SPI_SLAVE=y
CONFIG_SPI_MASTER=y
CONFIG_SPI_STATIS=y
CONFIG_SPI_SUPPORT_TX_FIFO_WR_READY=y
# CONFIG_HSLAVE_SPI is not set
CONFIG_QSPI=y
CONFIG_LCD_QSPI=y
CONFIG_LCD_QSPI_SH8601A=y
CONFIG_LCD_QSPI_ST77903=y
CONFIG_LCD_QSPI_TEST=y
# CONFIG_SPI_MST_FLASH is not set
# CONFIG_SPI_MST_PSRAM is not set
CONFIG_AON_RTC=y
CONFIG_AON_RTC_MANY_USERS=y
CONFIG_AON_RTC_DEBUG=n
CONFIG_AON_RTC_KEEP_TIME_SUPPORT=y
CONFIG_GENERAL_DMA=y
# CONFIG_SYS_REDUCE_NORMAL_POWER is not set
# CONFIG_XTAL_FREQ_40M is not set
CONFIG_XTAL_FREQ_26M=y
CONFIG_XTAL_FREQ=26000000
CONFIG_DCO_FREQ=120000000
# CONFIG_PTA is not set
CONFIG_I2S=n
CONFIG_PWM=y
CONFIG_MAILBOX=y
# CONFIG_SUPPORT_IRDA is not set
CONFIG_ICU=n
CONFIG_EASY_FLASH_V3=y
CONFIG_EASY_FLASH_V4=n
CONFIG_EASY_FLASH=y
CONFIG_EF_START_ADDR=0x3FC000
CONFIG_FLASHDB=n
CONFIG_FLASHDB_USING_KVDB=n
CONFIG_FLASHDB_KVDB_START_ADDR=0x3EF000
CONFIG_FLASHDB_KVDB_SIZE=8192
CONFIG_FLASHDB_USING_TSDB=n
CONFIG_FLASHDB_TSDB_START_ADDR=0x3F1000
CONFIG_FLASHDB_TSDB_SIZE=16384
CONFIG_FLASHDB_DEMO=n
CONFIG_LWIP=y
CONFIG_DHCP=y
CONFIG_TASK_LWIP_PRIO=4
# CONFIG_LWIP_MEM_DEFAULT is not set
CONFIG_LWIP_MEM_REDUCE=y
# CONFIG_MP3PLAYER is not set
# CONFIG_PCM_RESAMPLER is not set
# CONFIG_AP_IDLE is not set
# CONFIG_FAKE_RTC_PS is not set
# CONFIG_PM_MODEM_PWD is not set
# CONFIG_PM_STANDALONE is not set
CONFIG_PM_V2=y
CONFIG_GPIO_DEFAULT_SET_SUPPORT=y
CONFIG_GPIO_WAKEUP_SUPPORT=y
CONFIG_GPIO_DYNAMIC_WAKEUP_SUPPORT=y
CONFIG_GPIO_DYNAMIC_WAKEUP_SOURCE_MAX_CNT=4
CONFIG_GPIO_WAKEUP_DEBUG=n
CONFIG_GPIO_SIMULATE_UART_WRITE=y
CONFIG_TX_EVM_TEST=y
CONFIG_RX_SENSE_TEST=y
CONFIG_WIFI_KMSG_TASK_PRIO=3
CONFIG_WIFI_KMSG_TASK_STACK_SIZE=4096
CONFIG_WIFI_CORE_TASK_PRIO=2
CONFIG_WIFI_CORE_TASK_STACK_SIZE=2048
CONFIG_RWNX_QOS_MSDU=y
CONFIG_RWNX_SW_TXQ=y
# CONFIG_SPIDMA is not set
CONFIG_TEMP_DETECT=y
CONFIG_SARADC_CALI=y
# CONFIG_UART_DEBUG is not set
# CONFIG_UDISK_MP3 is not set
# CONFIG_WFA_CA is not set
CONFIG_TASK_WPAS_PRIO=5
CONFIG_WPA3=y
CONFIG_WPA_CTRL_IFACE=y
CONFIG_AP_HT_IE=y
CONFIG_AP_VHT=y
CONFIG_AP_HE=y
CONFIG_COMPONENTS_WPA_TWT_TEST=n
# CONFIG_WPA_LOG is not set
CONFIG_COMPONENTS_STA_VSIE=n
CONFIG_AP_STATYPE_LIMIT=n
CONFIG_SYSTEM_CTRL=y
CONFIG_FLASH_QUAD_ENABLE=y
CONFIG_FLASH_SRC_CLK_60M=y
CONFIG_SECURITYIP=n
CONFIG_I2C=y
CONFIG_SIM_I2C=y
CONFIG_I2C_SUPPORT_ID_BITS=3
CONFIG_FM_I2C=n
CONFIG_TIMER=y
CONFIG_TIMER_SUPPORT_ID_BITS=63
CONFIG_AON_PMU=y
CONFIG_POWER_CLOCK_RF=y
CONFIG_SARADC_NEED_FLUSH=n
CONFIG_SARADC_RANGE_DIVIDE=y
CONFIG_IPV6=n
CONFIG_ALI_MQTT=y
CONFIG_PAHO_MQTT=n
CONFIG_MIDEA=n
CONFIG_CHIP_SUPPORT=y
CONFIG_ADC_KEY=n
CONFIG_RWNX_PROTO_DEBUG=n
CONFIG_NTP_SYNC_RTC=n
CONFIG_LITTLEFS=n
CONFIG_VFS=n
CONFIG_VFS_MAX_FD_NUM=20
CONFIG_EXTERN_32K=n
CONFIG_OTP=y
CONFIG_VAULT_SUPPORT=y
CONFIG_HTTPS=n
CONFIG_MBEDTLS=n
CONFIG_OTA_HTTPS=n
CONFIG_MEM_AUTO_POWER_DISABLE=n
CONFIG_CP1_AUTO_POWER_DISABLE=n
CONFIG_BUTTON=n
CONFIG_DUAL_CORE=y
CONFIG_MASTER_CORE=y
CONFIG_SLAVE_CORE_OFFSET=1835008
```
