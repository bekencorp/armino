/* This file is generated by nds_ldsag (version (2022-05-18) ). */
ENTRY(_start)
SECTIONS
{
	PROVIDE (__executable_start = 0x10000);
	NDS_SAG_LMA_CPU0_LOAD1 = 0x10000 ;
	CPU0_LOAD1_BEGIN = NDS_SAG_LMA_CPU0_LOAD1;
	. = 0 + NDS_SAG_LMA_CPU0_LOAD1;
	. = ALIGN(ALIGNOF(.nds_vector));
	.nds_vector 	: { KEEP(*(.nds_vector )) KEEP(*(SORT(.nds_vector.* ))) }
	.interrupt.text 	: { KEEP(*(.interrupt.text )) }
	.interrupt.HalTrapVector.text.HalTrapVector 	: { KEEP(*(.interrupt.HalTrapVector.text.HalTrapVector )) }
	.itcm 	: { KEEP(*(.itcm )) }
	. = ALIGN(8);
	. = ALIGN(ALIGNOF(.nds_init));
	.nds_init 	: { KEEP(*(.nds_init )) } = 0x0100
	. = ALIGN(ALIGNOF(.interp));
	.interp 	: { *(.interp ) }
	. = ALIGN(ALIGNOF(.note.gnu.build-id));
	.note.gnu.build-id 	: { *(.note.gnu.build-id ) }
	. = ALIGN(ALIGNOF(.note.ABI-tag));
	.note.ABI-tag 	: { *(.note.ABI-tag ) }
	. = ALIGN(ALIGNOF(.hash));
	.hash 	: { *(.hash ) }
	. = ALIGN(ALIGNOF(.gnu.hash));
	.gnu.hash 	: { *(.gnu.hash ) }
	. = ALIGN(ALIGNOF(.dynsym));
	.dynsym 	: { *(.dynsym ) }
	. = ALIGN(ALIGNOF(.dynstr));
	.dynstr 	: { *(.dynstr ) }
	. = ALIGN(ALIGNOF(.gnu.version));
	.gnu.version 	: { *(.gnu.version ) }
	. = ALIGN(ALIGNOF(.gnu.version_d));
	.gnu.version_d 	: { *(.gnu.version_d ) }
	. = ALIGN(ALIGNOF(.gnu.version_r));
	.gnu.version_r 	: { *(.gnu.version_r ) }
	. = ALIGN(ALIGNOF(.rela.init));
	.rela.init 	: { *(.rela.init ) }
	. = ALIGN(ALIGNOF(.rela.text));
	.rela.text 	: { *(.rela.text .rela.text.* .rela.gnu.linkonce.t.* ) }
	. = ALIGN(ALIGNOF(.rela.fini));
	.rela.fini 	: { *(.rela.fini ) }
	. = ALIGN(ALIGNOF(.rela.rodata));
	.rela.rodata 	: { *(.rela.rodata .rela.rodata.* .rela.gnu.linkonce.r.* ) }
	. = ALIGN(ALIGNOF(.rela.data.rel.ro));
	.rela.data.rel.ro 	: { *(.rel.data.rel.ro* ) }
	. = ALIGN(ALIGNOF(.rela.data));
	.rela.data 	: { *(.rela.data .rela.data.* .rela.gnu.linkonce.d.* ) }
	. = ALIGN(ALIGNOF(.rela.tdata));
	.rela.tdata 	: { *(.rela.tdata .rela.tdata.* .rela.gnu.linkonce.td.* ) }
	. = ALIGN(ALIGNOF(.rela.tbss));
	.rela.tbss 	: { *(.rela.tbss .rela.tbss.* .rela.gnu.linkonce.tb.* ) }
	. = ALIGN(ALIGNOF(.rela.ctors));
	.rela.ctors 	: { *(.rela.ctors ) }
	. = ALIGN(ALIGNOF(.rela.dtors));
	.rela.dtors 	: { *(.rela.dtors ) }
	. = ALIGN(ALIGNOF(.rela.dyn));
	.rela.dyn 	: { *(rela.dyn ) *(.rela__libc_subfreeres ) *(.rela__libc_atexit ) *(.rela__libc_thread_subfreeres ) *(.rela.init_array ) *(.rela.fini_array ) }
	. = ALIGN(ALIGNOF(.rela.got));
	.rela.got 	: { *(.rela.got ) }
	. = ALIGN(ALIGNOF(.rela.sdata));
	.rela.sdata 	: { *(.rela.sdata .rela.sdata.* .rela.gnu.linkonce.s.* ) }
	. = ALIGN(ALIGNOF(.rela.sbss));
	.rela.sbss 	: { *(.rela.sbss .rela.sbss.* .rela.gnu.linkonce.sb.* ) }
	. = ALIGN(ALIGNOF(.rela.sdata2));
	.rela.sdata2 	: { *(.rela.sdata2 .rela.sdata2.* .rela.gnu.linkonce.s2.* ) }
	. = ALIGN(ALIGNOF(.rela.sbss2));
	.rela.sbss2 	: { *(.rela.sbss2 .rela.sbss2.* .rela.gnu.linkonce.sb2.* ) }
	. = ALIGN(ALIGNOF(.rela.bss));
	.rela.bss 	: { *(.rela.bss .rela.bss.* .rela.gnu.linkonce.b.* ) }
	. = ALIGN(ALIGNOF(.rela.plt));
	.rela.plt 	: { *(.rela.plt ) }
	. = ALIGN(ALIGNOF(.init));
	.init 	: { KEEP(*(.init )) }
	. = ALIGN(ALIGNOF(.plt));
	.plt 	: { *(.plt ) }
	. = ALIGN(ALIGNOF(.text));
	.text 	: { *(.text .stub .text.* .gnu.linkonce.t.* ) KEEP(*(.text.*personality* )) *(.gnu.warning ) . = ALIGN(4); } = 0x0100
	. = ALIGN(ALIGNOF(.fini));
	.fini 	: { KEEP(*(.fini )) }
	. = ALIGN(ALIGNOF(.exec.itable));
	.exec.itable 	: { *(.exec.itable ) }
	PROVIDE (__etext = .);
	PROVIDE (_etext = .);
	PROVIDE (etext = .);
	. = ALIGN(ALIGNOF(.rodata));
	.rodata 	: { *(.rodata .rodata.* .gnu.linkonce.r.* ) }
	. = ALIGN(ALIGNOF(.rodata1));
	.rodata1 	: { *(.rodata1 ) }
	. = ALIGN(ALIGNOF(.sdata2));
	.sdata2 	: { *(.sdata2 .sdata2.* .gnu.linkonce.s2.* ) }
	. = ALIGN(ALIGNOF(.sbss2));
	.sbss2 	: { *(.sbss2 .sbss2.* .gnu.linkonce.sb2.* ) }
	. = ALIGN(ALIGNOF(.eh_frame_hdr));
	.eh_frame_hdr 	: { *(.eh_frame_hdr ) }
	. = 0x10000000;
	ITCM_BEGIN = .;
	. = ALIGN(8);
	.itcm_sec_code 	: AT(ALIGN(ALIGN(LOADADDR (.eh_frame_hdr) + SIZEOF (.eh_frame_hdr), ALIGNOF(.itcm_sec_code)), 8))
		{ KEEP(*(.itcm_sec_code )) }
	_itcm_lma_start =  LOADADDR (.itcm_sec_code);
	_itcm_ema_start = ADDR(.itcm_sec_code);
	_itcm_lma_end =  LOADADDR (.itcm_sec_code) + SIZEOF (.itcm_sec_code);
	_itcm_ema_end = .;
	ITCM_SIZE = . - ITCM_BEGIN;
	. = 0x20000000;
	DTCM_BEGIN = .;
	. = ALIGN(8);
	.dtcm_sec_data 	: AT(ALIGN(ALIGN(LOADADDR (.itcm_sec_code) + SIZEOF (.itcm_sec_code), ALIGNOF(.dtcm_sec_data)), 8))
		{ KEEP(*(.dtcm_sec_data )) }
	_dtcm_lma_start =  LOADADDR (.dtcm_sec_data);
	_dtcm_ema_start = ADDR(.dtcm_sec_data);
	_dtcm_lma_end =  LOADADDR (.dtcm_sec_data) + SIZEOF (.dtcm_sec_data);
	_dtcm_ema_end = .;
	_dtcm_bss_start = .;
	.dtcm_sec_bss 	: AT(LOADADDR (.dtcm_sec_data) + SIZEOF (.dtcm_sec_data))
		{ KEEP(*(.dtcm_sec_bss )) }
	_dtcm_bss_end = .;
	DTCM_SIZE = . - DTCM_BEGIN;
	. = 0x30000000;
	SRAM_BT_BEGIN = .;
	. = ALIGN(8);
	.bt_spec_data 	: AT(ALIGN(ALIGN(LOADADDR (.dtcm_sec_bss) + SIZEOF (.dtcm_sec_bss), ALIGNOF(.bt_spec_data)), 8))
		{ KEEP(*(.bt_spec_data )) }
	_bt_data_lmastart =  LOADADDR (.bt_spec_data);
	_bt_data_start = ADDR(.bt_spec_data);
	. = ALIGN(8);
	.ble_bss_data 	: AT(ALIGN(ALIGN(LOADADDR (.bt_spec_data) + SIZEOF (.bt_spec_data), ALIGNOF(.ble_bss_data)), 8))
		{ KEEP(*(.ble_bss_data )) }
	. = ALIGN(8);
	__bss_start = .;
	PROVIDE (__sbss_start = .);
	PROVIDE (___sbss_start = .);
	".tbss_*rwip.c.obj" 	(NOLOAD)	: { *rwip.c.obj(.tbss .tbss.* .gnu.linkonce.tb.* ) *rwip_driver.c.obj(.tbss .tbss.* .gnu.linkonce.tb.* ) *uart_ble.c.obj(.tbss .tbss.* .gnu.linkonce.tb.* ) *uart_controller_only.c.obj(.tbss .tbss.* .gnu.linkonce.tb.* ) *rwip.c.obj(.tcommon ) *rwip_driver.c.obj(.tcommon ) *uart_ble.c.obj(.tcommon ) *uart_controller_only.c.obj(.tcommon ) }
	".sbss_*rwip.c.obj" 	(NOLOAD)	: { *rwip.c.obj(.dynsbss ) *rwip_driver.c.obj(.dynsbss ) *uart_ble.c.obj(.dynsbss ) *uart_controller_only.c.obj(.dynsbss ) *rwip.c.obj(.sbss .sbss.* .gnu.linkonce.sb.* ) *rwip_driver.c.obj(.sbss .sbss.* .gnu.linkonce.sb.* ) *uart_ble.c.obj(.sbss .sbss.* .gnu.linkonce.sb.* ) *uart_controller_only.c.obj(.sbss .sbss.* .gnu.linkonce.sb.* ) *rwip.c.obj(.scommon .scommon.* ) *rwip_driver.c.obj(.scommon .scommon.* ) *uart_ble.c.obj(.scommon .scommon.* ) *uart_controller_only.c.obj(.scommon .scommon.* ) }
	".sbss_f_*rwip.c.obj" 	(NOLOAD)	: { *rwip.c.obj(.sbss_f .sbss_f.* ) *rwip_driver.c.obj(.sbss_f .sbss_f.* ) *uart_ble.c.obj(.sbss_f .sbss_f.* ) *uart_controller_only.c.obj(.sbss_f .sbss_f.* ) *rwip.c.obj(.scommon_f .scommon_f.* ) *rwip_driver.c.obj(.scommon_f .scommon_f.* ) *uart_ble.c.obj(.scommon_f .scommon_f.* ) *uart_controller_only.c.obj(.scommon_f .scommon_f.* ) }
	".sbss_b_*rwip.c.obj" 	(NOLOAD)	: { *rwip.c.obj(.sbss_b .sbss_b.* ) *rwip_driver.c.obj(.sbss_b .sbss_b.* ) *uart_ble.c.obj(.sbss_b .sbss_b.* ) *uart_controller_only.c.obj(.sbss_b .sbss_b.* ) *rwip.c.obj(.scommon_b .scommon_b.* ) *rwip_driver.c.obj(.scommon_b .scommon_b.* ) *uart_ble.c.obj(.scommon_b .scommon_b.* ) *uart_controller_only.c.obj(.scommon_b .scommon_b.* ) . = ALIGN(2); }
	".sbss_h_*rwip.c.obj" 	(NOLOAD)	: { *rwip.c.obj(.sbss_h .sbss_h.* ) *rwip_driver.c.obj(.sbss_h .sbss_h.* ) *uart_ble.c.obj(.sbss_h .sbss_h.* ) *uart_controller_only.c.obj(.sbss_h .sbss_h.* ) *rwip.c.obj(.scommon_h .scommon_h.* ) *rwip_driver.c.obj(.scommon_h .scommon_h.* ) *uart_ble.c.obj(.scommon_h .scommon_h.* ) *uart_controller_only.c.obj(.scommon_h .scommon_h.* ) . = ALIGN(4); }
	".sbss_w_*rwip.c.obj" 	(NOLOAD)	: { *rwip.c.obj(.sbss_w .sbss_w.* ) *rwip_driver.c.obj(.sbss_w .sbss_w.* ) *uart_ble.c.obj(.sbss_w .sbss_w.* ) *uart_controller_only.c.obj(.sbss_w .sbss_w.* ) *rwip.c.obj(.scommon_w .scommon_w.* ) *rwip_driver.c.obj(.scommon_w .scommon_w.* ) *uart_ble.c.obj(.scommon_w .scommon_w.* ) *uart_controller_only.c.obj(.scommon_w .scommon_w.* ) *rwip.c.obj(.dynsbss ) *rwip_driver.c.obj(.dynsbss ) *uart_ble.c.obj(.dynsbss ) *uart_controller_only.c.obj(.dynsbss ) *rwip.c.obj(.scommon ) *rwip_driver.c.obj(.scommon ) *uart_ble.c.obj(.scommon ) *uart_controller_only.c.obj(.scommon ) . = ALIGN(8); }
	".sbss_d_*rwip.c.obj" 	(NOLOAD)	: { *rwip.c.obj(.sbss_d .sbss_d.* ) *rwip_driver.c.obj(.sbss_d .sbss_d.* ) *uart_ble.c.obj(.sbss_d .sbss_d.* ) *uart_controller_only.c.obj(.sbss_d .sbss_d.* ) *rwip.c.obj(.scommon_d .scommon_d.* ) *rwip_driver.c.obj(.scommon_d .scommon_d.* ) *uart_ble.c.obj(.scommon_d .scommon_d.* ) *uart_controller_only.c.obj(.scommon_d .scommon_d.* ) }
	".bss_*rwip.c.obj" 	(NOLOAD)	: { *rwip.c.obj(.dynbss ) *rwip_driver.c.obj(.dynbss ) *uart_ble.c.obj(.dynbss ) *uart_controller_only.c.obj(.dynbss ) *rwip.c.obj(.bss .bss.* .gnu.linkonce.b.* ) *rwip_driver.c.obj(.bss .bss.* .gnu.linkonce.b.* ) *uart_ble.c.obj(.bss .bss.* .gnu.linkonce.b.* ) *uart_controller_only.c.obj(.bss .bss.* .gnu.linkonce.b.* ) *rwip.c.obj(COMMON ) *rwip_driver.c.obj(COMMON ) *uart_ble.c.obj(COMMON ) *uart_controller_only.c.obj(COMMON ) . = ALIGN(8); }
	. = ALIGN(8);
	".tbss_*sdp_common.c.obj" 	(NOLOAD)	: { *sdp_common.c.obj(.tbss .tbss.* .gnu.linkonce.tb.* ) *app_ble.c.obj(.tbss .tbss.* .gnu.linkonce.tb.* ) *prf.c.obj(.tbss .tbss.* .gnu.linkonce.tb.* ) *sdp_common.c.obj(.tcommon ) *app_ble.c.obj(.tcommon ) *prf.c.obj(.tcommon ) }
	".sbss_*sdp_common.c.obj" 	(NOLOAD)	: { *sdp_common.c.obj(.dynsbss ) *app_ble.c.obj(.dynsbss ) *prf.c.obj(.dynsbss ) *sdp_common.c.obj(.sbss .sbss.* .gnu.linkonce.sb.* ) *app_ble.c.obj(.sbss .sbss.* .gnu.linkonce.sb.* ) *prf.c.obj(.sbss .sbss.* .gnu.linkonce.sb.* ) *sdp_common.c.obj(.scommon .scommon.* ) *app_ble.c.obj(.scommon .scommon.* ) *prf.c.obj(.scommon .scommon.* ) }
	".sbss_f_*sdp_common.c.obj" 	(NOLOAD)	: { *sdp_common.c.obj(.sbss_f .sbss_f.* ) *app_ble.c.obj(.sbss_f .sbss_f.* ) *prf.c.obj(.sbss_f .sbss_f.* ) *sdp_common.c.obj(.scommon_f .scommon_f.* ) *app_ble.c.obj(.scommon_f .scommon_f.* ) *prf.c.obj(.scommon_f .scommon_f.* ) }
	".sbss_b_*sdp_common.c.obj" 	(NOLOAD)	: { *sdp_common.c.obj(.sbss_b .sbss_b.* ) *app_ble.c.obj(.sbss_b .sbss_b.* ) *prf.c.obj(.sbss_b .sbss_b.* ) *sdp_common.c.obj(.scommon_b .scommon_b.* ) *app_ble.c.obj(.scommon_b .scommon_b.* ) *prf.c.obj(.scommon_b .scommon_b.* ) . = ALIGN(2); }
	".sbss_h_*sdp_common.c.obj" 	(NOLOAD)	: { *sdp_common.c.obj(.sbss_h .sbss_h.* ) *app_ble.c.obj(.sbss_h .sbss_h.* ) *prf.c.obj(.sbss_h .sbss_h.* ) *sdp_common.c.obj(.scommon_h .scommon_h.* ) *app_ble.c.obj(.scommon_h .scommon_h.* ) *prf.c.obj(.scommon_h .scommon_h.* ) . = ALIGN(4); }
	".sbss_w_*sdp_common.c.obj" 	(NOLOAD)	: { *sdp_common.c.obj(.sbss_w .sbss_w.* ) *app_ble.c.obj(.sbss_w .sbss_w.* ) *prf.c.obj(.sbss_w .sbss_w.* ) *sdp_common.c.obj(.scommon_w .scommon_w.* ) *app_ble.c.obj(.scommon_w .scommon_w.* ) *prf.c.obj(.scommon_w .scommon_w.* ) *sdp_common.c.obj(.dynsbss ) *app_ble.c.obj(.dynsbss ) *prf.c.obj(.dynsbss ) *sdp_common.c.obj(.scommon ) *app_ble.c.obj(.scommon ) *prf.c.obj(.scommon ) . = ALIGN(8); }
	".sbss_d_*sdp_common.c.obj" 	(NOLOAD)	: { *sdp_common.c.obj(.sbss_d .sbss_d.* ) *app_ble.c.obj(.sbss_d .sbss_d.* ) *prf.c.obj(.sbss_d .sbss_d.* ) *sdp_common.c.obj(.scommon_d .scommon_d.* ) *app_ble.c.obj(.scommon_d .scommon_d.* ) *prf.c.obj(.scommon_d .scommon_d.* ) }
	".bss_*sdp_common.c.obj" 	(NOLOAD)	: { *sdp_common.c.obj(.dynbss ) *app_ble.c.obj(.dynbss ) *prf.c.obj(.dynbss ) *sdp_common.c.obj(.bss .bss.* .gnu.linkonce.b.* ) *app_ble.c.obj(.bss .bss.* .gnu.linkonce.b.* ) *prf.c.obj(.bss .bss.* .gnu.linkonce.b.* ) *sdp_common.c.obj(COMMON ) *app_ble.c.obj(COMMON ) *prf.c.obj(COMMON ) . = ALIGN(8); }
	_bt_data_end = .;
	SRAM_BT_SIZE = . - SRAM_BT_BEGIN;
	. = 0x30010000;
	SRAM_DATA_BEGIN = .;
	.sram_nocache 	: AT(LOADADDR (.ble_bss_data) + SIZEOF (.ble_bss_data))
		{ KEEP(*(.sram_nocache )) }
	. = ALIGN(8);
	. = ALIGN(0x20);
	. = ALIGN(ALIGNOF(.eh_frame));
	.eh_frame 	: AT(ALIGN(LOADADDR (.sram_nocache) + SIZEOF (.sram_nocache), 32))
		{ KEEP(*(.eh_frame )) }
	_data_lmastart =  LOADADDR (.eh_frame);
	_data_start = ADDR(.eh_frame);
	. = ALIGN(ALIGNOF(.gcc_except_table));
	.gcc_except_table 	: AT(ALIGN(LOADADDR (.eh_frame) + SIZEOF (.eh_frame), ALIGNOF(.gcc_except_table)))
		{ KEEP(*(.gcc_except_table )) *(.gcc_except_table.* ) }
	. = ALIGN(ALIGNOF(.tdata));
	.tdata 	: AT(ALIGN(LOADADDR (.gcc_except_table) + SIZEOF (.gcc_except_table), ALIGNOF(.tdata)))
		{ *(.tdata .tdata.* .gnu.linkonce.td.* ) }
	. = ALIGN(8);
	. = ALIGN(ALIGNOF(.preinit_array));
	.preinit_array 	: AT(ALIGN(ALIGN(LOADADDR (.tdata) + SIZEOF (.tdata), ALIGNOF(.preinit_array)), 8))
		{; PROVIDE (__preinit_array_start = .); KEEP(*(.preinit_array )); PROVIDE (__preinit_array_end = .); }
	. = ALIGN(ALIGNOF(.init_array));
	.init_array 	: AT(ALIGN(LOADADDR (.preinit_array) + SIZEOF (.preinit_array), ALIGNOF(.init_array)))
		{; PROVIDE (__init_array_start = .); KEEP(*(SORT_BY_INIT_PRIORITY(.init_array.* ))) KEEP(*(.init_array )); PROVIDE (__init_array_end = .); }
	. = ALIGN(ALIGNOF(.fini_array));
	.fini_array 	: AT(ALIGN(LOADADDR (.init_array) + SIZEOF (.init_array), ALIGNOF(.fini_array)))
		{; PROVIDE (__fini_array_start = .); KEEP(*(SORT_BY_INIT_PRIORITY(.fini_array.* ))) KEEP(*(.fini_array )); PROVIDE (__fini_array_end = .); }
	. = ALIGN(ALIGNOF(.tm_clone_table));
	.tm_clone_table 	: AT(ALIGN(LOADADDR (.fini_array) + SIZEOF (.fini_array), ALIGNOF(.tm_clone_table)))
		{ *(.tm_clone_table ) }
	. = ALIGN(ALIGNOF(.ctors));
	.ctors 	: AT(ALIGN(LOADADDR (.tm_clone_table) + SIZEOF (.tm_clone_table), ALIGNOF(.ctors)))
		{ KEEP(*crtbegin*.o(.ctors)) KEEP(*(EXCLUDE_FILE (*crtend*.o) .ctors)) KEEP(*(SORT(.ctors.* ))) KEEP(*(.ctors )) }
	. = ALIGN(ALIGNOF(.dtors));
	.dtors 	: AT(ALIGN(LOADADDR (.ctors) + SIZEOF (.ctors), ALIGNOF(.dtors)))
		{ KEEP(*crtbegin*.o(.dtors)) KEEP(*(EXCLUDE_FILE (*crtend*.o) .dtors)) KEEP(*(SORT(.dtors.* ))) KEEP(*(.dtors )) }
	. = ALIGN(ALIGNOF(.jcr));
	.jcr 	: AT(ALIGN(LOADADDR (.dtors) + SIZEOF (.dtors), ALIGNOF(.jcr)))
		{ KEEP(*(.jcr )) }
	. = ALIGN(ALIGNOF(.data.rel.ro));
	.data.rel.ro 	: AT(ALIGN(LOADADDR (.jcr) + SIZEOF (.jcr), ALIGNOF(.data.rel.ro)))
		{ *(.data.rel.ro.local ) *(.data.rel.ro* ) }
	. = ALIGN(ALIGNOF(.dynamic));
	.dynamic 	: AT(ALIGN(LOADADDR (.data.rel.ro) + SIZEOF (.data.rel.ro), ALIGNOF(.dynamic)))
		{ *(.dynamic ) }
	. = ALIGN(8);
	. = ALIGN(ALIGNOF(.got));
	.got 	: AT(ALIGN(ALIGN(LOADADDR (.dynamic) + SIZEOF (.dynamic), ALIGNOF(.got)), 8))
		{ *(.got.plt ) *(.got ) }
	. = ALIGN(ALIGNOF(.data));
	.data 	: AT(ALIGN(LOADADDR (.got) + SIZEOF (.got), ALIGNOF(.data)))
		{ *(.data .data.* .gnu.linkonce.d.* ) KEEP(*(.gnu.linkonce.d.*personality* )) SORT(CONSTRUCTORS) . = ALIGN(8); }
	. = ALIGN(ALIGNOF(.data1));
	.data1 	: AT(ALIGN(LOADADDR (.data) + SIZEOF (.data), ALIGNOF(.data1)))
		{ *(.data1 ) . = ALIGN(8); }
	. = ALIGN(8);
	. = ALIGN(ALIGNOF(.sdata));
	.sdata 	: AT(ALIGN(ALIGN(LOADADDR (.data1) + SIZEOF (.data1), ALIGNOF(.sdata)), 8))
		{ *(.srodata.cst16 ) *(.srodata.cst8 ) *(.srodata.cst4 ) *(.srodata.cst2 ) *(.srodata .srodata.* ) *(.sdata .sdata.* .gnu.linkonce.s.* ) }
	. = ALIGN(ALIGNOF(.sdata_d));
	.sdata_d 	: AT(ALIGN(LOADADDR (.sdata) + SIZEOF (.sdata), ALIGNOF(.sdata_d)))
		{ *(.sdata_d .sdata_d.* ) }
	. = ALIGN(ALIGNOF(.sdata_w));
	.sdata_w 	: AT(ALIGN(LOADADDR (.sdata_d) + SIZEOF (.sdata_d), ALIGNOF(.sdata_w)))
		{ *(.sdata_w .sdata_w.* ) }
	. = ALIGN(ALIGNOF(.sdata_h));
	.sdata_h 	: AT(ALIGN(LOADADDR (.sdata_w) + SIZEOF (.sdata_w), ALIGNOF(.sdata_h)))
		{ *(.sdata_h .sdata_h.* ) }
	. = ALIGN(ALIGNOF(.sdata_b));
	.sdata_b 	: AT(ALIGN(LOADADDR (.sdata_h) + SIZEOF (.sdata_h), ALIGNOF(.sdata_b)))
		{ *(.sdata_b .sdata_b.* ) }
	. = ALIGN(ALIGNOF(.sdata_f));
	.sdata_f 	: AT(ALIGN(LOADADDR (.sdata_b) + SIZEOF (.sdata_b), ALIGNOF(.sdata_f)))
		{ *(.sdata_f .sdata_f.* ) }
	. = ALIGN(8);
	_edata = .;
	PROVIDE (edata = .);
	. = ALIGN(8);
	.tbss 	(NOLOAD)	: { *(.tbss .tbss.* .gnu.linkonce.tb.* ) *(.tcommon ) }
	.sbss 	(NOLOAD)	: { *(.dynsbss ) *(.sbss .sbss.* .gnu.linkonce.sb.* ) *(.scommon .scommon.* ) }
	.sbss_f 	(NOLOAD)	: { *(.sbss_f .sbss_f.* ) *(.scommon_f .scommon_f.* ) }
	.sbss_b 	(NOLOAD)	: { *(.sbss_b .sbss_b.* ) *(.scommon_b .scommon_b.* ) . = ALIGN(2); }
	.sbss_h 	(NOLOAD)	: { *(.sbss_h .sbss_h.* ) *(.scommon_h .scommon_h.* ) . = ALIGN(4); }
	.sbss_w 	(NOLOAD)	: { *(.sbss_w .sbss_w.* ) *(.scommon_w .scommon_w.* ) *(.dynsbss ) *(.scommon ) . = ALIGN(8); }
	.sbss_d 	(NOLOAD)	: { *(.sbss_d .sbss_d.* ) *(.scommon_d .scommon_d.* ) }
	.bss 	(NOLOAD)	: { *(.dynbss ) *(.bss .bss.* .gnu.linkonce.b.* ) *(COMMON ) . = ALIGN(8); }
	PROVIDE (__sbss_end = .);
	PROVIDE (___sbss_end = .);
	. = ALIGN(8);
	_end = .;
	PROVIDE (end = .);
	PROVIDE (_stack = 0x20007FE0);
	SRAM_DATA_SIZE = . - SRAM_DATA_BEGIN;
	. = 0x38000000;
	SRAM_CACHE_BEGIN = .;
	.sram_cache 	: AT(LOADADDR (.sdata_f) + SIZEOF (.sdata_f))
		{ KEEP(*(.sram_cache )) }
	SRAM_CACHE_SIZE = . - SRAM_CACHE_BEGIN;
	CPU0_LOAD1_SIZE = LOADADDR(.sram_cache) + SIZEOF(.sram_cache) - CPU0_LOAD1_BEGIN;
	.stab	0 : { *(.stab) }
	.stabstr	0 : { *(.stabstr) }
	.stab.excl	0 : { *(.stab.excl) }
	.stab.exclstr	0 : { *(.stab.exclstr) }
	.stab.index	0 : { *(.stab.index) }
	.stab.indexstr	0 : { *(.stab.indexstr) }
	.comment	0 : { *(.comment) }
	.debug	0 : { *(.debug) }
	.line	0 : { *(.line) }
	.debug_srcinfo	0 : { *(.debug_srcinfo) }
	.debug_sfnames	0 : { *(.debug_sfnames) }
	.debug_aranges	0 : { *(.debug_aranges) }
	.debug_pubnames	0 : { *(.debug_pubnames) }
	.debug_info	0 : { *(.debug_info .gnu.linkonce.wi.*) }
	.debug_abbrev	0 : { *(.debug_abbrev) }
	.debug_line	0 : { *(.debug_line) }
	.debug_frame	0 : { *(.debug_frame) }
	.debug_str	0 : { *(.debug_str) }
	.debug_loc	0 : { *(.debug_loc) }
	.debug_macinfo	0 : { *(.debug_macinfo) }
	.debug_weaknames	0 : { *(.debug_weaknames) }
	.debug_funcnames	0 : { *(.debug_funcnames) }
	.debug_typenames	0 : { *(.debug_typenames) }
	.debug_varnames	0 : { *(.debug_varnames) }
}
ASSERT((DEFINED (_RELAX_END_) ? ITCM_SIZE : 0x0)<= 0x8000, "ITCM OVERFLOW");
ASSERT((DEFINED (_RELAX_END_) ? DTCM_SIZE : 0x0)<= 0x7800, "DTCM OVERFLOW");
ASSERT((DEFINED (_RELAX_END_) ? SRAM_BT_SIZE : 0x0)<= 0x10000, "SRAM_BT OVERFLOW");
ASSERT((DEFINED (_RELAX_END_) ? SRAM_DATA_SIZE : 0x0)<= 0x30000, "SRAM_DATA OVERFLOW");
ASSERT((DEFINED (_RELAX_END_) ? SRAM_CACHE_SIZE : 0x0)<= 0x40000, "SRAM_CACHE OVERFLOW");
ASSERT((DEFINED (_RELAX_END_) ? CPU0_LOAD1_SIZE : 0x0)<= 0x3a0000, "CPU0_LOAD1 OVERFLOW");
