## projects/lvgl/soundbar/main/Kconfig.projbuild
```kconfig
menu "LVGL Music Configuration"

    config LV_USE_DEMO_MUSIC
        bool "LVGL Music"
        default n
endmenu
```

## projects/lvgl/stress/main/Kconfig.projbuild
```kconfig
menu "LVGL Stress Configuration"

    config LV_USE_DEMO_STRESS
        bool "LVGL Stress"
        default n
endmenu
```

## projects/lvgl/widgets/main/Kconfig.projbuild
```kconfig
menu "LVGL Widgets Configuration"

    config LV_USE_DEMO_WIDGETS
        bool "LVGL Widgets"
        default n
endmenu
```

## projects/media/doorbell/main/Kconfig.projbuild
```kconfig
menu "INTEGRATION_DOORBELL"

    config INTEGRATION_DOORBELL
        bool "Doorbell integration"
        default n
    config INTEGRATION_DOORBELL_CS2
        bool "Doorbell integration CS2"
        default n
		
endmenu
```

## tools/build_tools/build_files/Kconfig
```kconfig
#TODO add full ARMINO Kconfig

source "${ARMINO_PATH}/middleware/soc/Kconfig"

mainmenu "Beken Development Configuration"

	menu "ARMINO Configuration"
		menu "Common Configuration"

			menu "Compile/Build"
				# Don't modify the default value directly!
				# modify middleware/soc/bkxxx/bkxxx.defconfig,
				# or modify it in per-project bkxxx.config
				config TOOLCHAIN_PATH
				string "Toolchain absolute path"
				default "/opt/gcc-arm-none-eabi-5_4-2016q3/bin"

				config TOOLCHAIN_PREFIX
				string "Toolchain prefix"
				default "arm-none-eabi-"

				config OBJDUMP
				bool "whether Objdump -d elf to lst or not"
				default y

			endmenu

			menu "Debug"
				choice ASSERT
					prompt "Assert options"
					default ASSERT_REBOOT

					config ASSERT_IGNORE
						bool "Ignore Assert"
					config ASSERT_HALT
						bool "Assert halts the system"
					config ASSERT_REBOOT
						bool "Assert reboots the system"
				endchoice

				config JTAG
					bool "Enable JTAG"
					default n
			endmenu
		endmenu

		# Configure global or cross-components features
		# Place configurations here if:
		#  - Global features which is NOT suitable to configure in any specific component
		#  - Mutual exclusive components, such as ble, ble_5_x_rw etc
		menu "Features Configuration"

			config LWIP
				depends on WIFI_ENABLE
				bool "Enable LWIP"
				default y

			choice LWIP
				depends on LWIP
				prompt "LWIP Version"
				default LWIP_V2_0

				config LWIP_V2_0
					depends on LWIP
					bool "LWIP 2.0.2"
				config LWIP_V2_1
					depends on LWIP
					bool "LWIP 2.1.2"
			endchoice

			choice HOST
				prompt "Hosted Mode"
				default NO_HOSTED

				config NO_HOSTED
					bool "Disable Hosted"
				config SEMI_HOSTED
					bool "Semi Hosted"
				config FULLY_HOSTED
					bool "Fully Hosted"
			endchoice

			config WIFI_SENSOR
				bool "Enable WiFi sensor"
				default n

			config BLUETOOTH
				bool "Enable Bluetooth"
				default y
		endmenu

		menu "Modules Configuration"
			menu "Components Configuration"
				source "$COMPONENTS_KCONFIGS_SOURCE_FILE"
			endmenu
			menu "Middleware Configuration"
				source "$MIDDLEWARE_KCONFIGS_SOURCE_FILE"
			endmenu
			menu "Projects Configuration"
				source "$PROJECTS_KCONFIGS_SOURCE_FILE"
			endmenu
			menu "Properties Configuration"
				source "$PROPERTIES_KCONFIGS_SOURCE_FILE"
			endmenu
			menu "Extra Modules Configuration"
				source "$EXTRA_KCONFIGS_SOURCE_FILE"
			endmenu
		endmenu
	endmenu

	source "$COMPONENT_KCONFIGS_PROJBUILD_SOURCE_FILE"
```

## tools/build_tools/kconfig_new/test/gen_kconfig_doc/Kconfig.chipa
```kconfig
menu "Menu for CHIPA"
    visible if ARMINO_SOC_CHIPA

    config EXT_CONFIG1_FOR_CHIPA_MENU
        bool "Config for chip A"
        depends on ARMINO_SOC_CHIPA

    config EXT_CONFIG2_FOR_CHIPA_MENU
        bool "Config for chip A (depend on the visibility of the menu)"

endmenu

config EXT_CONFIG3_FOR_CHIPA
    bool "Config for chip A"
    depends on ARMINO_SOC_CHIPA

config EXT_CONFIG4
    bool "Config for every chip (note that the config is defined at multiple places)"
    depends on ARMINO_SOC_CHIPA
```
